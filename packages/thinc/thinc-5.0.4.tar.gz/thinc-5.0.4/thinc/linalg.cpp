/* Generated by Cython 0.23.4 */

#define PY_SSIZE_T_CLEAN
#include "Python.h"
#ifndef Py_PYTHON_H
    #error Python headers needed to compile C extensions, please install development version of Python.
#elif PY_VERSION_HEX < 0x02060000 || (0x03000000 <= PY_VERSION_HEX && PY_VERSION_HEX < 0x03020000)
    #error Cython requires Python 2.6+ or Python 3.2+.
#else
#define CYTHON_ABI "0_23_4"
#include <stddef.h>
#ifndef offsetof
#define offsetof(type, member) ( (size_t) & ((type*)0) -> member )
#endif
#if !defined(WIN32) && !defined(MS_WINDOWS)
  #ifndef __stdcall
    #define __stdcall
  #endif
  #ifndef __cdecl
    #define __cdecl
  #endif
  #ifndef __fastcall
    #define __fastcall
  #endif
#endif
#ifndef DL_IMPORT
  #define DL_IMPORT(t) t
#endif
#ifndef DL_EXPORT
  #define DL_EXPORT(t) t
#endif
#ifndef PY_LONG_LONG
  #define PY_LONG_LONG LONG_LONG
#endif
#ifndef Py_HUGE_VAL
  #define Py_HUGE_VAL HUGE_VAL
#endif
#ifdef PYPY_VERSION
#define CYTHON_COMPILING_IN_PYPY 1
#define CYTHON_COMPILING_IN_CPYTHON 0
#else
#define CYTHON_COMPILING_IN_PYPY 0
#define CYTHON_COMPILING_IN_CPYTHON 1
#endif
#if !defined(CYTHON_USE_PYLONG_INTERNALS) && CYTHON_COMPILING_IN_CPYTHON && PY_VERSION_HEX >= 0x02070000
#define CYTHON_USE_PYLONG_INTERNALS 1
#endif
#if CYTHON_COMPILING_IN_PYPY && PY_VERSION_HEX < 0x02070600 && !defined(Py_OptimizeFlag)
#define Py_OptimizeFlag 0
#endif
#define __PYX_BUILD_PY_SSIZE_T "n"
#define CYTHON_FORMAT_SSIZE_T "z"
#if PY_MAJOR_VERSION < 3
  #define __Pyx_BUILTIN_MODULE_NAME "__builtin__"
  #define __Pyx_PyCode_New(a, k, l, s, f, code, c, n, v, fv, cell, fn, name, fline, lnos)\
          PyCode_New(a+k, l, s, f, code, c, n, v, fv, cell, fn, name, fline, lnos)
  #define __Pyx_DefaultClassType PyClass_Type
#else
  #define __Pyx_BUILTIN_MODULE_NAME "builtins"
  #define __Pyx_PyCode_New(a, k, l, s, f, code, c, n, v, fv, cell, fn, name, fline, lnos)\
          PyCode_New(a, k, l, s, f, code, c, n, v, fv, cell, fn, name, fline, lnos)
  #define __Pyx_DefaultClassType PyType_Type
#endif
#ifndef Py_TPFLAGS_CHECKTYPES
  #define Py_TPFLAGS_CHECKTYPES 0
#endif
#ifndef Py_TPFLAGS_HAVE_INDEX
  #define Py_TPFLAGS_HAVE_INDEX 0
#endif
#ifndef Py_TPFLAGS_HAVE_NEWBUFFER
  #define Py_TPFLAGS_HAVE_NEWBUFFER 0
#endif
#ifndef Py_TPFLAGS_HAVE_FINALIZE
  #define Py_TPFLAGS_HAVE_FINALIZE 0
#endif
#if PY_VERSION_HEX > 0x03030000 && defined(PyUnicode_KIND)
  #define CYTHON_PEP393_ENABLED 1
  #define __Pyx_PyUnicode_READY(op)       (likely(PyUnicode_IS_READY(op)) ?\
                                              0 : _PyUnicode_Ready((PyObject *)(op)))
  #define __Pyx_PyUnicode_GET_LENGTH(u)   PyUnicode_GET_LENGTH(u)
  #define __Pyx_PyUnicode_READ_CHAR(u, i) PyUnicode_READ_CHAR(u, i)
  #define __Pyx_PyUnicode_KIND(u)         PyUnicode_KIND(u)
  #define __Pyx_PyUnicode_DATA(u)         PyUnicode_DATA(u)
  #define __Pyx_PyUnicode_READ(k, d, i)   PyUnicode_READ(k, d, i)
#else
  #define CYTHON_PEP393_ENABLED 0
  #define __Pyx_PyUnicode_READY(op)       (0)
  #define __Pyx_PyUnicode_GET_LENGTH(u)   PyUnicode_GET_SIZE(u)
  #define __Pyx_PyUnicode_READ_CHAR(u, i) ((Py_UCS4)(PyUnicode_AS_UNICODE(u)[i]))
  #define __Pyx_PyUnicode_KIND(u)         (sizeof(Py_UNICODE))
  #define __Pyx_PyUnicode_DATA(u)         ((void*)PyUnicode_AS_UNICODE(u))
  #define __Pyx_PyUnicode_READ(k, d, i)   ((void)(k), (Py_UCS4)(((Py_UNICODE*)d)[i]))
#endif
#if CYTHON_COMPILING_IN_PYPY
  #define __Pyx_PyUnicode_Concat(a, b)      PyNumber_Add(a, b)
  #define __Pyx_PyUnicode_ConcatSafe(a, b)  PyNumber_Add(a, b)
#else
  #define __Pyx_PyUnicode_Concat(a, b)      PyUnicode_Concat(a, b)
  #define __Pyx_PyUnicode_ConcatSafe(a, b)  ((unlikely((a) == Py_None) || unlikely((b) == Py_None)) ?\
      PyNumber_Add(a, b) : __Pyx_PyUnicode_Concat(a, b))
#endif
#if CYTHON_COMPILING_IN_PYPY && !defined(PyUnicode_Contains)
  #define PyUnicode_Contains(u, s)  PySequence_Contains(u, s)
#endif
#define __Pyx_PyString_FormatSafe(a, b)   ((unlikely((a) == Py_None)) ? PyNumber_Remainder(a, b) : __Pyx_PyString_Format(a, b))
#define __Pyx_PyUnicode_FormatSafe(a, b)  ((unlikely((a) == Py_None)) ? PyNumber_Remainder(a, b) : PyUnicode_Format(a, b))
#if PY_MAJOR_VERSION >= 3
  #define __Pyx_PyString_Format(a, b)  PyUnicode_Format(a, b)
#else
  #define __Pyx_PyString_Format(a, b)  PyString_Format(a, b)
#endif
#if PY_MAJOR_VERSION >= 3
  #define PyBaseString_Type            PyUnicode_Type
  #define PyStringObject               PyUnicodeObject
  #define PyString_Type                PyUnicode_Type
  #define PyString_Check               PyUnicode_Check
  #define PyString_CheckExact          PyUnicode_CheckExact
#endif
#if PY_MAJOR_VERSION >= 3
  #define __Pyx_PyBaseString_Check(obj) PyUnicode_Check(obj)
  #define __Pyx_PyBaseString_CheckExact(obj) PyUnicode_CheckExact(obj)
#else
  #define __Pyx_PyBaseString_Check(obj) (PyString_Check(obj) || PyUnicode_Check(obj))
  #define __Pyx_PyBaseString_CheckExact(obj) (PyString_CheckExact(obj) || PyUnicode_CheckExact(obj))
#endif
#ifndef PySet_CheckExact
  #define PySet_CheckExact(obj)        (Py_TYPE(obj) == &PySet_Type)
#endif
#define __Pyx_TypeCheck(obj, type) PyObject_TypeCheck(obj, (PyTypeObject *)type)
#if PY_MAJOR_VERSION >= 3
  #define PyIntObject                  PyLongObject
  #define PyInt_Type                   PyLong_Type
  #define PyInt_Check(op)              PyLong_Check(op)
  #define PyInt_CheckExact(op)         PyLong_CheckExact(op)
  #define PyInt_FromString             PyLong_FromString
  #define PyInt_FromUnicode            PyLong_FromUnicode
  #define PyInt_FromLong               PyLong_FromLong
  #define PyInt_FromSize_t             PyLong_FromSize_t
  #define PyInt_FromSsize_t            PyLong_FromSsize_t
  #define PyInt_AsLong                 PyLong_AsLong
  #define PyInt_AS_LONG                PyLong_AS_LONG
  #define PyInt_AsSsize_t              PyLong_AsSsize_t
  #define PyInt_AsUnsignedLongMask     PyLong_AsUnsignedLongMask
  #define PyInt_AsUnsignedLongLongMask PyLong_AsUnsignedLongLongMask
  #define PyNumber_Int                 PyNumber_Long
#endif
#if PY_MAJOR_VERSION >= 3
  #define PyBoolObject                 PyLongObject
#endif
#if PY_MAJOR_VERSION >= 3 && CYTHON_COMPILING_IN_PYPY
  #ifndef PyUnicode_InternFromString
    #define PyUnicode_InternFromString(s) PyUnicode_FromString(s)
  #endif
#endif
#if PY_VERSION_HEX < 0x030200A4
  typedef long Py_hash_t;
  #define __Pyx_PyInt_FromHash_t PyInt_FromLong
  #define __Pyx_PyInt_AsHash_t   PyInt_AsLong
#else
  #define __Pyx_PyInt_FromHash_t PyInt_FromSsize_t
  #define __Pyx_PyInt_AsHash_t   PyInt_AsSsize_t
#endif
#if PY_MAJOR_VERSION >= 3
  #define __Pyx_PyMethod_New(func, self, klass) ((self) ? PyMethod_New(func, self) : PyInstanceMethod_New(func))
#else
  #define __Pyx_PyMethod_New(func, self, klass) PyMethod_New(func, self, klass)
#endif
#if PY_VERSION_HEX >= 0x030500B1
#define __Pyx_PyAsyncMethodsStruct PyAsyncMethods
#define __Pyx_PyType_AsAsync(obj) (Py_TYPE(obj)->tp_as_async)
#elif CYTHON_COMPILING_IN_CPYTHON && PY_MAJOR_VERSION >= 3
typedef struct {
    unaryfunc am_await;
    unaryfunc am_aiter;
    unaryfunc am_anext;
} __Pyx_PyAsyncMethodsStruct;
#define __Pyx_PyType_AsAsync(obj) ((__Pyx_PyAsyncMethodsStruct*) (Py_TYPE(obj)->tp_reserved))
#else
#define __Pyx_PyType_AsAsync(obj) NULL
#endif
#ifndef CYTHON_RESTRICT
  #if defined(__GNUC__)
    #define CYTHON_RESTRICT __restrict__
  #elif defined(_MSC_VER) && _MSC_VER >= 1400
    #define CYTHON_RESTRICT __restrict
  #elif defined (__STDC_VERSION__) && __STDC_VERSION__ >= 199901L
    #define CYTHON_RESTRICT restrict
  #else
    #define CYTHON_RESTRICT
  #endif
#endif
#define __Pyx_void_to_None(void_result) ((void)(void_result), Py_INCREF(Py_None), Py_None)

#ifndef __cplusplus
  #error "Cython files generated with the C++ option must be compiled with a C++ compiler."
#endif
#ifndef CYTHON_INLINE
  #define CYTHON_INLINE inline
#endif
template<typename T>
void __Pyx_call_destructor(T& x) {
    x.~T();
}
template<typename T>
class __Pyx_FakeReference {
  public:
    __Pyx_FakeReference() : ptr(NULL) { }
    __Pyx_FakeReference(const T& ref) : ptr(const_cast<T*>(&ref)) { }
    T *operator->() { return ptr; }
    operator T&() { return *ptr; }
  private:
    T *ptr;
};

#if defined(WIN32) || defined(MS_WINDOWS)
  #define _USE_MATH_DEFINES
#endif
#include <math.h>
#ifdef NAN
#define __PYX_NAN() ((float) NAN)
#else
static CYTHON_INLINE float __PYX_NAN() {
  float value;
  memset(&value, 0xFF, sizeof(value));
  return value;
}
#endif


#if PY_MAJOR_VERSION >= 3
  #define __Pyx_PyNumber_Divide(x,y)         PyNumber_TrueDivide(x,y)
  #define __Pyx_PyNumber_InPlaceDivide(x,y)  PyNumber_InPlaceTrueDivide(x,y)
#else
  #define __Pyx_PyNumber_Divide(x,y)         PyNumber_Divide(x,y)
  #define __Pyx_PyNumber_InPlaceDivide(x,y)  PyNumber_InPlaceDivide(x,y)
#endif

#ifndef __PYX_EXTERN_C
  #ifdef __cplusplus
    #define __PYX_EXTERN_C extern "C"
  #else
    #define __PYX_EXTERN_C extern
  #endif
#endif

#define __PYX_HAVE__thinc__linalg
#define __PYX_HAVE_API__thinc__linalg
#include "stdint.h"
#include "string.h"
#include "math.h"
#ifdef _OPENMP
#include <omp.h>
#endif /* _OPENMP */

#ifdef PYREX_WITHOUT_ASSERTIONS
#define CYTHON_WITHOUT_ASSERTIONS
#endif

#ifndef CYTHON_UNUSED
# if defined(__GNUC__)
#   if !(defined(__cplusplus)) || (__GNUC__ > 3 || (__GNUC__ == 3 && __GNUC_MINOR__ >= 4))
#     define CYTHON_UNUSED __attribute__ ((__unused__))
#   else
#     define CYTHON_UNUSED
#   endif
# elif defined(__ICC) || (defined(__INTEL_COMPILER) && !defined(_MSC_VER))
#   define CYTHON_UNUSED __attribute__ ((__unused__))
# else
#   define CYTHON_UNUSED
# endif
#endif
#ifndef CYTHON_NCP_UNUSED
# if CYTHON_COMPILING_IN_CPYTHON
#  define CYTHON_NCP_UNUSED
# else
#  define CYTHON_NCP_UNUSED CYTHON_UNUSED
# endif
#endif
typedef struct {PyObject **p; char *s; const Py_ssize_t n; const char* encoding;
                const char is_unicode; const char is_str; const char intern; } __Pyx_StringTabEntry;

#define __PYX_DEFAULT_STRING_ENCODING_IS_ASCII 0
#define __PYX_DEFAULT_STRING_ENCODING_IS_DEFAULT 0
#define __PYX_DEFAULT_STRING_ENCODING ""
#define __Pyx_PyObject_FromString __Pyx_PyBytes_FromString
#define __Pyx_PyObject_FromStringAndSize __Pyx_PyBytes_FromStringAndSize
#define __Pyx_uchar_cast(c) ((unsigned char)c)
#define __Pyx_long_cast(x) ((long)x)
#define __Pyx_fits_Py_ssize_t(v, type, is_signed)  (\
    (sizeof(type) < sizeof(Py_ssize_t))  ||\
    (sizeof(type) > sizeof(Py_ssize_t) &&\
          likely(v < (type)PY_SSIZE_T_MAX ||\
                 v == (type)PY_SSIZE_T_MAX)  &&\
          (!is_signed || likely(v > (type)PY_SSIZE_T_MIN ||\
                                v == (type)PY_SSIZE_T_MIN)))  ||\
    (sizeof(type) == sizeof(Py_ssize_t) &&\
          (is_signed || likely(v < (type)PY_SSIZE_T_MAX ||\
                               v == (type)PY_SSIZE_T_MAX)))  )
#if defined (__cplusplus) && __cplusplus >= 201103L
    #include <cstdlib>
    #define __Pyx_sst_abs(value) std::abs(value)
#elif SIZEOF_INT >= SIZEOF_SIZE_T
    #define __Pyx_sst_abs(value) abs(value)
#elif SIZEOF_LONG >= SIZEOF_SIZE_T
    #define __Pyx_sst_abs(value) labs(value)
#elif defined (_MSC_VER) && defined (_M_X64)
    #define __Pyx_sst_abs(value) _abs64(value)
#elif defined (__STDC_VERSION__) && __STDC_VERSION__ >= 199901L
    #define __Pyx_sst_abs(value) llabs(value)
#elif defined (__GNUC__)
    #define __Pyx_sst_abs(value) __builtin_llabs(value)
#else
    #define __Pyx_sst_abs(value) ((value<0) ? -value : value)
#endif
static CYTHON_INLINE char* __Pyx_PyObject_AsString(PyObject*);
static CYTHON_INLINE char* __Pyx_PyObject_AsStringAndSize(PyObject*, Py_ssize_t* length);
#define __Pyx_PyByteArray_FromString(s) PyByteArray_FromStringAndSize((const char*)s, strlen((const char*)s))
#define __Pyx_PyByteArray_FromStringAndSize(s, l) PyByteArray_FromStringAndSize((const char*)s, l)
#define __Pyx_PyBytes_FromString        PyBytes_FromString
#define __Pyx_PyBytes_FromStringAndSize PyBytes_FromStringAndSize
static CYTHON_INLINE PyObject* __Pyx_PyUnicode_FromString(const char*);
#if PY_MAJOR_VERSION < 3
    #define __Pyx_PyStr_FromString        __Pyx_PyBytes_FromString
    #define __Pyx_PyStr_FromStringAndSize __Pyx_PyBytes_FromStringAndSize
#else
    #define __Pyx_PyStr_FromString        __Pyx_PyUnicode_FromString
    #define __Pyx_PyStr_FromStringAndSize __Pyx_PyUnicode_FromStringAndSize
#endif
#define __Pyx_PyObject_AsSString(s)    ((signed char*) __Pyx_PyObject_AsString(s))
#define __Pyx_PyObject_AsUString(s)    ((unsigned char*) __Pyx_PyObject_AsString(s))
#define __Pyx_PyObject_FromCString(s)  __Pyx_PyObject_FromString((const char*)s)
#define __Pyx_PyBytes_FromCString(s)   __Pyx_PyBytes_FromString((const char*)s)
#define __Pyx_PyByteArray_FromCString(s)   __Pyx_PyByteArray_FromString((const char*)s)
#define __Pyx_PyStr_FromCString(s)     __Pyx_PyStr_FromString((const char*)s)
#define __Pyx_PyUnicode_FromCString(s) __Pyx_PyUnicode_FromString((const char*)s)
#if PY_MAJOR_VERSION < 3
static CYTHON_INLINE size_t __Pyx_Py_UNICODE_strlen(const Py_UNICODE *u)
{
    const Py_UNICODE *u_end = u;
    while (*u_end++) ;
    return (size_t)(u_end - u - 1);
}
#else
#define __Pyx_Py_UNICODE_strlen Py_UNICODE_strlen
#endif
#define __Pyx_PyUnicode_FromUnicode(u)       PyUnicode_FromUnicode(u, __Pyx_Py_UNICODE_strlen(u))
#define __Pyx_PyUnicode_FromUnicodeAndLength PyUnicode_FromUnicode
#define __Pyx_PyUnicode_AsUnicode            PyUnicode_AsUnicode
#define __Pyx_NewRef(obj) (Py_INCREF(obj), obj)
#define __Pyx_Owned_Py_None(b) __Pyx_NewRef(Py_None)
#define __Pyx_PyBool_FromLong(b) ((b) ? __Pyx_NewRef(Py_True) : __Pyx_NewRef(Py_False))
static CYTHON_INLINE int __Pyx_PyObject_IsTrue(PyObject*);
static CYTHON_INLINE PyObject* __Pyx_PyNumber_Int(PyObject* x);
static CYTHON_INLINE Py_ssize_t __Pyx_PyIndex_AsSsize_t(PyObject*);
static CYTHON_INLINE PyObject * __Pyx_PyInt_FromSize_t(size_t);
#if CYTHON_COMPILING_IN_CPYTHON
#define __pyx_PyFloat_AsDouble(x) (PyFloat_CheckExact(x) ? PyFloat_AS_DOUBLE(x) : PyFloat_AsDouble(x))
#else
#define __pyx_PyFloat_AsDouble(x) PyFloat_AsDouble(x)
#endif
#define __pyx_PyFloat_AsFloat(x) ((float) __pyx_PyFloat_AsDouble(x))
#if PY_MAJOR_VERSION < 3 && __PYX_DEFAULT_STRING_ENCODING_IS_ASCII
static int __Pyx_sys_getdefaultencoding_not_ascii;
static int __Pyx_init_sys_getdefaultencoding_params(void) {
    PyObject* sys;
    PyObject* default_encoding = NULL;
    PyObject* ascii_chars_u = NULL;
    PyObject* ascii_chars_b = NULL;
    const char* default_encoding_c;
    sys = PyImport_ImportModule("sys");
    if (!sys) goto bad;
    default_encoding = PyObject_CallMethod(sys, (char*) "getdefaultencoding", NULL);
    Py_DECREF(sys);
    if (!default_encoding) goto bad;
    default_encoding_c = PyBytes_AsString(default_encoding);
    if (!default_encoding_c) goto bad;
    if (strcmp(default_encoding_c, "ascii") == 0) {
        __Pyx_sys_getdefaultencoding_not_ascii = 0;
    } else {
        char ascii_chars[128];
        int c;
        for (c = 0; c < 128; c++) {
            ascii_chars[c] = c;
        }
        __Pyx_sys_getdefaultencoding_not_ascii = 1;
        ascii_chars_u = PyUnicode_DecodeASCII(ascii_chars, 128, NULL);
        if (!ascii_chars_u) goto bad;
        ascii_chars_b = PyUnicode_AsEncodedString(ascii_chars_u, default_encoding_c, NULL);
        if (!ascii_chars_b || !PyBytes_Check(ascii_chars_b) || memcmp(ascii_chars, PyBytes_AS_STRING(ascii_chars_b), 128) != 0) {
            PyErr_Format(
                PyExc_ValueError,
                "This module compiled with c_string_encoding=ascii, but default encoding '%.200s' is not a superset of ascii.",
                default_encoding_c);
            goto bad;
        }
        Py_DECREF(ascii_chars_u);
        Py_DECREF(ascii_chars_b);
    }
    Py_DECREF(default_encoding);
    return 0;
bad:
    Py_XDECREF(default_encoding);
    Py_XDECREF(ascii_chars_u);
    Py_XDECREF(ascii_chars_b);
    return -1;
}
#endif
#if __PYX_DEFAULT_STRING_ENCODING_IS_DEFAULT && PY_MAJOR_VERSION >= 3
#define __Pyx_PyUnicode_FromStringAndSize(c_str, size) PyUnicode_DecodeUTF8(c_str, size, NULL)
#else
#define __Pyx_PyUnicode_FromStringAndSize(c_str, size) PyUnicode_Decode(c_str, size, __PYX_DEFAULT_STRING_ENCODING, NULL)
#if __PYX_DEFAULT_STRING_ENCODING_IS_DEFAULT
static char* __PYX_DEFAULT_STRING_ENCODING;
static int __Pyx_init_sys_getdefaultencoding_params(void) {
    PyObject* sys;
    PyObject* default_encoding = NULL;
    char* default_encoding_c;
    sys = PyImport_ImportModule("sys");
    if (!sys) goto bad;
    default_encoding = PyObject_CallMethod(sys, (char*) (const char*) "getdefaultencoding", NULL);
    Py_DECREF(sys);
    if (!default_encoding) goto bad;
    default_encoding_c = PyBytes_AsString(default_encoding);
    if (!default_encoding_c) goto bad;
    __PYX_DEFAULT_STRING_ENCODING = (char*) malloc(strlen(default_encoding_c));
    if (!__PYX_DEFAULT_STRING_ENCODING) goto bad;
    strcpy(__PYX_DEFAULT_STRING_ENCODING, default_encoding_c);
    Py_DECREF(default_encoding);
    return 0;
bad:
    Py_XDECREF(default_encoding);
    return -1;
}
#endif
#endif


/* Test for GCC > 2.95 */
#if defined(__GNUC__)     && (__GNUC__ > 2 || (__GNUC__ == 2 && (__GNUC_MINOR__ > 95)))
  #define likely(x)   __builtin_expect(!!(x), 1)
  #define unlikely(x) __builtin_expect(!!(x), 0)
#else /* !__GNUC__ or GCC < 2.95 */
  #define likely(x)   (x)
  #define unlikely(x) (x)
#endif /* __GNUC__ */

static PyObject *__pyx_m;
static PyObject *__pyx_d;
static PyObject *__pyx_b;
static PyObject *__pyx_empty_tuple;
static PyObject *__pyx_empty_bytes;
static int __pyx_lineno;
static int __pyx_clineno = 0;
static const char * __pyx_cfilenm= __FILE__;
static const char *__pyx_filename;


static const char *__pyx_f[] = {
  "thinc/linalg.pxd",
  "thinc/linalg.pyx",
  ".env/lib/python2.7/site-packages/cymem/cymem.pxd",
};

/* "thinc/linalg.pxd":9
 * from cymem.cymem cimport Pool
 * 
 * ctypedef float weight_t             # <<<<<<<<<<<<<<
 * 
 * include "compile_time_constants.pxi"
 */
typedef float __pyx_t_5thinc_6linalg_weight_t;

/*--- Type declarations ---*/
struct __pyx_obj_5cymem_5cymem_Pool;
struct __pyx_obj_5cymem_5cymem_Address;
struct __pyx_obj_5thinc_6linalg_Matrix;
struct __pyx_obj_5thinc_6linalg_Vec;
struct __pyx_obj_5thinc_6linalg_VecVec;
struct __pyx_obj_5thinc_6linalg_MatVec;
struct __pyx_obj_5thinc_6linalg_MatMat;

/* "cymem/cymem.pxd":1
 * cdef class Pool:             # <<<<<<<<<<<<<<
 *     cdef readonly size_t size
 *     cdef readonly dict addresses
 */
struct __pyx_obj_5cymem_5cymem_Pool {
  PyObject_HEAD
  struct __pyx_vtabstruct_5cymem_5cymem_Pool *__pyx_vtab;
  size_t size;
  PyObject *addresses;
  PyObject *refs;
};


/* "cymem/cymem.pxd":11
 * 
 * 
 * cdef class Address:             # <<<<<<<<<<<<<<
 *     cdef void* ptr
 */
struct __pyx_obj_5cymem_5cymem_Address {
  PyObject_HEAD
  void *ptr;
};


/* "thinc/linalg.pxd":54
 * 
 * 
 * cdef class Matrix:             # <<<<<<<<<<<<<<
 *     cdef readonly Pool mem
 *     cdef weight_t* data
 */
struct __pyx_obj_5thinc_6linalg_Matrix {
  PyObject_HEAD
  struct __pyx_obj_5cymem_5cymem_Pool *mem;
  __pyx_t_5thinc_6linalg_weight_t *data;
  int32_t nr_row;
  int32_t nr_col;
};


/* "thinc/linalg.pxd":61
 * 
 * 
 * cdef class Vec:             # <<<<<<<<<<<<<<
 *     @staticmethod
 *     cdef inline int arg_max(const weight_t* scores, const int n_classes) nogil:
 */
struct __pyx_obj_5thinc_6linalg_Vec {
  PyObject_HEAD
  struct __pyx_vtabstruct_5thinc_6linalg_Vec *__pyx_vtab;
};


/* "thinc/linalg.pxd":163
 * 
 * 
 * cdef class VecVec:             # <<<<<<<<<<<<<<
 *     @staticmethod
 *     cdef inline void add(weight_t* output,
 */
struct __pyx_obj_5thinc_6linalg_VecVec {
  PyObject_HEAD
  struct __pyx_vtabstruct_5thinc_6linalg_VecVec *__pyx_vtab;
};


/* "thinc/linalg.pxd":247
 * 
 * 
 * cdef class MatVec:             # <<<<<<<<<<<<<<
 *     @staticmethod
 *     cdef inline void mul(weight_t* output,
 */
struct __pyx_obj_5thinc_6linalg_MatVec {
  PyObject_HEAD
  struct __pyx_vtabstruct_5thinc_6linalg_MatVec *__pyx_vtab;
};


/* "thinc/linalg.pxd":322
 * 
 * 
 * cdef class MatMat:             # <<<<<<<<<<<<<<
 *     @staticmethod
 *     cdef inline void add(weight_t* output,
 */
struct __pyx_obj_5thinc_6linalg_MatMat {
  PyObject_HEAD
  struct __pyx_vtabstruct_5thinc_6linalg_MatMat *__pyx_vtab;
};



/* "cymem/cymem.pxd":1
 * cdef class Pool:             # <<<<<<<<<<<<<<
 *     cdef readonly size_t size
 *     cdef readonly dict addresses
 */

struct __pyx_vtabstruct_5cymem_5cymem_Pool {
  void *(*alloc)(struct __pyx_obj_5cymem_5cymem_Pool *, size_t, size_t);
  void (*free)(struct __pyx_obj_5cymem_5cymem_Pool *, void *);
  void *(*realloc)(struct __pyx_obj_5cymem_5cymem_Pool *, void *, size_t);
};
static struct __pyx_vtabstruct_5cymem_5cymem_Pool *__pyx_vtabptr_5cymem_5cymem_Pool;


/* "thinc/linalg.pxd":61
 * 
 * 
 * cdef class Vec:             # <<<<<<<<<<<<<<
 *     @staticmethod
 *     cdef inline int arg_max(const weight_t* scores, const int n_classes) nogil:
 */

struct __pyx_vtabstruct_5thinc_6linalg_Vec {
  int (*arg_max)(__pyx_t_5thinc_6linalg_weight_t const *, int const );
  __pyx_t_5thinc_6linalg_weight_t (*max)(__pyx_t_5thinc_6linalg_weight_t const *, int32_t);
  __pyx_t_5thinc_6linalg_weight_t (*sum)(__pyx_t_5thinc_6linalg_weight_t const *, int32_t);
  void (*add)(__pyx_t_5thinc_6linalg_weight_t *, __pyx_t_5thinc_6linalg_weight_t const *, __pyx_t_5thinc_6linalg_weight_t, int32_t);
  void (*add_i)(__pyx_t_5thinc_6linalg_weight_t *, __pyx_t_5thinc_6linalg_weight_t, int32_t);
  void (*mul)(__pyx_t_5thinc_6linalg_weight_t *, __pyx_t_5thinc_6linalg_weight_t const *, __pyx_t_5thinc_6linalg_weight_t, int32_t);
  void (*mul_i)(__pyx_t_5thinc_6linalg_weight_t *, __pyx_t_5thinc_6linalg_weight_t const , int32_t);
  void (*pow)(__pyx_t_5thinc_6linalg_weight_t *, __pyx_t_5thinc_6linalg_weight_t const *, __pyx_t_5thinc_6linalg_weight_t, int32_t);
  void (*pow_i)(__pyx_t_5thinc_6linalg_weight_t *, __pyx_t_5thinc_6linalg_weight_t const , int32_t);
  void (*div)(__pyx_t_5thinc_6linalg_weight_t *, __pyx_t_5thinc_6linalg_weight_t const *, __pyx_t_5thinc_6linalg_weight_t, int32_t);
  void (*div_i)(__pyx_t_5thinc_6linalg_weight_t *, __pyx_t_5thinc_6linalg_weight_t const , int32_t);
  void (*exp)(__pyx_t_5thinc_6linalg_weight_t *, __pyx_t_5thinc_6linalg_weight_t const *, int32_t);
  void (*exp_i)(__pyx_t_5thinc_6linalg_weight_t *, int32_t);
  void (*reciprocal_i)(__pyx_t_5thinc_6linalg_weight_t *, int32_t);
};
static struct __pyx_vtabstruct_5thinc_6linalg_Vec *__pyx_vtabptr_5thinc_6linalg_Vec;
static CYTHON_INLINE int __pyx_f_5thinc_6linalg_3Vec_arg_max(__pyx_t_5thinc_6linalg_weight_t const *, int const );
static CYTHON_INLINE __pyx_t_5thinc_6linalg_weight_t __pyx_f_5thinc_6linalg_3Vec_max(__pyx_t_5thinc_6linalg_weight_t const *, int32_t);
static CYTHON_INLINE __pyx_t_5thinc_6linalg_weight_t __pyx_f_5thinc_6linalg_3Vec_sum(__pyx_t_5thinc_6linalg_weight_t const *, int32_t);
static CYTHON_INLINE void __pyx_f_5thinc_6linalg_3Vec_add(__pyx_t_5thinc_6linalg_weight_t *, __pyx_t_5thinc_6linalg_weight_t const *, __pyx_t_5thinc_6linalg_weight_t, int32_t);
static CYTHON_INLINE void __pyx_f_5thinc_6linalg_3Vec_add_i(__pyx_t_5thinc_6linalg_weight_t *, __pyx_t_5thinc_6linalg_weight_t, int32_t);
static CYTHON_INLINE void __pyx_f_5thinc_6linalg_3Vec_mul(__pyx_t_5thinc_6linalg_weight_t *, __pyx_t_5thinc_6linalg_weight_t const *, __pyx_t_5thinc_6linalg_weight_t, int32_t);
static CYTHON_INLINE void __pyx_f_5thinc_6linalg_3Vec_mul_i(__pyx_t_5thinc_6linalg_weight_t *, __pyx_t_5thinc_6linalg_weight_t const , int32_t);
static CYTHON_INLINE void __pyx_f_5thinc_6linalg_3Vec_pow(__pyx_t_5thinc_6linalg_weight_t *, __pyx_t_5thinc_6linalg_weight_t const *, __pyx_t_5thinc_6linalg_weight_t, int32_t);
static CYTHON_INLINE void __pyx_f_5thinc_6linalg_3Vec_pow_i(__pyx_t_5thinc_6linalg_weight_t *, __pyx_t_5thinc_6linalg_weight_t const , int32_t);
static CYTHON_INLINE void __pyx_f_5thinc_6linalg_3Vec_div(__pyx_t_5thinc_6linalg_weight_t *, __pyx_t_5thinc_6linalg_weight_t const *, __pyx_t_5thinc_6linalg_weight_t, int32_t);
static CYTHON_INLINE void __pyx_f_5thinc_6linalg_3Vec_div_i(__pyx_t_5thinc_6linalg_weight_t *, __pyx_t_5thinc_6linalg_weight_t const , int32_t);
static CYTHON_INLINE void __pyx_f_5thinc_6linalg_3Vec_exp(__pyx_t_5thinc_6linalg_weight_t *, __pyx_t_5thinc_6linalg_weight_t const *, int32_t);
static CYTHON_INLINE void __pyx_f_5thinc_6linalg_3Vec_exp_i(__pyx_t_5thinc_6linalg_weight_t *, int32_t);
static CYTHON_INLINE void __pyx_f_5thinc_6linalg_3Vec_reciprocal_i(__pyx_t_5thinc_6linalg_weight_t *, int32_t);


/* "thinc/linalg.pxd":163
 * 
 * 
 * cdef class VecVec:             # <<<<<<<<<<<<<<
 *     @staticmethod
 *     cdef inline void add(weight_t* output,
 */

struct __pyx_vtabstruct_5thinc_6linalg_VecVec {
  void (*add)(__pyx_t_5thinc_6linalg_weight_t *, __pyx_t_5thinc_6linalg_weight_t const *, __pyx_t_5thinc_6linalg_weight_t const *, __pyx_t_5thinc_6linalg_weight_t, int32_t);
  void (*add_i)(float *, float const *, float, int32_t);
  void (*add_pow)(__pyx_t_5thinc_6linalg_weight_t *, __pyx_t_5thinc_6linalg_weight_t const *, __pyx_t_5thinc_6linalg_weight_t const *, __pyx_t_5thinc_6linalg_weight_t, int32_t);
  void (*add_pow_i)(__pyx_t_5thinc_6linalg_weight_t *, __pyx_t_5thinc_6linalg_weight_t const *, __pyx_t_5thinc_6linalg_weight_t, int32_t);
  void (*mul)(__pyx_t_5thinc_6linalg_weight_t *, __pyx_t_5thinc_6linalg_weight_t const *, __pyx_t_5thinc_6linalg_weight_t const *, int32_t);
  void (*mul_i)(__pyx_t_5thinc_6linalg_weight_t *, __pyx_t_5thinc_6linalg_weight_t const *, int32_t);
  __pyx_t_5thinc_6linalg_weight_t (*dot)(__pyx_t_5thinc_6linalg_weight_t const *, __pyx_t_5thinc_6linalg_weight_t const *, int32_t);
  int (*arg_max_if_true)(__pyx_t_5thinc_6linalg_weight_t const *, int const *, int const );
  int (*arg_max_if_zero)(__pyx_t_5thinc_6linalg_weight_t const *, __pyx_t_5thinc_6linalg_weight_t const *, int const );
};
static struct __pyx_vtabstruct_5thinc_6linalg_VecVec *__pyx_vtabptr_5thinc_6linalg_VecVec;
static CYTHON_INLINE void __pyx_f_5thinc_6linalg_6VecVec_add(__pyx_t_5thinc_6linalg_weight_t *, __pyx_t_5thinc_6linalg_weight_t const *, __pyx_t_5thinc_6linalg_weight_t const *, __pyx_t_5thinc_6linalg_weight_t, int32_t);
static CYTHON_INLINE void __pyx_f_5thinc_6linalg_6VecVec_add_i(float *, float const *, float, int32_t);
static CYTHON_INLINE void __pyx_f_5thinc_6linalg_6VecVec_add_pow(__pyx_t_5thinc_6linalg_weight_t *, __pyx_t_5thinc_6linalg_weight_t const *, __pyx_t_5thinc_6linalg_weight_t const *, __pyx_t_5thinc_6linalg_weight_t, int32_t);
static CYTHON_INLINE void __pyx_f_5thinc_6linalg_6VecVec_add_pow_i(__pyx_t_5thinc_6linalg_weight_t *, __pyx_t_5thinc_6linalg_weight_t const *, __pyx_t_5thinc_6linalg_weight_t, int32_t);
static CYTHON_INLINE void __pyx_f_5thinc_6linalg_6VecVec_mul(__pyx_t_5thinc_6linalg_weight_t *, __pyx_t_5thinc_6linalg_weight_t const *, __pyx_t_5thinc_6linalg_weight_t const *, int32_t);
static CYTHON_INLINE void __pyx_f_5thinc_6linalg_6VecVec_mul_i(__pyx_t_5thinc_6linalg_weight_t *, __pyx_t_5thinc_6linalg_weight_t const *, int32_t);
static CYTHON_INLINE __pyx_t_5thinc_6linalg_weight_t __pyx_f_5thinc_6linalg_6VecVec_dot(__pyx_t_5thinc_6linalg_weight_t const *, __pyx_t_5thinc_6linalg_weight_t const *, int32_t);
static CYTHON_INLINE int __pyx_f_5thinc_6linalg_6VecVec_arg_max_if_true(__pyx_t_5thinc_6linalg_weight_t const *, int const *, int const );
static CYTHON_INLINE int __pyx_f_5thinc_6linalg_6VecVec_arg_max_if_zero(__pyx_t_5thinc_6linalg_weight_t const *, __pyx_t_5thinc_6linalg_weight_t const *, int const );


/* "thinc/linalg.pxd":247
 * 
 * 
 * cdef class MatVec:             # <<<<<<<<<<<<<<
 *     @staticmethod
 *     cdef inline void mul(weight_t* output,
 */

struct __pyx_vtabstruct_5thinc_6linalg_MatVec {
  void (*mul)(__pyx_t_5thinc_6linalg_weight_t *, __pyx_t_5thinc_6linalg_weight_t const *, __pyx_t_5thinc_6linalg_weight_t const *, int32_t, int32_t);
  void (*mul_i)(__pyx_t_5thinc_6linalg_weight_t *, __pyx_t_5thinc_6linalg_weight_t const *, int32_t, int32_t);
  void (*dot)(__pyx_t_5thinc_6linalg_weight_t *, __pyx_t_5thinc_6linalg_weight_t const *, __pyx_t_5thinc_6linalg_weight_t const *, int32_t, int32_t);
  void (*T_dot)(__pyx_t_5thinc_6linalg_weight_t *, __pyx_t_5thinc_6linalg_weight_t const *, __pyx_t_5thinc_6linalg_weight_t const *, int32_t, int32_t);
};
static struct __pyx_vtabstruct_5thinc_6linalg_MatVec *__pyx_vtabptr_5thinc_6linalg_MatVec;
static CYTHON_INLINE void __pyx_f_5thinc_6linalg_6MatVec_mul(__pyx_t_5thinc_6linalg_weight_t *, __pyx_t_5thinc_6linalg_weight_t const *, __pyx_t_5thinc_6linalg_weight_t const *, int32_t, int32_t);
static CYTHON_INLINE void __pyx_f_5thinc_6linalg_6MatVec_mul_i(__pyx_t_5thinc_6linalg_weight_t *, __pyx_t_5thinc_6linalg_weight_t const *, int32_t, int32_t);
static CYTHON_INLINE void __pyx_f_5thinc_6linalg_6MatVec_dot(__pyx_t_5thinc_6linalg_weight_t *, __pyx_t_5thinc_6linalg_weight_t const *, __pyx_t_5thinc_6linalg_weight_t const *, int32_t, int32_t);
static CYTHON_INLINE void __pyx_f_5thinc_6linalg_6MatVec_T_dot(__pyx_t_5thinc_6linalg_weight_t *, __pyx_t_5thinc_6linalg_weight_t const *, __pyx_t_5thinc_6linalg_weight_t const *, int32_t, int32_t);


/* "thinc/linalg.pxd":322
 * 
 * 
 * cdef class MatMat:             # <<<<<<<<<<<<<<
 *     @staticmethod
 *     cdef inline void add(weight_t* output,
 */

struct __pyx_vtabstruct_5thinc_6linalg_MatMat {
  void (*add)(__pyx_t_5thinc_6linalg_weight_t *, __pyx_t_5thinc_6linalg_weight_t const *, __pyx_t_5thinc_6linalg_weight_t const *, int32_t, int32_t);
  void (*add_i)(__pyx_t_5thinc_6linalg_weight_t *, __pyx_t_5thinc_6linalg_weight_t const *, int32_t, int32_t);
  void (*mul)(__pyx_t_5thinc_6linalg_weight_t *, __pyx_t_5thinc_6linalg_weight_t const *, __pyx_t_5thinc_6linalg_weight_t const *, int32_t, int32_t);
  void (*mul_i)(__pyx_t_5thinc_6linalg_weight_t *, __pyx_t_5thinc_6linalg_weight_t const *, int32_t, int32_t);
  void (*add_outer_i)(__pyx_t_5thinc_6linalg_weight_t *, __pyx_t_5thinc_6linalg_weight_t const *, __pyx_t_5thinc_6linalg_weight_t const *, int32_t, int32_t);
};
static struct __pyx_vtabstruct_5thinc_6linalg_MatMat *__pyx_vtabptr_5thinc_6linalg_MatMat;
static CYTHON_INLINE void __pyx_f_5thinc_6linalg_6MatMat_add(__pyx_t_5thinc_6linalg_weight_t *, __pyx_t_5thinc_6linalg_weight_t const *, __pyx_t_5thinc_6linalg_weight_t const *, int32_t, int32_t);
static CYTHON_INLINE void __pyx_f_5thinc_6linalg_6MatMat_add_i(__pyx_t_5thinc_6linalg_weight_t *, __pyx_t_5thinc_6linalg_weight_t const *, int32_t, int32_t);
static CYTHON_INLINE void __pyx_f_5thinc_6linalg_6MatMat_mul(__pyx_t_5thinc_6linalg_weight_t *, __pyx_t_5thinc_6linalg_weight_t const *, __pyx_t_5thinc_6linalg_weight_t const *, int32_t, int32_t);
static CYTHON_INLINE void __pyx_f_5thinc_6linalg_6MatMat_mul_i(__pyx_t_5thinc_6linalg_weight_t *, __pyx_t_5thinc_6linalg_weight_t const *, int32_t, int32_t);
static CYTHON_INLINE void __pyx_f_5thinc_6linalg_6MatMat_add_outer_i(__pyx_t_5thinc_6linalg_weight_t *, __pyx_t_5thinc_6linalg_weight_t const *, __pyx_t_5thinc_6linalg_weight_t const *, int32_t, int32_t);

/* --- Runtime support code (head) --- */
#ifndef CYTHON_REFNANNY
  #define CYTHON_REFNANNY 0
#endif
#if CYTHON_REFNANNY
  typedef struct {
    void (*INCREF)(void*, PyObject*, int);
    void (*DECREF)(void*, PyObject*, int);
    void (*GOTREF)(void*, PyObject*, int);
    void (*GIVEREF)(void*, PyObject*, int);
    void* (*SetupContext)(const char*, int, const char*);
    void (*FinishContext)(void**);
  } __Pyx_RefNannyAPIStruct;
  static __Pyx_RefNannyAPIStruct *__Pyx_RefNanny = NULL;
  static __Pyx_RefNannyAPIStruct *__Pyx_RefNannyImportAPI(const char *modname);
  #define __Pyx_RefNannyDeclarations void *__pyx_refnanny = NULL;
#ifdef WITH_THREAD
  #define __Pyx_RefNannySetupContext(name, acquire_gil)\
          if (acquire_gil) {\
              PyGILState_STATE __pyx_gilstate_save = PyGILState_Ensure();\
              __pyx_refnanny = __Pyx_RefNanny->SetupContext((name), __LINE__, __FILE__);\
              PyGILState_Release(__pyx_gilstate_save);\
          } else {\
              __pyx_refnanny = __Pyx_RefNanny->SetupContext((name), __LINE__, __FILE__);\
          }
#else
  #define __Pyx_RefNannySetupContext(name, acquire_gil)\
          __pyx_refnanny = __Pyx_RefNanny->SetupContext((name), __LINE__, __FILE__)
#endif
  #define __Pyx_RefNannyFinishContext()\
          __Pyx_RefNanny->FinishContext(&__pyx_refnanny)
  #define __Pyx_INCREF(r)  __Pyx_RefNanny->INCREF(__pyx_refnanny, (PyObject *)(r), __LINE__)
  #define __Pyx_DECREF(r)  __Pyx_RefNanny->DECREF(__pyx_refnanny, (PyObject *)(r), __LINE__)
  #define __Pyx_GOTREF(r)  __Pyx_RefNanny->GOTREF(__pyx_refnanny, (PyObject *)(r), __LINE__)
  #define __Pyx_GIVEREF(r) __Pyx_RefNanny->GIVEREF(__pyx_refnanny, (PyObject *)(r), __LINE__)
  #define __Pyx_XINCREF(r)  do { if((r) != NULL) {__Pyx_INCREF(r); }} while(0)
  #define __Pyx_XDECREF(r)  do { if((r) != NULL) {__Pyx_DECREF(r); }} while(0)
  #define __Pyx_XGOTREF(r)  do { if((r) != NULL) {__Pyx_GOTREF(r); }} while(0)
  #define __Pyx_XGIVEREF(r) do { if((r) != NULL) {__Pyx_GIVEREF(r);}} while(0)
#else
  #define __Pyx_RefNannyDeclarations
  #define __Pyx_RefNannySetupContext(name, acquire_gil)
  #define __Pyx_RefNannyFinishContext()
  #define __Pyx_INCREF(r) Py_INCREF(r)
  #define __Pyx_DECREF(r) Py_DECREF(r)
  #define __Pyx_GOTREF(r)
  #define __Pyx_GIVEREF(r)
  #define __Pyx_XINCREF(r) Py_XINCREF(r)
  #define __Pyx_XDECREF(r) Py_XDECREF(r)
  #define __Pyx_XGOTREF(r)
  #define __Pyx_XGIVEREF(r)
#endif
#define __Pyx_XDECREF_SET(r, v) do {\
        PyObject *tmp = (PyObject *) r;\
        r = v; __Pyx_XDECREF(tmp);\
    } while (0)
#define __Pyx_DECREF_SET(r, v) do {\
        PyObject *tmp = (PyObject *) r;\
        r = v; __Pyx_DECREF(tmp);\
    } while (0)
#define __Pyx_CLEAR(r)    do { PyObject* tmp = ((PyObject*)(r)); r = NULL; __Pyx_DECREF(tmp);} while(0)
#define __Pyx_XCLEAR(r)   do { if((r) != NULL) {PyObject* tmp = ((PyObject*)(r)); r = NULL; __Pyx_DECREF(tmp);}} while(0)

#if CYTHON_COMPILING_IN_CPYTHON
static CYTHON_INLINE PyObject* __Pyx_PyObject_GetAttrStr(PyObject* obj, PyObject* attr_name) {
    PyTypeObject* tp = Py_TYPE(obj);
    if (likely(tp->tp_getattro))
        return tp->tp_getattro(obj, attr_name);
#if PY_MAJOR_VERSION < 3
    if (likely(tp->tp_getattr))
        return tp->tp_getattr(obj, PyString_AS_STRING(attr_name));
#endif
    return PyObject_GetAttr(obj, attr_name);
}
#else
#define __Pyx_PyObject_GetAttrStr(o,n) PyObject_GetAttr(o,n)
#endif

static PyObject *__Pyx_GetBuiltinName(PyObject *name);

static int __Pyx_SetVtable(PyObject *dict, void *vtable);

static void* __Pyx_GetVtable(PyObject *dict);

typedef struct {
    int code_line;
    PyCodeObject* code_object;
} __Pyx_CodeObjectCacheEntry;
struct __Pyx_CodeObjectCache {
    int count;
    int max_count;
    __Pyx_CodeObjectCacheEntry* entries;
};
static struct __Pyx_CodeObjectCache __pyx_code_cache = {0,0,NULL};
static int __pyx_bisect_code_objects(__Pyx_CodeObjectCacheEntry* entries, int count, int code_line);
static PyCodeObject *__pyx_find_code_object(int code_line);
static void __pyx_insert_code_object(int code_line, PyCodeObject* code_object);

static void __Pyx_AddTraceback(const char *funcname, int c_line,
                               int py_line, const char *filename);

static CYTHON_INLINE PyObject* __Pyx_PyInt_From_int(int value);

static CYTHON_INLINE int __Pyx_PyInt_As_int(PyObject *);

static CYTHON_INLINE PyObject* __Pyx_PyInt_From_int32_t(int32_t value);

static CYTHON_INLINE PyObject* __Pyx_PyInt_From_long(long value);

static CYTHON_INLINE long __Pyx_PyInt_As_long(PyObject *);

static int __Pyx_check_binary_version(void);

#if !defined(__Pyx_PyIdentifier_FromString)
#if PY_MAJOR_VERSION < 3
  #define __Pyx_PyIdentifier_FromString(s) PyString_FromString(s)
#else
  #define __Pyx_PyIdentifier_FromString(s) PyUnicode_FromString(s)
#endif
#endif

static PyObject *__Pyx_ImportModule(const char *name);

static PyTypeObject *__Pyx_ImportType(const char *module_name, const char *class_name, size_t size, int strict);

static int __Pyx_InitStrings(__Pyx_StringTabEntry *t);

static CYTHON_INLINE int __pyx_f_5thinc_6linalg_3Vec_arg_max(__pyx_t_5thinc_6linalg_weight_t const *__pyx_v_scores, int const __pyx_v_n_classes); /* proto*/
static CYTHON_INLINE __pyx_t_5thinc_6linalg_weight_t __pyx_f_5thinc_6linalg_3Vec_max(__pyx_t_5thinc_6linalg_weight_t const *__pyx_v_x, int32_t __pyx_v_nr); /* proto*/
static CYTHON_INLINE __pyx_t_5thinc_6linalg_weight_t __pyx_f_5thinc_6linalg_3Vec_sum(__pyx_t_5thinc_6linalg_weight_t const *__pyx_v_vec, int32_t __pyx_v_nr); /* proto*/
static CYTHON_INLINE void __pyx_f_5thinc_6linalg_3Vec_add(__pyx_t_5thinc_6linalg_weight_t *__pyx_v_output, __pyx_t_5thinc_6linalg_weight_t const *__pyx_v_x, __pyx_t_5thinc_6linalg_weight_t __pyx_v_inc, int32_t __pyx_v_nr); /* proto*/
static CYTHON_INLINE void __pyx_f_5thinc_6linalg_3Vec_add_i(__pyx_t_5thinc_6linalg_weight_t *__pyx_v_vec, __pyx_t_5thinc_6linalg_weight_t __pyx_v_inc, int32_t __pyx_v_nr); /* proto*/
static CYTHON_INLINE void __pyx_f_5thinc_6linalg_3Vec_mul(__pyx_t_5thinc_6linalg_weight_t *__pyx_v_output, __pyx_t_5thinc_6linalg_weight_t const *__pyx_v_vec, __pyx_t_5thinc_6linalg_weight_t __pyx_v_scal, int32_t __pyx_v_nr); /* proto*/
static CYTHON_INLINE void __pyx_f_5thinc_6linalg_3Vec_mul_i(__pyx_t_5thinc_6linalg_weight_t *__pyx_v_vec, __pyx_t_5thinc_6linalg_weight_t const __pyx_v_scal, int32_t __pyx_v_nr); /* proto*/
static CYTHON_INLINE void __pyx_f_5thinc_6linalg_3Vec_pow(__pyx_t_5thinc_6linalg_weight_t *__pyx_v_output, __pyx_t_5thinc_6linalg_weight_t const *__pyx_v_vec, __pyx_t_5thinc_6linalg_weight_t __pyx_v_scal, int32_t __pyx_v_nr); /* proto*/
static CYTHON_INLINE void __pyx_f_5thinc_6linalg_3Vec_pow_i(__pyx_t_5thinc_6linalg_weight_t *__pyx_v_vec, __pyx_t_5thinc_6linalg_weight_t const __pyx_v_scal, int32_t __pyx_v_nr); /* proto*/
static CYTHON_INLINE void __pyx_f_5thinc_6linalg_3Vec_div(__pyx_t_5thinc_6linalg_weight_t *__pyx_v_output, __pyx_t_5thinc_6linalg_weight_t const *__pyx_v_vec, __pyx_t_5thinc_6linalg_weight_t __pyx_v_scal, int32_t __pyx_v_nr); /* proto*/
static CYTHON_INLINE void __pyx_f_5thinc_6linalg_3Vec_div_i(__pyx_t_5thinc_6linalg_weight_t *__pyx_v_vec, __pyx_t_5thinc_6linalg_weight_t const __pyx_v_scal, int32_t __pyx_v_nr); /* proto*/
static CYTHON_INLINE void __pyx_f_5thinc_6linalg_3Vec_exp(__pyx_t_5thinc_6linalg_weight_t *__pyx_v_output, __pyx_t_5thinc_6linalg_weight_t const *__pyx_v_vec, int32_t __pyx_v_nr); /* proto*/
static CYTHON_INLINE void __pyx_f_5thinc_6linalg_3Vec_exp_i(__pyx_t_5thinc_6linalg_weight_t *__pyx_v_vec, int32_t __pyx_v_nr); /* proto*/
static CYTHON_INLINE void __pyx_f_5thinc_6linalg_3Vec_reciprocal_i(__pyx_t_5thinc_6linalg_weight_t *__pyx_v_vec, int32_t __pyx_v_nr); /* proto*/
static CYTHON_INLINE void __pyx_f_5thinc_6linalg_6VecVec_add(__pyx_t_5thinc_6linalg_weight_t *__pyx_v_output, __pyx_t_5thinc_6linalg_weight_t const *__pyx_v_x, __pyx_t_5thinc_6linalg_weight_t const *__pyx_v_y, __pyx_t_5thinc_6linalg_weight_t __pyx_v_scale, int32_t __pyx_v_nr); /* proto*/
static CYTHON_INLINE void __pyx_f_5thinc_6linalg_6VecVec_add_i(float *__pyx_v_x, float const *__pyx_v_y, float __pyx_v_scale, int32_t __pyx_v_nr); /* proto*/
static CYTHON_INLINE void __pyx_f_5thinc_6linalg_6VecVec_add_pow(__pyx_t_5thinc_6linalg_weight_t *__pyx_v_output, __pyx_t_5thinc_6linalg_weight_t const *__pyx_v_x, __pyx_t_5thinc_6linalg_weight_t const *__pyx_v_y, __pyx_t_5thinc_6linalg_weight_t __pyx_v_power, int32_t __pyx_v_nr); /* proto*/
static CYTHON_INLINE void __pyx_f_5thinc_6linalg_6VecVec_add_pow_i(__pyx_t_5thinc_6linalg_weight_t *__pyx_v_x, __pyx_t_5thinc_6linalg_weight_t const *__pyx_v_y, __pyx_t_5thinc_6linalg_weight_t __pyx_v_power, int32_t __pyx_v_nr); /* proto*/
static CYTHON_INLINE void __pyx_f_5thinc_6linalg_6VecVec_mul(__pyx_t_5thinc_6linalg_weight_t *__pyx_v_output, __pyx_t_5thinc_6linalg_weight_t const *__pyx_v_x, __pyx_t_5thinc_6linalg_weight_t const *__pyx_v_y, int32_t __pyx_v_nr); /* proto*/
static CYTHON_INLINE void __pyx_f_5thinc_6linalg_6VecVec_mul_i(__pyx_t_5thinc_6linalg_weight_t *__pyx_v_x, __pyx_t_5thinc_6linalg_weight_t const *__pyx_v_y, int32_t __pyx_v_nr); /* proto*/
static CYTHON_INLINE __pyx_t_5thinc_6linalg_weight_t __pyx_f_5thinc_6linalg_6VecVec_dot(__pyx_t_5thinc_6linalg_weight_t const *__pyx_v_x, __pyx_t_5thinc_6linalg_weight_t const *__pyx_v_y, int32_t __pyx_v_nr); /* proto*/
static CYTHON_INLINE int __pyx_f_5thinc_6linalg_6VecVec_arg_max_if_true(__pyx_t_5thinc_6linalg_weight_t const *__pyx_v_scores, int const *__pyx_v_is_valid, int const __pyx_v_n_classes); /* proto*/
static CYTHON_INLINE int __pyx_f_5thinc_6linalg_6VecVec_arg_max_if_zero(__pyx_t_5thinc_6linalg_weight_t const *__pyx_v_scores, __pyx_t_5thinc_6linalg_weight_t const *__pyx_v_costs, int const __pyx_v_n_classes); /* proto*/
static CYTHON_INLINE void __pyx_f_5thinc_6linalg_6MatVec_mul(__pyx_t_5thinc_6linalg_weight_t *__pyx_v_output, __pyx_t_5thinc_6linalg_weight_t const *__pyx_v_mat, __pyx_t_5thinc_6linalg_weight_t const *__pyx_v_vec, int32_t __pyx_v_nr_row, int32_t __pyx_v_nr_col); /* proto*/
static CYTHON_INLINE void __pyx_f_5thinc_6linalg_6MatVec_mul_i(__pyx_t_5thinc_6linalg_weight_t *__pyx_v_mat, __pyx_t_5thinc_6linalg_weight_t const *__pyx_v_vec, int32_t __pyx_v_nr_row, int32_t __pyx_v_nr_col); /* proto*/
static CYTHON_INLINE void __pyx_f_5thinc_6linalg_6MatVec_dot(__pyx_t_5thinc_6linalg_weight_t *__pyx_v_output, __pyx_t_5thinc_6linalg_weight_t const *__pyx_v_mat, __pyx_t_5thinc_6linalg_weight_t const *__pyx_v_vec, int32_t __pyx_v_nr_row, int32_t __pyx_v_nr_col); /* proto*/
static CYTHON_INLINE void __pyx_f_5thinc_6linalg_6MatVec_T_dot(__pyx_t_5thinc_6linalg_weight_t *__pyx_v_output, __pyx_t_5thinc_6linalg_weight_t const *__pyx_v_mat, __pyx_t_5thinc_6linalg_weight_t const *__pyx_v_vec, int32_t __pyx_v_nr_row, int32_t __pyx_v_nr_col); /* proto*/
static CYTHON_INLINE void __pyx_f_5thinc_6linalg_6MatMat_add(__pyx_t_5thinc_6linalg_weight_t *__pyx_v_output, __pyx_t_5thinc_6linalg_weight_t const *__pyx_v_x, __pyx_t_5thinc_6linalg_weight_t const *__pyx_v_y, int32_t __pyx_v_nr_row, int32_t __pyx_v_nr_col); /* proto*/
static CYTHON_INLINE void __pyx_f_5thinc_6linalg_6MatMat_add_i(__pyx_t_5thinc_6linalg_weight_t *__pyx_v_x, __pyx_t_5thinc_6linalg_weight_t const *__pyx_v_y, int32_t __pyx_v_nr_row, int32_t __pyx_v_nr_col); /* proto*/
static CYTHON_INLINE void __pyx_f_5thinc_6linalg_6MatMat_mul(__pyx_t_5thinc_6linalg_weight_t *__pyx_v_output, __pyx_t_5thinc_6linalg_weight_t const *__pyx_v_x, __pyx_t_5thinc_6linalg_weight_t const *__pyx_v_y, int32_t __pyx_v_nr_row, int32_t __pyx_v_nr_col); /* proto*/
static CYTHON_INLINE void __pyx_f_5thinc_6linalg_6MatMat_mul_i(__pyx_t_5thinc_6linalg_weight_t *__pyx_v_x, __pyx_t_5thinc_6linalg_weight_t const *__pyx_v_y, int32_t __pyx_v_nr_row, int32_t __pyx_v_nr_col); /* proto*/
static CYTHON_INLINE void __pyx_f_5thinc_6linalg_6MatMat_add_outer_i(__pyx_t_5thinc_6linalg_weight_t *__pyx_v_mat, __pyx_t_5thinc_6linalg_weight_t const *__pyx_v_x, __pyx_t_5thinc_6linalg_weight_t const *__pyx_v_y, int32_t __pyx_v_nr_row, int32_t __pyx_v_nr_col); /* proto*/

/* Module declarations from 'cython' */

/* Module declarations from 'libc.stdint' */

/* Module declarations from 'libc.string' */

/* Module declarations from 'cymem.cymem' */
static PyTypeObject *__pyx_ptype_5cymem_5cymem_Pool = 0;
static PyTypeObject *__pyx_ptype_5cymem_5cymem_Address = 0;

/* Module declarations from 'thinc.linalg' */
static PyTypeObject *__pyx_ptype_5thinc_6linalg_Matrix = 0;
static PyTypeObject *__pyx_ptype_5thinc_6linalg_Vec = 0;
static PyTypeObject *__pyx_ptype_5thinc_6linalg_VecVec = 0;
static PyTypeObject *__pyx_ptype_5thinc_6linalg_MatVec = 0;
static PyTypeObject *__pyx_ptype_5thinc_6linalg_MatMat = 0;
#define __Pyx_MODULE_NAME "thinc.linalg"
int __pyx_module_is_main_thinc__linalg = 0;

/* Implementation of 'thinc.linalg' */
static PyObject *__pyx_builtin_range;
static char __pyx_k_main[] = "__main__";
static char __pyx_k_test[] = "__test__";
static char __pyx_k_range[] = "range";
static char __pyx_k_pyx_vtable[] = "__pyx_vtable__";
static PyObject *__pyx_n_s_main;
static PyObject *__pyx_n_s_pyx_vtable;
static PyObject *__pyx_n_s_range;
static PyObject *__pyx_n_s_test;
static PyObject *__pyx_tp_new_5thinc_6linalg_Matrix(PyTypeObject *t, PyObject *a, PyObject *k); /*proto*/
static PyObject *__pyx_tp_new_5thinc_6linalg_Vec(PyTypeObject *t, PyObject *a, PyObject *k); /*proto*/
static PyObject *__pyx_tp_new_5thinc_6linalg_VecVec(PyTypeObject *t, PyObject *a, PyObject *k); /*proto*/
static PyObject *__pyx_tp_new_5thinc_6linalg_MatVec(PyTypeObject *t, PyObject *a, PyObject *k); /*proto*/
static PyObject *__pyx_tp_new_5thinc_6linalg_MatMat(PyTypeObject *t, PyObject *a, PyObject *k); /*proto*/

/* "thinc/linalg.pxd":63
 * cdef class Vec:
 *     @staticmethod
 *     cdef inline int arg_max(const weight_t* scores, const int n_classes) nogil:             # <<<<<<<<<<<<<<
 *         cdef int i
 *         cdef int best = 0
 */

static CYTHON_INLINE int __pyx_f_5thinc_6linalg_3Vec_arg_max(__pyx_t_5thinc_6linalg_weight_t const *__pyx_v_scores, int const __pyx_v_n_classes) {
  int __pyx_v_i;
  int __pyx_v_best;
  __pyx_t_5thinc_6linalg_weight_t __pyx_v_mode;
  int __pyx_r;
  int __pyx_t_1;
  int __pyx_t_2;
  int __pyx_t_3;

  /* "thinc/linalg.pxd":65
 *     cdef inline int arg_max(const weight_t* scores, const int n_classes) nogil:
 *         cdef int i
 *         cdef int best = 0             # <<<<<<<<<<<<<<
 *         cdef weight_t mode = scores[0]
 *         for i in range(1, n_classes):
 */
  __pyx_v_best = 0;

  /* "thinc/linalg.pxd":66
 *         cdef int i
 *         cdef int best = 0
 *         cdef weight_t mode = scores[0]             # <<<<<<<<<<<<<<
 *         for i in range(1, n_classes):
 *             if scores[i] > mode:
 */
  __pyx_v_mode = (__pyx_v_scores[0]);

  /* "thinc/linalg.pxd":67
 *         cdef int best = 0
 *         cdef weight_t mode = scores[0]
 *         for i in range(1, n_classes):             # <<<<<<<<<<<<<<
 *             if scores[i] > mode:
 *                 mode = scores[i]
 */
  __pyx_t_1 = __pyx_v_n_classes;
  for (__pyx_t_2 = 1; __pyx_t_2 < __pyx_t_1; __pyx_t_2+=1) {
    __pyx_v_i = __pyx_t_2;

    /* "thinc/linalg.pxd":68
 *         cdef weight_t mode = scores[0]
 *         for i in range(1, n_classes):
 *             if scores[i] > mode:             # <<<<<<<<<<<<<<
 *                 mode = scores[i]
 *                 best = i
 */
    __pyx_t_3 = (((__pyx_v_scores[__pyx_v_i]) > __pyx_v_mode) != 0);
    if (__pyx_t_3) {

      /* "thinc/linalg.pxd":69
 *         for i in range(1, n_classes):
 *             if scores[i] > mode:
 *                 mode = scores[i]             # <<<<<<<<<<<<<<
 *                 best = i
 *         return best
 */
      __pyx_v_mode = (__pyx_v_scores[__pyx_v_i]);

      /* "thinc/linalg.pxd":70
 *             if scores[i] > mode:
 *                 mode = scores[i]
 *                 best = i             # <<<<<<<<<<<<<<
 *         return best
 * 
 */
      __pyx_v_best = __pyx_v_i;

      /* "thinc/linalg.pxd":68
 *         cdef weight_t mode = scores[0]
 *         for i in range(1, n_classes):
 *             if scores[i] > mode:             # <<<<<<<<<<<<<<
 *                 mode = scores[i]
 *                 best = i
 */
    }
  }

  /* "thinc/linalg.pxd":71
 *                 mode = scores[i]
 *                 best = i
 *         return best             # <<<<<<<<<<<<<<
 * 
 *     @staticmethod
 */
  __pyx_r = __pyx_v_best;
  goto __pyx_L0;

  /* "thinc/linalg.pxd":63
 * cdef class Vec:
 *     @staticmethod
 *     cdef inline int arg_max(const weight_t* scores, const int n_classes) nogil:             # <<<<<<<<<<<<<<
 *         cdef int i
 *         cdef int best = 0
 */

  /* function exit code */
  __pyx_L0:;
  return __pyx_r;
}

/* "thinc/linalg.pxd":74
 * 
 *     @staticmethod
 *     cdef inline weight_t max(const weight_t* x, int32_t nr) nogil:             # <<<<<<<<<<<<<<
 *         if nr == 0:
 *             return 0
 */

static CYTHON_INLINE __pyx_t_5thinc_6linalg_weight_t __pyx_f_5thinc_6linalg_3Vec_max(__pyx_t_5thinc_6linalg_weight_t const *__pyx_v_x, int32_t __pyx_v_nr) {
  int __pyx_v_i;
  __pyx_t_5thinc_6linalg_weight_t __pyx_v_mode;
  __pyx_t_5thinc_6linalg_weight_t __pyx_r;
  int __pyx_t_1;
  int32_t __pyx_t_2;
  int __pyx_t_3;

  /* "thinc/linalg.pxd":75
 *     @staticmethod
 *     cdef inline weight_t max(const weight_t* x, int32_t nr) nogil:
 *         if nr == 0:             # <<<<<<<<<<<<<<
 *             return 0
 *         cdef int i
 */
  __pyx_t_1 = ((__pyx_v_nr == 0) != 0);
  if (__pyx_t_1) {

    /* "thinc/linalg.pxd":76
 *     cdef inline weight_t max(const weight_t* x, int32_t nr) nogil:
 *         if nr == 0:
 *             return 0             # <<<<<<<<<<<<<<
 *         cdef int i
 *         cdef weight_t mode = x[0]
 */
    __pyx_r = 0.0;
    goto __pyx_L0;

    /* "thinc/linalg.pxd":75
 *     @staticmethod
 *     cdef inline weight_t max(const weight_t* x, int32_t nr) nogil:
 *         if nr == 0:             # <<<<<<<<<<<<<<
 *             return 0
 *         cdef int i
 */
  }

  /* "thinc/linalg.pxd":78
 *             return 0
 *         cdef int i
 *         cdef weight_t mode = x[0]             # <<<<<<<<<<<<<<
 *         for i in range(1, nr):
 *             if x[i] > mode:
 */
  __pyx_v_mode = (__pyx_v_x[0]);

  /* "thinc/linalg.pxd":79
 *         cdef int i
 *         cdef weight_t mode = x[0]
 *         for i in range(1, nr):             # <<<<<<<<<<<<<<
 *             if x[i] > mode:
 *                 mode = x[i]
 */
  __pyx_t_2 = __pyx_v_nr;
  for (__pyx_t_3 = 1; __pyx_t_3 < __pyx_t_2; __pyx_t_3+=1) {
    __pyx_v_i = __pyx_t_3;

    /* "thinc/linalg.pxd":80
 *         cdef weight_t mode = x[0]
 *         for i in range(1, nr):
 *             if x[i] > mode:             # <<<<<<<<<<<<<<
 *                 mode = x[i]
 *         return mode
 */
    __pyx_t_1 = (((__pyx_v_x[__pyx_v_i]) > __pyx_v_mode) != 0);
    if (__pyx_t_1) {

      /* "thinc/linalg.pxd":81
 *         for i in range(1, nr):
 *             if x[i] > mode:
 *                 mode = x[i]             # <<<<<<<<<<<<<<
 *         return mode
 * 
 */
      __pyx_v_mode = (__pyx_v_x[__pyx_v_i]);

      /* "thinc/linalg.pxd":80
 *         cdef weight_t mode = x[0]
 *         for i in range(1, nr):
 *             if x[i] > mode:             # <<<<<<<<<<<<<<
 *                 mode = x[i]
 *         return mode
 */
    }
  }

  /* "thinc/linalg.pxd":82
 *             if x[i] > mode:
 *                 mode = x[i]
 *         return mode             # <<<<<<<<<<<<<<
 * 
 *     @staticmethod
 */
  __pyx_r = __pyx_v_mode;
  goto __pyx_L0;

  /* "thinc/linalg.pxd":74
 * 
 *     @staticmethod
 *     cdef inline weight_t max(const weight_t* x, int32_t nr) nogil:             # <<<<<<<<<<<<<<
 *         if nr == 0:
 *             return 0
 */

  /* function exit code */
  __pyx_L0:;
  return __pyx_r;
}

/* "thinc/linalg.pxd":85
 * 
 *     @staticmethod
 *     cdef inline weight_t sum(const weight_t* vec, int32_t nr) nogil:             # <<<<<<<<<<<<<<
 *         cdef int i
 *         cdef weight_t total = 0
 */

static CYTHON_INLINE __pyx_t_5thinc_6linalg_weight_t __pyx_f_5thinc_6linalg_3Vec_sum(__pyx_t_5thinc_6linalg_weight_t const *__pyx_v_vec, int32_t __pyx_v_nr) {
  int __pyx_v_i;
  __pyx_t_5thinc_6linalg_weight_t __pyx_v_total;
  __pyx_t_5thinc_6linalg_weight_t __pyx_r;
  int32_t __pyx_t_1;
  int __pyx_t_2;

  /* "thinc/linalg.pxd":87
 *     cdef inline weight_t sum(const weight_t* vec, int32_t nr) nogil:
 *         cdef int i
 *         cdef weight_t total = 0             # <<<<<<<<<<<<<<
 *         for i in range(nr):
 *             total += vec[i]
 */
  __pyx_v_total = 0.0;

  /* "thinc/linalg.pxd":88
 *         cdef int i
 *         cdef weight_t total = 0
 *         for i in range(nr):             # <<<<<<<<<<<<<<
 *             total += vec[i]
 *         return total
 */
  __pyx_t_1 = __pyx_v_nr;
  for (__pyx_t_2 = 0; __pyx_t_2 < __pyx_t_1; __pyx_t_2+=1) {
    __pyx_v_i = __pyx_t_2;

    /* "thinc/linalg.pxd":89
 *         cdef weight_t total = 0
 *         for i in range(nr):
 *             total += vec[i]             # <<<<<<<<<<<<<<
 *         return total
 * 
 */
    __pyx_v_total = (__pyx_v_total + (__pyx_v_vec[__pyx_v_i]));
  }

  /* "thinc/linalg.pxd":90
 *         for i in range(nr):
 *             total += vec[i]
 *         return total             # <<<<<<<<<<<<<<
 * 
 *     @staticmethod
 */
  __pyx_r = __pyx_v_total;
  goto __pyx_L0;

  /* "thinc/linalg.pxd":85
 * 
 *     @staticmethod
 *     cdef inline weight_t sum(const weight_t* vec, int32_t nr) nogil:             # <<<<<<<<<<<<<<
 *         cdef int i
 *         cdef weight_t total = 0
 */

  /* function exit code */
  __pyx_L0:;
  return __pyx_r;
}

/* "thinc/linalg.pxd":93
 * 
 *     @staticmethod
 *     cdef inline void add(weight_t* output, const weight_t* x,             # <<<<<<<<<<<<<<
 *             weight_t inc, int32_t nr) nogil:
 *         memcpy(output, x, sizeof(output[0]) * nr)
 */

static CYTHON_INLINE void __pyx_f_5thinc_6linalg_3Vec_add(__pyx_t_5thinc_6linalg_weight_t *__pyx_v_output, __pyx_t_5thinc_6linalg_weight_t const *__pyx_v_x, __pyx_t_5thinc_6linalg_weight_t __pyx_v_inc, int32_t __pyx_v_nr) {

  /* "thinc/linalg.pxd":95
 *     cdef inline void add(weight_t* output, const weight_t* x,
 *             weight_t inc, int32_t nr) nogil:
 *         memcpy(output, x, sizeof(output[0]) * nr)             # <<<<<<<<<<<<<<
 *         Vec.add_i(output, inc, nr)
 * 
 */
  memcpy(__pyx_v_output, __pyx_v_x, ((sizeof((__pyx_v_output[0]))) * __pyx_v_nr));

  /* "thinc/linalg.pxd":96
 *             weight_t inc, int32_t nr) nogil:
 *         memcpy(output, x, sizeof(output[0]) * nr)
 *         Vec.add_i(output, inc, nr)             # <<<<<<<<<<<<<<
 * 
 *     @staticmethod
 */
  __pyx_f_5thinc_6linalg_3Vec_add_i(__pyx_v_output, __pyx_v_inc, __pyx_v_nr);

  /* "thinc/linalg.pxd":93
 * 
 *     @staticmethod
 *     cdef inline void add(weight_t* output, const weight_t* x,             # <<<<<<<<<<<<<<
 *             weight_t inc, int32_t nr) nogil:
 *         memcpy(output, x, sizeof(output[0]) * nr)
 */

  /* function exit code */
}

/* "thinc/linalg.pxd":99
 * 
 *     @staticmethod
 *     cdef inline void add_i(weight_t* vec, weight_t inc, int32_t nr) nogil:             # <<<<<<<<<<<<<<
 *         cdef int i
 *         for i in range(nr):
 */

static CYTHON_INLINE void __pyx_f_5thinc_6linalg_3Vec_add_i(__pyx_t_5thinc_6linalg_weight_t *__pyx_v_vec, __pyx_t_5thinc_6linalg_weight_t __pyx_v_inc, int32_t __pyx_v_nr) {
  int __pyx_v_i;
  int32_t __pyx_t_1;
  int __pyx_t_2;
  int __pyx_t_3;

  /* "thinc/linalg.pxd":101
 *     cdef inline void add_i(weight_t* vec, weight_t inc, int32_t nr) nogil:
 *         cdef int i
 *         for i in range(nr):             # <<<<<<<<<<<<<<
 *             vec[i] += inc
 * 
 */
  __pyx_t_1 = __pyx_v_nr;
  for (__pyx_t_2 = 0; __pyx_t_2 < __pyx_t_1; __pyx_t_2+=1) {
    __pyx_v_i = __pyx_t_2;

    /* "thinc/linalg.pxd":102
 *         cdef int i
 *         for i in range(nr):
 *             vec[i] += inc             # <<<<<<<<<<<<<<
 * 
 *     @staticmethod
 */
    __pyx_t_3 = __pyx_v_i;
    (__pyx_v_vec[__pyx_t_3]) = ((__pyx_v_vec[__pyx_t_3]) + __pyx_v_inc);
  }

  /* "thinc/linalg.pxd":99
 * 
 *     @staticmethod
 *     cdef inline void add_i(weight_t* vec, weight_t inc, int32_t nr) nogil:             # <<<<<<<<<<<<<<
 *         cdef int i
 *         for i in range(nr):
 */

  /* function exit code */
}

/* "thinc/linalg.pxd":105
 * 
 *     @staticmethod
 *     cdef inline void mul(weight_t* output, const weight_t* vec, weight_t scal,             # <<<<<<<<<<<<<<
 *             int32_t nr) nogil:
 *         memcpy(output, vec, sizeof(output[0]) * nr)
 */

static CYTHON_INLINE void __pyx_f_5thinc_6linalg_3Vec_mul(__pyx_t_5thinc_6linalg_weight_t *__pyx_v_output, __pyx_t_5thinc_6linalg_weight_t const *__pyx_v_vec, __pyx_t_5thinc_6linalg_weight_t __pyx_v_scal, int32_t __pyx_v_nr) {

  /* "thinc/linalg.pxd":107
 *     cdef inline void mul(weight_t* output, const weight_t* vec, weight_t scal,
 *             int32_t nr) nogil:
 *         memcpy(output, vec, sizeof(output[0]) * nr)             # <<<<<<<<<<<<<<
 *         Vec.mul_i(output, scal, nr)
 * 
 */
  memcpy(__pyx_v_output, __pyx_v_vec, ((sizeof((__pyx_v_output[0]))) * __pyx_v_nr));

  /* "thinc/linalg.pxd":108
 *             int32_t nr) nogil:
 *         memcpy(output, vec, sizeof(output[0]) * nr)
 *         Vec.mul_i(output, scal, nr)             # <<<<<<<<<<<<<<
 * 
 *     @staticmethod
 */
  __pyx_f_5thinc_6linalg_3Vec_mul_i(__pyx_v_output, __pyx_v_scal, __pyx_v_nr);

  /* "thinc/linalg.pxd":105
 * 
 *     @staticmethod
 *     cdef inline void mul(weight_t* output, const weight_t* vec, weight_t scal,             # <<<<<<<<<<<<<<
 *             int32_t nr) nogil:
 *         memcpy(output, vec, sizeof(output[0]) * nr)
 */

  /* function exit code */
}

/* "thinc/linalg.pxd":111
 * 
 *     @staticmethod
 *     cdef inline void mul_i(weight_t* vec, const weight_t scal, int32_t nr) nogil:             # <<<<<<<<<<<<<<
 *         cdef int i
 *         if USE_BLAS:
 */

static CYTHON_INLINE void __pyx_f_5thinc_6linalg_3Vec_mul_i(__pyx_t_5thinc_6linalg_weight_t *__pyx_v_vec, __pyx_t_5thinc_6linalg_weight_t const __pyx_v_scal, int32_t __pyx_v_nr) {
  int __pyx_v_i;
  int32_t __pyx_t_1;
  int __pyx_t_2;
  int __pyx_t_3;

  /* "thinc/linalg.pxd":116
 *             cblas_sscal(nr, scal, vec, 1)
 *         else:
 *             for i in range(nr):             # <<<<<<<<<<<<<<
 *                 vec[i] *= scal
 * 
 */
  __pyx_t_1 = __pyx_v_nr;
  for (__pyx_t_2 = 0; __pyx_t_2 < __pyx_t_1; __pyx_t_2+=1) {
    __pyx_v_i = __pyx_t_2;

    /* "thinc/linalg.pxd":117
 *         else:
 *             for i in range(nr):
 *                 vec[i] *= scal             # <<<<<<<<<<<<<<
 * 
 *     @staticmethod
 */
    __pyx_t_3 = __pyx_v_i;
    (__pyx_v_vec[__pyx_t_3]) = ((__pyx_v_vec[__pyx_t_3]) * __pyx_v_scal);
  }

  /* "thinc/linalg.pxd":111
 * 
 *     @staticmethod
 *     cdef inline void mul_i(weight_t* vec, const weight_t scal, int32_t nr) nogil:             # <<<<<<<<<<<<<<
 *         cdef int i
 *         if USE_BLAS:
 */

  /* function exit code */
}

/* "thinc/linalg.pxd":120
 * 
 *     @staticmethod
 *     cdef inline void pow(weight_t* output, const weight_t* vec, weight_t scal,             # <<<<<<<<<<<<<<
 *             int32_t nr) nogil:
 *         memcpy(output, vec, sizeof(output[0]) * nr)
 */

static CYTHON_INLINE void __pyx_f_5thinc_6linalg_3Vec_pow(__pyx_t_5thinc_6linalg_weight_t *__pyx_v_output, __pyx_t_5thinc_6linalg_weight_t const *__pyx_v_vec, __pyx_t_5thinc_6linalg_weight_t __pyx_v_scal, int32_t __pyx_v_nr) {

  /* "thinc/linalg.pxd":122
 *     cdef inline void pow(weight_t* output, const weight_t* vec, weight_t scal,
 *             int32_t nr) nogil:
 *         memcpy(output, vec, sizeof(output[0]) * nr)             # <<<<<<<<<<<<<<
 *         Vec.pow_i(output, scal, nr)
 * 
 */
  memcpy(__pyx_v_output, __pyx_v_vec, ((sizeof((__pyx_v_output[0]))) * __pyx_v_nr));

  /* "thinc/linalg.pxd":123
 *             int32_t nr) nogil:
 *         memcpy(output, vec, sizeof(output[0]) * nr)
 *         Vec.pow_i(output, scal, nr)             # <<<<<<<<<<<<<<
 * 
 *     @staticmethod
 */
  __pyx_f_5thinc_6linalg_3Vec_pow_i(__pyx_v_output, __pyx_v_scal, __pyx_v_nr);

  /* "thinc/linalg.pxd":120
 * 
 *     @staticmethod
 *     cdef inline void pow(weight_t* output, const weight_t* vec, weight_t scal,             # <<<<<<<<<<<<<<
 *             int32_t nr) nogil:
 *         memcpy(output, vec, sizeof(output[0]) * nr)
 */

  /* function exit code */
}

/* "thinc/linalg.pxd":126
 * 
 *     @staticmethod
 *     cdef inline void pow_i(weight_t* vec, const weight_t scal, int32_t nr) nogil:             # <<<<<<<<<<<<<<
 *         cdef int i
 *         for i in range(nr):
 */

static CYTHON_INLINE void __pyx_f_5thinc_6linalg_3Vec_pow_i(__pyx_t_5thinc_6linalg_weight_t *__pyx_v_vec, __pyx_t_5thinc_6linalg_weight_t const __pyx_v_scal, int32_t __pyx_v_nr) {
  int __pyx_v_i;
  int32_t __pyx_t_1;
  int __pyx_t_2;
  int __pyx_t_3;

  /* "thinc/linalg.pxd":128
 *     cdef inline void pow_i(weight_t* vec, const weight_t scal, int32_t nr) nogil:
 *         cdef int i
 *         for i in range(nr):             # <<<<<<<<<<<<<<
 *             vec[i] **= scal
 * 
 */
  __pyx_t_1 = __pyx_v_nr;
  for (__pyx_t_2 = 0; __pyx_t_2 < __pyx_t_1; __pyx_t_2+=1) {
    __pyx_v_i = __pyx_t_2;

    /* "thinc/linalg.pxd":129
 *         cdef int i
 *         for i in range(nr):
 *             vec[i] **= scal             # <<<<<<<<<<<<<<
 * 
 *     @staticmethod
 */
    __pyx_t_3 = __pyx_v_i;
    (__pyx_v_vec[__pyx_t_3]) = powf(((__pyx_t_5thinc_6linalg_weight_t const )(__pyx_v_vec[__pyx_t_3])), __pyx_v_scal);
  }

  /* "thinc/linalg.pxd":126
 * 
 *     @staticmethod
 *     cdef inline void pow_i(weight_t* vec, const weight_t scal, int32_t nr) nogil:             # <<<<<<<<<<<<<<
 *         cdef int i
 *         for i in range(nr):
 */

  /* function exit code */
}

/* "thinc/linalg.pxd":133
 *     @staticmethod
 *     @cython.cdivision(True)
 *     cdef inline void div(weight_t* output, const weight_t* vec, weight_t scal,             # <<<<<<<<<<<<<<
 *             int32_t nr) nogil:
 *         memcpy(output, vec, sizeof(output[0]) * nr)
 */

static CYTHON_INLINE void __pyx_f_5thinc_6linalg_3Vec_div(__pyx_t_5thinc_6linalg_weight_t *__pyx_v_output, __pyx_t_5thinc_6linalg_weight_t const *__pyx_v_vec, __pyx_t_5thinc_6linalg_weight_t __pyx_v_scal, int32_t __pyx_v_nr) {

  /* "thinc/linalg.pxd":135
 *     cdef inline void div(weight_t* output, const weight_t* vec, weight_t scal,
 *             int32_t nr) nogil:
 *         memcpy(output, vec, sizeof(output[0]) * nr)             # <<<<<<<<<<<<<<
 *         Vec.div_i(output, scal, nr)
 * 
 */
  memcpy(__pyx_v_output, __pyx_v_vec, ((sizeof((__pyx_v_output[0]))) * __pyx_v_nr));

  /* "thinc/linalg.pxd":136
 *             int32_t nr) nogil:
 *         memcpy(output, vec, sizeof(output[0]) * nr)
 *         Vec.div_i(output, scal, nr)             # <<<<<<<<<<<<<<
 * 
 *     @staticmethod
 */
  __pyx_f_5thinc_6linalg_3Vec_div_i(__pyx_v_output, __pyx_v_scal, __pyx_v_nr);

  /* "thinc/linalg.pxd":133
 *     @staticmethod
 *     @cython.cdivision(True)
 *     cdef inline void div(weight_t* output, const weight_t* vec, weight_t scal,             # <<<<<<<<<<<<<<
 *             int32_t nr) nogil:
 *         memcpy(output, vec, sizeof(output[0]) * nr)
 */

  /* function exit code */
}

/* "thinc/linalg.pxd":140
 *     @staticmethod
 *     @cython.cdivision(True)
 *     cdef inline void div_i(weight_t* vec, const weight_t scal, int32_t nr) nogil:             # <<<<<<<<<<<<<<
 *         cdef int i
 *         for i in range(nr):
 */

static CYTHON_INLINE void __pyx_f_5thinc_6linalg_3Vec_div_i(__pyx_t_5thinc_6linalg_weight_t *__pyx_v_vec, __pyx_t_5thinc_6linalg_weight_t const __pyx_v_scal, int32_t __pyx_v_nr) {
  int __pyx_v_i;
  int32_t __pyx_t_1;
  int __pyx_t_2;
  int __pyx_t_3;

  /* "thinc/linalg.pxd":142
 *     cdef inline void div_i(weight_t* vec, const weight_t scal, int32_t nr) nogil:
 *         cdef int i
 *         for i in range(nr):             # <<<<<<<<<<<<<<
 *             vec[i] /= scal
 * 
 */
  __pyx_t_1 = __pyx_v_nr;
  for (__pyx_t_2 = 0; __pyx_t_2 < __pyx_t_1; __pyx_t_2+=1) {
    __pyx_v_i = __pyx_t_2;

    /* "thinc/linalg.pxd":143
 *         cdef int i
 *         for i in range(nr):
 *             vec[i] /= scal             # <<<<<<<<<<<<<<
 * 
 *     @staticmethod
 */
    __pyx_t_3 = __pyx_v_i;
    (__pyx_v_vec[__pyx_t_3]) = ((__pyx_v_vec[__pyx_t_3]) / __pyx_v_scal);
  }

  /* "thinc/linalg.pxd":140
 *     @staticmethod
 *     @cython.cdivision(True)
 *     cdef inline void div_i(weight_t* vec, const weight_t scal, int32_t nr) nogil:             # <<<<<<<<<<<<<<
 *         cdef int i
 *         for i in range(nr):
 */

  /* function exit code */
}

/* "thinc/linalg.pxd":146
 * 
 *     @staticmethod
 *     cdef inline void exp(weight_t* output, const weight_t* vec, int32_t nr) nogil:             # <<<<<<<<<<<<<<
 *         memcpy(output, vec, sizeof(output[0]) * nr)
 *         Vec.exp_i(output, nr)
 */

static CYTHON_INLINE void __pyx_f_5thinc_6linalg_3Vec_exp(__pyx_t_5thinc_6linalg_weight_t *__pyx_v_output, __pyx_t_5thinc_6linalg_weight_t const *__pyx_v_vec, int32_t __pyx_v_nr) {

  /* "thinc/linalg.pxd":147
 *     @staticmethod
 *     cdef inline void exp(weight_t* output, const weight_t* vec, int32_t nr) nogil:
 *         memcpy(output, vec, sizeof(output[0]) * nr)             # <<<<<<<<<<<<<<
 *         Vec.exp_i(output, nr)
 * 
 */
  memcpy(__pyx_v_output, __pyx_v_vec, ((sizeof((__pyx_v_output[0]))) * __pyx_v_nr));

  /* "thinc/linalg.pxd":148
 *     cdef inline void exp(weight_t* output, const weight_t* vec, int32_t nr) nogil:
 *         memcpy(output, vec, sizeof(output[0]) * nr)
 *         Vec.exp_i(output, nr)             # <<<<<<<<<<<<<<
 * 
 *     @staticmethod
 */
  __pyx_f_5thinc_6linalg_3Vec_exp_i(__pyx_v_output, __pyx_v_nr);

  /* "thinc/linalg.pxd":146
 * 
 *     @staticmethod
 *     cdef inline void exp(weight_t* output, const weight_t* vec, int32_t nr) nogil:             # <<<<<<<<<<<<<<
 *         memcpy(output, vec, sizeof(output[0]) * nr)
 *         Vec.exp_i(output, nr)
 */

  /* function exit code */
}

/* "thinc/linalg.pxd":151
 * 
 *     @staticmethod
 *     cdef inline void exp_i(weight_t* vec, int32_t nr) nogil:             # <<<<<<<<<<<<<<
 *         cdef int i
 *         for i in range(nr):
 */

static CYTHON_INLINE void __pyx_f_5thinc_6linalg_3Vec_exp_i(__pyx_t_5thinc_6linalg_weight_t *__pyx_v_vec, int32_t __pyx_v_nr) {
  int __pyx_v_i;
  int32_t __pyx_t_1;
  int __pyx_t_2;

  /* "thinc/linalg.pxd":153
 *     cdef inline void exp_i(weight_t* vec, int32_t nr) nogil:
 *         cdef int i
 *         for i in range(nr):             # <<<<<<<<<<<<<<
 *             vec[i] = expf(vec[i])
 * 
 */
  __pyx_t_1 = __pyx_v_nr;
  for (__pyx_t_2 = 0; __pyx_t_2 < __pyx_t_1; __pyx_t_2+=1) {
    __pyx_v_i = __pyx_t_2;

    /* "thinc/linalg.pxd":154
 *         cdef int i
 *         for i in range(nr):
 *             vec[i] = expf(vec[i])             # <<<<<<<<<<<<<<
 * 
 *     @staticmethod
 */
    (__pyx_v_vec[__pyx_v_i]) = expf((__pyx_v_vec[__pyx_v_i]));
  }

  /* "thinc/linalg.pxd":151
 * 
 *     @staticmethod
 *     cdef inline void exp_i(weight_t* vec, int32_t nr) nogil:             # <<<<<<<<<<<<<<
 *         cdef int i
 *         for i in range(nr):
 */

  /* function exit code */
}

/* "thinc/linalg.pxd":157
 * 
 *     @staticmethod
 *     cdef inline void reciprocal_i(weight_t* vec, int32_t nr) nogil:             # <<<<<<<<<<<<<<
 *         cdef int i
 *         for i in range(nr):
 */

static CYTHON_INLINE void __pyx_f_5thinc_6linalg_3Vec_reciprocal_i(__pyx_t_5thinc_6linalg_weight_t *__pyx_v_vec, int32_t __pyx_v_nr) {
  int __pyx_v_i;
  int32_t __pyx_t_1;
  int __pyx_t_2;

  /* "thinc/linalg.pxd":159
 *     cdef inline void reciprocal_i(weight_t* vec, int32_t nr) nogil:
 *         cdef int i
 *         for i in range(nr):             # <<<<<<<<<<<<<<
 *             vec[i] = 1.0 / vec[i]
 * 
 */
  __pyx_t_1 = __pyx_v_nr;
  for (__pyx_t_2 = 0; __pyx_t_2 < __pyx_t_1; __pyx_t_2+=1) {
    __pyx_v_i = __pyx_t_2;

    /* "thinc/linalg.pxd":160
 *         cdef int i
 *         for i in range(nr):
 *             vec[i] = 1.0 / vec[i]             # <<<<<<<<<<<<<<
 * 
 * 
 */
    (__pyx_v_vec[__pyx_v_i]) = (1.0 / (__pyx_v_vec[__pyx_v_i]));
  }

  /* "thinc/linalg.pxd":157
 * 
 *     @staticmethod
 *     cdef inline void reciprocal_i(weight_t* vec, int32_t nr) nogil:             # <<<<<<<<<<<<<<
 *         cdef int i
 *         for i in range(nr):
 */

  /* function exit code */
}

/* "thinc/linalg.pxd":165
 * cdef class VecVec:
 *     @staticmethod
 *     cdef inline void add(weight_t* output,             # <<<<<<<<<<<<<<
 *                          const weight_t* x,
 *                          const weight_t* y,
 */

static CYTHON_INLINE void __pyx_f_5thinc_6linalg_6VecVec_add(__pyx_t_5thinc_6linalg_weight_t *__pyx_v_output, __pyx_t_5thinc_6linalg_weight_t const *__pyx_v_x, __pyx_t_5thinc_6linalg_weight_t const *__pyx_v_y, __pyx_t_5thinc_6linalg_weight_t __pyx_v_scale, int32_t __pyx_v_nr) {

  /* "thinc/linalg.pxd":170
 *                          weight_t scale,
 *                          int32_t nr) nogil:
 *         memcpy(output, x, sizeof(output[0]) * nr)             # <<<<<<<<<<<<<<
 *         VecVec.add_i(output, y, scale, nr)
 * 
 */
  memcpy(__pyx_v_output, __pyx_v_x, ((sizeof((__pyx_v_output[0]))) * __pyx_v_nr));

  /* "thinc/linalg.pxd":171
 *                          int32_t nr) nogil:
 *         memcpy(output, x, sizeof(output[0]) * nr)
 *         VecVec.add_i(output, y, scale, nr)             # <<<<<<<<<<<<<<
 * 
 *     @staticmethod
 */
  __pyx_f_5thinc_6linalg_6VecVec_add_i(__pyx_v_output, __pyx_v_y, __pyx_v_scale, __pyx_v_nr);

  /* "thinc/linalg.pxd":165
 * cdef class VecVec:
 *     @staticmethod
 *     cdef inline void add(weight_t* output,             # <<<<<<<<<<<<<<
 *                          const weight_t* x,
 *                          const weight_t* y,
 */

  /* function exit code */
}

/* "thinc/linalg.pxd":174
 * 
 *     @staticmethod
 *     cdef inline void add_i(float* x,             # <<<<<<<<<<<<<<
 *                            const float* y,
 *                            float scale,
 */

static CYTHON_INLINE void __pyx_f_5thinc_6linalg_6VecVec_add_i(float *__pyx_v_x, float const *__pyx_v_y, float __pyx_v_scale, int32_t __pyx_v_nr) {
  int __pyx_v_i;
  int32_t __pyx_t_1;
  int __pyx_t_2;
  int __pyx_t_3;

  /* "thinc/linalg.pxd":182
 *             cblas_saxpy(nr, scale, y, 1, x, 1)
 *         else:
 *             for i in range(nr):             # <<<<<<<<<<<<<<
 *                 x[i] += y[i] * scale
 * 
 */
  __pyx_t_1 = __pyx_v_nr;
  for (__pyx_t_2 = 0; __pyx_t_2 < __pyx_t_1; __pyx_t_2+=1) {
    __pyx_v_i = __pyx_t_2;

    /* "thinc/linalg.pxd":183
 *         else:
 *             for i in range(nr):
 *                 x[i] += y[i] * scale             # <<<<<<<<<<<<<<
 * 
 *     @staticmethod
 */
    __pyx_t_3 = __pyx_v_i;
    (__pyx_v_x[__pyx_t_3]) = ((__pyx_v_x[__pyx_t_3]) + ((__pyx_v_y[__pyx_v_i]) * __pyx_v_scale));
  }

  /* "thinc/linalg.pxd":174
 * 
 *     @staticmethod
 *     cdef inline void add_i(float* x,             # <<<<<<<<<<<<<<
 *                            const float* y,
 *                            float scale,
 */

  /* function exit code */
}

/* "thinc/linalg.pxd":186
 * 
 *     @staticmethod
 *     cdef inline void add_pow(weight_t* output,             # <<<<<<<<<<<<<<
 *             const weight_t* x, const weight_t* y, weight_t power, int32_t nr) nogil:
 *         memcpy(output, x, sizeof(output[0]) * nr)
 */

static CYTHON_INLINE void __pyx_f_5thinc_6linalg_6VecVec_add_pow(__pyx_t_5thinc_6linalg_weight_t *__pyx_v_output, __pyx_t_5thinc_6linalg_weight_t const *__pyx_v_x, __pyx_t_5thinc_6linalg_weight_t const *__pyx_v_y, __pyx_t_5thinc_6linalg_weight_t __pyx_v_power, int32_t __pyx_v_nr) {

  /* "thinc/linalg.pxd":188
 *     cdef inline void add_pow(weight_t* output,
 *             const weight_t* x, const weight_t* y, weight_t power, int32_t nr) nogil:
 *         memcpy(output, x, sizeof(output[0]) * nr)             # <<<<<<<<<<<<<<
 *         VecVec.add_pow_i(output, y, power, nr)
 * 
 */
  memcpy(__pyx_v_output, __pyx_v_x, ((sizeof((__pyx_v_output[0]))) * __pyx_v_nr));

  /* "thinc/linalg.pxd":189
 *             const weight_t* x, const weight_t* y, weight_t power, int32_t nr) nogil:
 *         memcpy(output, x, sizeof(output[0]) * nr)
 *         VecVec.add_pow_i(output, y, power, nr)             # <<<<<<<<<<<<<<
 * 
 * 
 */
  __pyx_f_5thinc_6linalg_6VecVec_add_pow_i(__pyx_v_output, __pyx_v_y, __pyx_v_power, __pyx_v_nr);

  /* "thinc/linalg.pxd":186
 * 
 *     @staticmethod
 *     cdef inline void add_pow(weight_t* output,             # <<<<<<<<<<<<<<
 *             const weight_t* x, const weight_t* y, weight_t power, int32_t nr) nogil:
 *         memcpy(output, x, sizeof(output[0]) * nr)
 */

  /* function exit code */
}

/* "thinc/linalg.pxd":193
 * 
 *     @staticmethod
 *     cdef inline void add_pow_i(weight_t* x,             # <<<<<<<<<<<<<<
 *             const weight_t* y, weight_t power, int32_t nr) nogil:
 *         cdef int i
 */

static CYTHON_INLINE void __pyx_f_5thinc_6linalg_6VecVec_add_pow_i(__pyx_t_5thinc_6linalg_weight_t *__pyx_v_x, __pyx_t_5thinc_6linalg_weight_t const *__pyx_v_y, __pyx_t_5thinc_6linalg_weight_t __pyx_v_power, int32_t __pyx_v_nr) {
  int __pyx_v_i;
  int32_t __pyx_t_1;
  int __pyx_t_2;
  int __pyx_t_3;

  /* "thinc/linalg.pxd":196
 *             const weight_t* y, weight_t power, int32_t nr) nogil:
 *         cdef int i
 *         for i in range(nr):             # <<<<<<<<<<<<<<
 *             x[i] += y[i] ** power
 * 
 */
  __pyx_t_1 = __pyx_v_nr;
  for (__pyx_t_2 = 0; __pyx_t_2 < __pyx_t_1; __pyx_t_2+=1) {
    __pyx_v_i = __pyx_t_2;

    /* "thinc/linalg.pxd":197
 *         cdef int i
 *         for i in range(nr):
 *             x[i] += y[i] ** power             # <<<<<<<<<<<<<<
 * 
 *     @staticmethod
 */
    __pyx_t_3 = __pyx_v_i;
    (__pyx_v_x[__pyx_t_3]) = ((__pyx_v_x[__pyx_t_3]) + powf(((__pyx_t_5thinc_6linalg_weight_t)(__pyx_v_y[__pyx_v_i])), __pyx_v_power));
  }

  /* "thinc/linalg.pxd":193
 * 
 *     @staticmethod
 *     cdef inline void add_pow_i(weight_t* x,             # <<<<<<<<<<<<<<
 *             const weight_t* y, weight_t power, int32_t nr) nogil:
 *         cdef int i
 */

  /* function exit code */
}

/* "thinc/linalg.pxd":200
 * 
 *     @staticmethod
 *     cdef inline void mul(weight_t* output,             # <<<<<<<<<<<<<<
 *             const weight_t* x, const weight_t* y, int32_t nr) nogil:
 *         memcpy(output, x, sizeof(output[0]) * nr)
 */

static CYTHON_INLINE void __pyx_f_5thinc_6linalg_6VecVec_mul(__pyx_t_5thinc_6linalg_weight_t *__pyx_v_output, __pyx_t_5thinc_6linalg_weight_t const *__pyx_v_x, __pyx_t_5thinc_6linalg_weight_t const *__pyx_v_y, int32_t __pyx_v_nr) {

  /* "thinc/linalg.pxd":202
 *     cdef inline void mul(weight_t* output,
 *             const weight_t* x, const weight_t* y, int32_t nr) nogil:
 *         memcpy(output, x, sizeof(output[0]) * nr)             # <<<<<<<<<<<<<<
 *         VecVec.mul_i(output, y, nr)
 * 
 */
  memcpy(__pyx_v_output, __pyx_v_x, ((sizeof((__pyx_v_output[0]))) * __pyx_v_nr));

  /* "thinc/linalg.pxd":203
 *             const weight_t* x, const weight_t* y, int32_t nr) nogil:
 *         memcpy(output, x, sizeof(output[0]) * nr)
 *         VecVec.mul_i(output, y, nr)             # <<<<<<<<<<<<<<
 * 
 *     @staticmethod
 */
  __pyx_f_5thinc_6linalg_6VecVec_mul_i(__pyx_v_output, __pyx_v_y, __pyx_v_nr);

  /* "thinc/linalg.pxd":200
 * 
 *     @staticmethod
 *     cdef inline void mul(weight_t* output,             # <<<<<<<<<<<<<<
 *             const weight_t* x, const weight_t* y, int32_t nr) nogil:
 *         memcpy(output, x, sizeof(output[0]) * nr)
 */

  /* function exit code */
}

/* "thinc/linalg.pxd":206
 * 
 *     @staticmethod
 *     cdef inline void mul_i(weight_t* x,             # <<<<<<<<<<<<<<
 *             const weight_t* y, int32_t nr) nogil:
 *         cdef int i
 */

static CYTHON_INLINE void __pyx_f_5thinc_6linalg_6VecVec_mul_i(__pyx_t_5thinc_6linalg_weight_t *__pyx_v_x, __pyx_t_5thinc_6linalg_weight_t const *__pyx_v_y, int32_t __pyx_v_nr) {
  int __pyx_v_i;
  int32_t __pyx_t_1;
  int __pyx_t_2;
  int __pyx_t_3;

  /* "thinc/linalg.pxd":209
 *             const weight_t* y, int32_t nr) nogil:
 *         cdef int i
 *         for i in range(nr):             # <<<<<<<<<<<<<<
 *             x[i] *= y[i]
 * 
 */
  __pyx_t_1 = __pyx_v_nr;
  for (__pyx_t_2 = 0; __pyx_t_2 < __pyx_t_1; __pyx_t_2+=1) {
    __pyx_v_i = __pyx_t_2;

    /* "thinc/linalg.pxd":210
 *         cdef int i
 *         for i in range(nr):
 *             x[i] *= y[i]             # <<<<<<<<<<<<<<
 * 
 * 
 */
    __pyx_t_3 = __pyx_v_i;
    (__pyx_v_x[__pyx_t_3]) = ((__pyx_v_x[__pyx_t_3]) * (__pyx_v_y[__pyx_v_i]));
  }

  /* "thinc/linalg.pxd":206
 * 
 *     @staticmethod
 *     cdef inline void mul_i(weight_t* x,             # <<<<<<<<<<<<<<
 *             const weight_t* y, int32_t nr) nogil:
 *         cdef int i
 */

  /* function exit code */
}

/* "thinc/linalg.pxd":214
 * 
 *     @staticmethod
 *     cdef inline weight_t dot(             # <<<<<<<<<<<<<<
 *             const weight_t* x, const weight_t* y, int32_t nr) nogil:
 *         cdef int i
 */

static CYTHON_INLINE __pyx_t_5thinc_6linalg_weight_t __pyx_f_5thinc_6linalg_6VecVec_dot(__pyx_t_5thinc_6linalg_weight_t const *__pyx_v_x, __pyx_t_5thinc_6linalg_weight_t const *__pyx_v_y, int32_t __pyx_v_nr) {
  int __pyx_v_i;
  __pyx_t_5thinc_6linalg_weight_t __pyx_v_total;
  __pyx_t_5thinc_6linalg_weight_t __pyx_r;
  int32_t __pyx_t_1;
  int __pyx_t_2;

  /* "thinc/linalg.pxd":217
 *             const weight_t* x, const weight_t* y, int32_t nr) nogil:
 *         cdef int i
 *         cdef weight_t total = 0             # <<<<<<<<<<<<<<
 *         for i in range(nr):
 *             total += x[i] * y[i]
 */
  __pyx_v_total = 0.0;

  /* "thinc/linalg.pxd":218
 *         cdef int i
 *         cdef weight_t total = 0
 *         for i in range(nr):             # <<<<<<<<<<<<<<
 *             total += x[i] * y[i]
 *         return total
 */
  __pyx_t_1 = __pyx_v_nr;
  for (__pyx_t_2 = 0; __pyx_t_2 < __pyx_t_1; __pyx_t_2+=1) {
    __pyx_v_i = __pyx_t_2;

    /* "thinc/linalg.pxd":219
 *         cdef weight_t total = 0
 *         for i in range(nr):
 *             total += x[i] * y[i]             # <<<<<<<<<<<<<<
 *         return total
 * 
 */
    __pyx_v_total = (__pyx_v_total + ((__pyx_v_x[__pyx_v_i]) * (__pyx_v_y[__pyx_v_i])));
  }

  /* "thinc/linalg.pxd":220
 *         for i in range(nr):
 *             total += x[i] * y[i]
 *         return total             # <<<<<<<<<<<<<<
 * 
 *     @staticmethod
 */
  __pyx_r = __pyx_v_total;
  goto __pyx_L0;

  /* "thinc/linalg.pxd":214
 * 
 *     @staticmethod
 *     cdef inline weight_t dot(             # <<<<<<<<<<<<<<
 *             const weight_t* x, const weight_t* y, int32_t nr) nogil:
 *         cdef int i
 */

  /* function exit code */
  __pyx_L0:;
  return __pyx_r;
}

/* "thinc/linalg.pxd":223
 * 
 *     @staticmethod
 *     cdef inline int arg_max_if_true(             # <<<<<<<<<<<<<<
 *             const weight_t* scores, const int* is_valid, const int n_classes) nogil:
 *         cdef int i
 */

static CYTHON_INLINE int __pyx_f_5thinc_6linalg_6VecVec_arg_max_if_true(__pyx_t_5thinc_6linalg_weight_t const *__pyx_v_scores, int const *__pyx_v_is_valid, int const __pyx_v_n_classes) {
  int __pyx_v_i;
  int __pyx_v_best;
  __pyx_t_5thinc_6linalg_weight_t __pyx_v_mode;
  int __pyx_r;
  int __pyx_t_1;
  int __pyx_t_2;
  int __pyx_t_3;
  int __pyx_t_4;

  /* "thinc/linalg.pxd":226
 *             const weight_t* scores, const int* is_valid, const int n_classes) nogil:
 *         cdef int i
 *         cdef int best = 0             # <<<<<<<<<<<<<<
 *         cdef weight_t mode = -900000
 *         for i in range(n_classes):
 */
  __pyx_v_best = 0;

  /* "thinc/linalg.pxd":227
 *         cdef int i
 *         cdef int best = 0
 *         cdef weight_t mode = -900000             # <<<<<<<<<<<<<<
 *         for i in range(n_classes):
 *             if is_valid[i] and scores[i] > mode:
 */
  __pyx_v_mode = -900000.0;

  /* "thinc/linalg.pxd":228
 *         cdef int best = 0
 *         cdef weight_t mode = -900000
 *         for i in range(n_classes):             # <<<<<<<<<<<<<<
 *             if is_valid[i] and scores[i] > mode:
 *                 mode = scores[i]
 */
  __pyx_t_1 = __pyx_v_n_classes;
  for (__pyx_t_2 = 0; __pyx_t_2 < __pyx_t_1; __pyx_t_2+=1) {
    __pyx_v_i = __pyx_t_2;

    /* "thinc/linalg.pxd":229
 *         cdef weight_t mode = -900000
 *         for i in range(n_classes):
 *             if is_valid[i] and scores[i] > mode:             # <<<<<<<<<<<<<<
 *                 mode = scores[i]
 *                 best = i
 */
    __pyx_t_4 = ((__pyx_v_is_valid[__pyx_v_i]) != 0);
    if (__pyx_t_4) {
    } else {
      __pyx_t_3 = __pyx_t_4;
      goto __pyx_L6_bool_binop_done;
    }
    __pyx_t_4 = (((__pyx_v_scores[__pyx_v_i]) > __pyx_v_mode) != 0);
    __pyx_t_3 = __pyx_t_4;
    __pyx_L6_bool_binop_done:;
    if (__pyx_t_3) {

      /* "thinc/linalg.pxd":230
 *         for i in range(n_classes):
 *             if is_valid[i] and scores[i] > mode:
 *                 mode = scores[i]             # <<<<<<<<<<<<<<
 *                 best = i
 *         return best
 */
      __pyx_v_mode = (__pyx_v_scores[__pyx_v_i]);

      /* "thinc/linalg.pxd":231
 *             if is_valid[i] and scores[i] > mode:
 *                 mode = scores[i]
 *                 best = i             # <<<<<<<<<<<<<<
 *         return best
 * 
 */
      __pyx_v_best = __pyx_v_i;

      /* "thinc/linalg.pxd":229
 *         cdef weight_t mode = -900000
 *         for i in range(n_classes):
 *             if is_valid[i] and scores[i] > mode:             # <<<<<<<<<<<<<<
 *                 mode = scores[i]
 *                 best = i
 */
    }
  }

  /* "thinc/linalg.pxd":232
 *                 mode = scores[i]
 *                 best = i
 *         return best             # <<<<<<<<<<<<<<
 * 
 *     @staticmethod
 */
  __pyx_r = __pyx_v_best;
  goto __pyx_L0;

  /* "thinc/linalg.pxd":223
 * 
 *     @staticmethod
 *     cdef inline int arg_max_if_true(             # <<<<<<<<<<<<<<
 *             const weight_t* scores, const int* is_valid, const int n_classes) nogil:
 *         cdef int i
 */

  /* function exit code */
  __pyx_L0:;
  return __pyx_r;
}

/* "thinc/linalg.pxd":235
 * 
 *     @staticmethod
 *     cdef inline int arg_max_if_zero(             # <<<<<<<<<<<<<<
 *             const weight_t* scores, const weight_t* costs, const int n_classes) nogil:
 *         cdef int i
 */

static CYTHON_INLINE int __pyx_f_5thinc_6linalg_6VecVec_arg_max_if_zero(__pyx_t_5thinc_6linalg_weight_t const *__pyx_v_scores, __pyx_t_5thinc_6linalg_weight_t const *__pyx_v_costs, int const __pyx_v_n_classes) {
  int __pyx_v_i;
  int __pyx_v_best;
  __pyx_t_5thinc_6linalg_weight_t __pyx_v_mode;
  int __pyx_r;
  int __pyx_t_1;
  int __pyx_t_2;
  int __pyx_t_3;
  int __pyx_t_4;

  /* "thinc/linalg.pxd":238
 *             const weight_t* scores, const weight_t* costs, const int n_classes) nogil:
 *         cdef int i
 *         cdef int best = 0             # <<<<<<<<<<<<<<
 *         cdef weight_t mode = -900000
 *         for i in range(n_classes):
 */
  __pyx_v_best = 0;

  /* "thinc/linalg.pxd":239
 *         cdef int i
 *         cdef int best = 0
 *         cdef weight_t mode = -900000             # <<<<<<<<<<<<<<
 *         for i in range(n_classes):
 *             if costs[i] == 0 and scores[i] > mode:
 */
  __pyx_v_mode = -900000.0;

  /* "thinc/linalg.pxd":240
 *         cdef int best = 0
 *         cdef weight_t mode = -900000
 *         for i in range(n_classes):             # <<<<<<<<<<<<<<
 *             if costs[i] == 0 and scores[i] > mode:
 *                 mode = scores[i]
 */
  __pyx_t_1 = __pyx_v_n_classes;
  for (__pyx_t_2 = 0; __pyx_t_2 < __pyx_t_1; __pyx_t_2+=1) {
    __pyx_v_i = __pyx_t_2;

    /* "thinc/linalg.pxd":241
 *         cdef weight_t mode = -900000
 *         for i in range(n_classes):
 *             if costs[i] == 0 and scores[i] > mode:             # <<<<<<<<<<<<<<
 *                 mode = scores[i]
 *                 best = i
 */
    __pyx_t_4 = (((__pyx_v_costs[__pyx_v_i]) == 0.0) != 0);
    if (__pyx_t_4) {
    } else {
      __pyx_t_3 = __pyx_t_4;
      goto __pyx_L6_bool_binop_done;
    }
    __pyx_t_4 = (((__pyx_v_scores[__pyx_v_i]) > __pyx_v_mode) != 0);
    __pyx_t_3 = __pyx_t_4;
    __pyx_L6_bool_binop_done:;
    if (__pyx_t_3) {

      /* "thinc/linalg.pxd":242
 *         for i in range(n_classes):
 *             if costs[i] == 0 and scores[i] > mode:
 *                 mode = scores[i]             # <<<<<<<<<<<<<<
 *                 best = i
 *         return best
 */
      __pyx_v_mode = (__pyx_v_scores[__pyx_v_i]);

      /* "thinc/linalg.pxd":243
 *             if costs[i] == 0 and scores[i] > mode:
 *                 mode = scores[i]
 *                 best = i             # <<<<<<<<<<<<<<
 *         return best
 * 
 */
      __pyx_v_best = __pyx_v_i;

      /* "thinc/linalg.pxd":241
 *         cdef weight_t mode = -900000
 *         for i in range(n_classes):
 *             if costs[i] == 0 and scores[i] > mode:             # <<<<<<<<<<<<<<
 *                 mode = scores[i]
 *                 best = i
 */
    }
  }

  /* "thinc/linalg.pxd":244
 *                 mode = scores[i]
 *                 best = i
 *         return best             # <<<<<<<<<<<<<<
 * 
 * 
 */
  __pyx_r = __pyx_v_best;
  goto __pyx_L0;

  /* "thinc/linalg.pxd":235
 * 
 *     @staticmethod
 *     cdef inline int arg_max_if_zero(             # <<<<<<<<<<<<<<
 *             const weight_t* scores, const weight_t* costs, const int n_classes) nogil:
 *         cdef int i
 */

  /* function exit code */
  __pyx_L0:;
  return __pyx_r;
}

/* "thinc/linalg.pxd":249
 * cdef class MatVec:
 *     @staticmethod
 *     cdef inline void mul(weight_t* output,             # <<<<<<<<<<<<<<
 *                          const weight_t* mat,
 *                          const weight_t* vec,
 */

static CYTHON_INLINE void __pyx_f_5thinc_6linalg_6MatVec_mul(__pyx_t_5thinc_6linalg_weight_t *__pyx_v_output, __pyx_t_5thinc_6linalg_weight_t const *__pyx_v_mat, __pyx_t_5thinc_6linalg_weight_t const *__pyx_v_vec, int32_t __pyx_v_nr_row, int32_t __pyx_v_nr_col) {

  /* "thinc/linalg.pxd":253
 *                          const weight_t* vec,
 *                          int32_t nr_row, int32_t nr_col) nogil:
 *         memcpy(output, mat, sizeof(output[0]) * nr_row * nr_col)             # <<<<<<<<<<<<<<
 *         MatVec.mul_i(output, vec, nr_row, nr_col)
 * 
 */
  memcpy(__pyx_v_output, __pyx_v_mat, (((sizeof((__pyx_v_output[0]))) * __pyx_v_nr_row) * __pyx_v_nr_col));

  /* "thinc/linalg.pxd":254
 *                          int32_t nr_row, int32_t nr_col) nogil:
 *         memcpy(output, mat, sizeof(output[0]) * nr_row * nr_col)
 *         MatVec.mul_i(output, vec, nr_row, nr_col)             # <<<<<<<<<<<<<<
 * 
 *     @staticmethod
 */
  __pyx_f_5thinc_6linalg_6MatVec_mul_i(__pyx_v_output, __pyx_v_vec, __pyx_v_nr_row, __pyx_v_nr_col);

  /* "thinc/linalg.pxd":249
 * cdef class MatVec:
 *     @staticmethod
 *     cdef inline void mul(weight_t* output,             # <<<<<<<<<<<<<<
 *                          const weight_t* mat,
 *                          const weight_t* vec,
 */

  /* function exit code */
}

/* "thinc/linalg.pxd":257
 * 
 *     @staticmethod
 *     cdef inline void mul_i(weight_t* mat,             # <<<<<<<<<<<<<<
 *                            const weight_t* vec,
 *                            int32_t nr_row, int32_t nr_col) nogil:
 */

static CYTHON_INLINE void __pyx_f_5thinc_6linalg_6MatVec_mul_i(__pyx_t_5thinc_6linalg_weight_t *__pyx_v_mat, __pyx_t_5thinc_6linalg_weight_t const *__pyx_v_vec, int32_t __pyx_v_nr_row, int32_t __pyx_v_nr_col) {
  int __pyx_v_i;
  int __pyx_v_row;
  int __pyx_v_col;
  int32_t __pyx_t_1;
  int __pyx_t_2;
  int32_t __pyx_t_3;
  int __pyx_t_4;
  int __pyx_t_5;

  /* "thinc/linalg.pxd":261
 *                            int32_t nr_row, int32_t nr_col) nogil:
 *         cdef int i, row, col
 *         for i in range(nr_row):             # <<<<<<<<<<<<<<
 *             row = i * nr_col
 *             for col in range(nr_col):
 */
  __pyx_t_1 = __pyx_v_nr_row;
  for (__pyx_t_2 = 0; __pyx_t_2 < __pyx_t_1; __pyx_t_2+=1) {
    __pyx_v_i = __pyx_t_2;

    /* "thinc/linalg.pxd":262
 *         cdef int i, row, col
 *         for i in range(nr_row):
 *             row = i * nr_col             # <<<<<<<<<<<<<<
 *             for col in range(nr_col):
 *                 mat[row + col] *= vec[col]
 */
    __pyx_v_row = (__pyx_v_i * __pyx_v_nr_col);

    /* "thinc/linalg.pxd":263
 *         for i in range(nr_row):
 *             row = i * nr_col
 *             for col in range(nr_col):             # <<<<<<<<<<<<<<
 *                 mat[row + col] *= vec[col]
 * 
 */
    __pyx_t_3 = __pyx_v_nr_col;
    for (__pyx_t_4 = 0; __pyx_t_4 < __pyx_t_3; __pyx_t_4+=1) {
      __pyx_v_col = __pyx_t_4;

      /* "thinc/linalg.pxd":264
 *             row = i * nr_col
 *             for col in range(nr_col):
 *                 mat[row + col] *= vec[col]             # <<<<<<<<<<<<<<
 * 
 *     @staticmethod
 */
      __pyx_t_5 = (__pyx_v_row + __pyx_v_col);
      (__pyx_v_mat[__pyx_t_5]) = ((__pyx_v_mat[__pyx_t_5]) * (__pyx_v_vec[__pyx_v_col]));
    }
  }

  /* "thinc/linalg.pxd":257
 * 
 *     @staticmethod
 *     cdef inline void mul_i(weight_t* mat,             # <<<<<<<<<<<<<<
 *                            const weight_t* vec,
 *                            int32_t nr_row, int32_t nr_col) nogil:
 */

  /* function exit code */
}

/* "thinc/linalg.pxd":267
 * 
 *     @staticmethod
 *     cdef inline void dot(weight_t* output,             # <<<<<<<<<<<<<<
 *                          const weight_t* mat,
 *                          const weight_t* vec,
 */

static CYTHON_INLINE void __pyx_f_5thinc_6linalg_6MatVec_dot(__pyx_t_5thinc_6linalg_weight_t *__pyx_v_output, __pyx_t_5thinc_6linalg_weight_t const *__pyx_v_mat, __pyx_t_5thinc_6linalg_weight_t const *__pyx_v_vec, int32_t __pyx_v_nr_row, int32_t __pyx_v_nr_col) {
  int __pyx_v_i;
  int __pyx_v_row;
  int __pyx_v_col;
  int32_t __pyx_t_1;
  int __pyx_t_2;
  int32_t __pyx_t_3;
  int __pyx_t_4;
  int __pyx_t_5;

  /* "thinc/linalg.pxd":288
 *             )
 *         else:
 *             for i in range(nr_row):             # <<<<<<<<<<<<<<
 *                 output[i] = 0
 *                 row = i * nr_col
 */
  __pyx_t_1 = __pyx_v_nr_row;
  for (__pyx_t_2 = 0; __pyx_t_2 < __pyx_t_1; __pyx_t_2+=1) {
    __pyx_v_i = __pyx_t_2;

    /* "thinc/linalg.pxd":289
 *         else:
 *             for i in range(nr_row):
 *                 output[i] = 0             # <<<<<<<<<<<<<<
 *                 row = i * nr_col
 *                 for col in range(nr_col):
 */
    (__pyx_v_output[__pyx_v_i]) = 0.0;

    /* "thinc/linalg.pxd":290
 *             for i in range(nr_row):
 *                 output[i] = 0
 *                 row = i * nr_col             # <<<<<<<<<<<<<<
 *                 for col in range(nr_col):
 *                     output[i] += mat[row + col] * vec[col]
 */
    __pyx_v_row = (__pyx_v_i * __pyx_v_nr_col);

    /* "thinc/linalg.pxd":291
 *                 output[i] = 0
 *                 row = i * nr_col
 *                 for col in range(nr_col):             # <<<<<<<<<<<<<<
 *                     output[i] += mat[row + col] * vec[col]
 * 
 */
    __pyx_t_3 = __pyx_v_nr_col;
    for (__pyx_t_4 = 0; __pyx_t_4 < __pyx_t_3; __pyx_t_4+=1) {
      __pyx_v_col = __pyx_t_4;

      /* "thinc/linalg.pxd":292
 *                 row = i * nr_col
 *                 for col in range(nr_col):
 *                     output[i] += mat[row + col] * vec[col]             # <<<<<<<<<<<<<<
 * 
 *     @staticmethod
 */
      __pyx_t_5 = __pyx_v_i;
      (__pyx_v_output[__pyx_t_5]) = ((__pyx_v_output[__pyx_t_5]) + ((__pyx_v_mat[(__pyx_v_row + __pyx_v_col)]) * (__pyx_v_vec[__pyx_v_col])));
    }
  }

  /* "thinc/linalg.pxd":267
 * 
 *     @staticmethod
 *     cdef inline void dot(weight_t* output,             # <<<<<<<<<<<<<<
 *                          const weight_t* mat,
 *                          const weight_t* vec,
 */

  /* function exit code */
}

/* "thinc/linalg.pxd":295
 * 
 *     @staticmethod
 *     cdef inline void T_dot(weight_t* output,             # <<<<<<<<<<<<<<
 *                              const weight_t* mat,
 *                              const weight_t* vec,
 */

static CYTHON_INLINE void __pyx_f_5thinc_6linalg_6MatVec_T_dot(__pyx_t_5thinc_6linalg_weight_t *__pyx_v_output, __pyx_t_5thinc_6linalg_weight_t const *__pyx_v_mat, __pyx_t_5thinc_6linalg_weight_t const *__pyx_v_vec, int32_t __pyx_v_nr_row, int32_t __pyx_v_nr_col) {
  int __pyx_v_row;
  int __pyx_v_col;
  int32_t __pyx_t_1;
  int __pyx_t_2;
  int32_t __pyx_t_3;
  int __pyx_t_4;
  int __pyx_t_5;

  /* "thinc/linalg.pxd":317
 *             )
 *         else:
 *             for row in range(nr_row):             # <<<<<<<<<<<<<<
 *                 for col in range(nr_col):
 *                     output[col] += vec[row] * mat[(row * nr_col) + col]
 */
  __pyx_t_1 = __pyx_v_nr_row;
  for (__pyx_t_2 = 0; __pyx_t_2 < __pyx_t_1; __pyx_t_2+=1) {
    __pyx_v_row = __pyx_t_2;

    /* "thinc/linalg.pxd":318
 *         else:
 *             for row in range(nr_row):
 *                 for col in range(nr_col):             # <<<<<<<<<<<<<<
 *                     output[col] += vec[row] * mat[(row * nr_col) + col]
 * 
 */
    __pyx_t_3 = __pyx_v_nr_col;
    for (__pyx_t_4 = 0; __pyx_t_4 < __pyx_t_3; __pyx_t_4+=1) {
      __pyx_v_col = __pyx_t_4;

      /* "thinc/linalg.pxd":319
 *             for row in range(nr_row):
 *                 for col in range(nr_col):
 *                     output[col] += vec[row] * mat[(row * nr_col) + col]             # <<<<<<<<<<<<<<
 * 
 * 
 */
      __pyx_t_5 = __pyx_v_col;
      (__pyx_v_output[__pyx_t_5]) = ((__pyx_v_output[__pyx_t_5]) + ((__pyx_v_vec[__pyx_v_row]) * (__pyx_v_mat[((__pyx_v_row * __pyx_v_nr_col) + __pyx_v_col)])));
    }
  }

  /* "thinc/linalg.pxd":295
 * 
 *     @staticmethod
 *     cdef inline void T_dot(weight_t* output,             # <<<<<<<<<<<<<<
 *                              const weight_t* mat,
 *                              const weight_t* vec,
 */

  /* function exit code */
}

/* "thinc/linalg.pxd":324
 * cdef class MatMat:
 *     @staticmethod
 *     cdef inline void add(weight_t* output,             # <<<<<<<<<<<<<<
 *                          const weight_t* x,
 *                          const weight_t* y,
 */

static CYTHON_INLINE void __pyx_f_5thinc_6linalg_6MatMat_add(__pyx_t_5thinc_6linalg_weight_t *__pyx_v_output, __pyx_t_5thinc_6linalg_weight_t const *__pyx_v_x, __pyx_t_5thinc_6linalg_weight_t const *__pyx_v_y, int32_t __pyx_v_nr_row, int32_t __pyx_v_nr_col) {

  /* "thinc/linalg.pxd":328
 *                          const weight_t* y,
 *                          int32_t nr_row, int32_t nr_col) nogil:
 *         memcpy(output, x, sizeof(output[0]) * nr_row * nr_col)             # <<<<<<<<<<<<<<
 *         MatMat.add_i(output, y, nr_row, nr_col)
 * 
 */
  memcpy(__pyx_v_output, __pyx_v_x, (((sizeof((__pyx_v_output[0]))) * __pyx_v_nr_row) * __pyx_v_nr_col));

  /* "thinc/linalg.pxd":329
 *                          int32_t nr_row, int32_t nr_col) nogil:
 *         memcpy(output, x, sizeof(output[0]) * nr_row * nr_col)
 *         MatMat.add_i(output, y, nr_row, nr_col)             # <<<<<<<<<<<<<<
 * 
 *     @staticmethod
 */
  __pyx_f_5thinc_6linalg_6MatMat_add_i(__pyx_v_output, __pyx_v_y, __pyx_v_nr_row, __pyx_v_nr_col);

  /* "thinc/linalg.pxd":324
 * cdef class MatMat:
 *     @staticmethod
 *     cdef inline void add(weight_t* output,             # <<<<<<<<<<<<<<
 *                          const weight_t* x,
 *                          const weight_t* y,
 */

  /* function exit code */
}

/* "thinc/linalg.pxd":332
 * 
 *     @staticmethod
 *     cdef inline void add_i(weight_t* x,             # <<<<<<<<<<<<<<
 *                            const weight_t* y,
 *                            int32_t nr_row, int32_t nr_col) nogil:
 */

static CYTHON_INLINE void __pyx_f_5thinc_6linalg_6MatMat_add_i(__pyx_t_5thinc_6linalg_weight_t *__pyx_v_x, __pyx_t_5thinc_6linalg_weight_t const *__pyx_v_y, int32_t __pyx_v_nr_row, int32_t __pyx_v_nr_col) {
  int __pyx_v_i;
  int __pyx_v_row;
  int __pyx_v_col;
  int32_t __pyx_t_1;
  int __pyx_t_2;
  int32_t __pyx_t_3;
  int __pyx_t_4;
  int __pyx_t_5;

  /* "thinc/linalg.pxd":336
 *                            int32_t nr_row, int32_t nr_col) nogil:
 *         cdef int i, row, col
 *         for i in range(nr_row):             # <<<<<<<<<<<<<<
 *             row = i * nr_col
 *             for col in range(nr_col):
 */
  __pyx_t_1 = __pyx_v_nr_row;
  for (__pyx_t_2 = 0; __pyx_t_2 < __pyx_t_1; __pyx_t_2+=1) {
    __pyx_v_i = __pyx_t_2;

    /* "thinc/linalg.pxd":337
 *         cdef int i, row, col
 *         for i in range(nr_row):
 *             row = i * nr_col             # <<<<<<<<<<<<<<
 *             for col in range(nr_col):
 *                 x[row + col] += y[row + col]
 */
    __pyx_v_row = (__pyx_v_i * __pyx_v_nr_col);

    /* "thinc/linalg.pxd":338
 *         for i in range(nr_row):
 *             row = i * nr_col
 *             for col in range(nr_col):             # <<<<<<<<<<<<<<
 *                 x[row + col] += y[row + col]
 * 
 */
    __pyx_t_3 = __pyx_v_nr_col;
    for (__pyx_t_4 = 0; __pyx_t_4 < __pyx_t_3; __pyx_t_4+=1) {
      __pyx_v_col = __pyx_t_4;

      /* "thinc/linalg.pxd":339
 *             row = i * nr_col
 *             for col in range(nr_col):
 *                 x[row + col] += y[row + col]             # <<<<<<<<<<<<<<
 * 
 *     @staticmethod
 */
      __pyx_t_5 = (__pyx_v_row + __pyx_v_col);
      (__pyx_v_x[__pyx_t_5]) = ((__pyx_v_x[__pyx_t_5]) + (__pyx_v_y[(__pyx_v_row + __pyx_v_col)]));
    }
  }

  /* "thinc/linalg.pxd":332
 * 
 *     @staticmethod
 *     cdef inline void add_i(weight_t* x,             # <<<<<<<<<<<<<<
 *                            const weight_t* y,
 *                            int32_t nr_row, int32_t nr_col) nogil:
 */

  /* function exit code */
}

/* "thinc/linalg.pxd":342
 * 
 *     @staticmethod
 *     cdef inline void mul(weight_t* output,             # <<<<<<<<<<<<<<
 *                          const weight_t* x,
 *                          const weight_t* y,
 */

static CYTHON_INLINE void __pyx_f_5thinc_6linalg_6MatMat_mul(__pyx_t_5thinc_6linalg_weight_t *__pyx_v_output, __pyx_t_5thinc_6linalg_weight_t const *__pyx_v_x, __pyx_t_5thinc_6linalg_weight_t const *__pyx_v_y, int32_t __pyx_v_nr_row, int32_t __pyx_v_nr_col) {

  /* "thinc/linalg.pxd":346
 *                          const weight_t* y,
 *                          int32_t nr_row, int32_t nr_col) nogil:
 *         memcpy(output, x, sizeof(output[0]) * nr_row * nr_col)             # <<<<<<<<<<<<<<
 *         MatMat.mul_i(output, y, nr_row, nr_col)
 * 
 */
  memcpy(__pyx_v_output, __pyx_v_x, (((sizeof((__pyx_v_output[0]))) * __pyx_v_nr_row) * __pyx_v_nr_col));

  /* "thinc/linalg.pxd":347
 *                          int32_t nr_row, int32_t nr_col) nogil:
 *         memcpy(output, x, sizeof(output[0]) * nr_row * nr_col)
 *         MatMat.mul_i(output, y, nr_row, nr_col)             # <<<<<<<<<<<<<<
 * 
 *     @staticmethod
 */
  __pyx_f_5thinc_6linalg_6MatMat_mul_i(__pyx_v_output, __pyx_v_y, __pyx_v_nr_row, __pyx_v_nr_col);

  /* "thinc/linalg.pxd":342
 * 
 *     @staticmethod
 *     cdef inline void mul(weight_t* output,             # <<<<<<<<<<<<<<
 *                          const weight_t* x,
 *                          const weight_t* y,
 */

  /* function exit code */
}

/* "thinc/linalg.pxd":350
 * 
 *     @staticmethod
 *     cdef inline void mul_i(weight_t* x,             # <<<<<<<<<<<<<<
 *                            const weight_t* y,
 *                            int32_t nr_row, int32_t nr_col) nogil:
 */

static CYTHON_INLINE void __pyx_f_5thinc_6linalg_6MatMat_mul_i(__pyx_t_5thinc_6linalg_weight_t *__pyx_v_x, __pyx_t_5thinc_6linalg_weight_t const *__pyx_v_y, int32_t __pyx_v_nr_row, int32_t __pyx_v_nr_col) {
  int __pyx_v_i;
  int __pyx_v_row;
  int __pyx_v_col;
  int32_t __pyx_t_1;
  int __pyx_t_2;
  int32_t __pyx_t_3;
  int __pyx_t_4;
  int __pyx_t_5;

  /* "thinc/linalg.pxd":354
 *                            int32_t nr_row, int32_t nr_col) nogil:
 *         cdef int i, row, col
 *         for i in range(nr_row):             # <<<<<<<<<<<<<<
 *             row = i * nr_col
 *             for col in range(nr_col):
 */
  __pyx_t_1 = __pyx_v_nr_row;
  for (__pyx_t_2 = 0; __pyx_t_2 < __pyx_t_1; __pyx_t_2+=1) {
    __pyx_v_i = __pyx_t_2;

    /* "thinc/linalg.pxd":355
 *         cdef int i, row, col
 *         for i in range(nr_row):
 *             row = i * nr_col             # <<<<<<<<<<<<<<
 *             for col in range(nr_col):
 *                 x[row + col] *= y[row + col]
 */
    __pyx_v_row = (__pyx_v_i * __pyx_v_nr_col);

    /* "thinc/linalg.pxd":356
 *         for i in range(nr_row):
 *             row = i * nr_col
 *             for col in range(nr_col):             # <<<<<<<<<<<<<<
 *                 x[row + col] *= y[row + col]
 * 
 */
    __pyx_t_3 = __pyx_v_nr_col;
    for (__pyx_t_4 = 0; __pyx_t_4 < __pyx_t_3; __pyx_t_4+=1) {
      __pyx_v_col = __pyx_t_4;

      /* "thinc/linalg.pxd":357
 *             row = i * nr_col
 *             for col in range(nr_col):
 *                 x[row + col] *= y[row + col]             # <<<<<<<<<<<<<<
 * 
 *     @staticmethod
 */
      __pyx_t_5 = (__pyx_v_row + __pyx_v_col);
      (__pyx_v_x[__pyx_t_5]) = ((__pyx_v_x[__pyx_t_5]) * (__pyx_v_y[(__pyx_v_row + __pyx_v_col)]));
    }
  }

  /* "thinc/linalg.pxd":350
 * 
 *     @staticmethod
 *     cdef inline void mul_i(weight_t* x,             # <<<<<<<<<<<<<<
 *                            const weight_t* y,
 *                            int32_t nr_row, int32_t nr_col) nogil:
 */

  /* function exit code */
}

/* "thinc/linalg.pxd":360
 * 
 *     @staticmethod
 *     cdef inline void add_outer_i(weight_t* mat,             # <<<<<<<<<<<<<<
 *                                  const weight_t* x,
 *                                  const weight_t* y,
 */

static CYTHON_INLINE void __pyx_f_5thinc_6linalg_6MatMat_add_outer_i(__pyx_t_5thinc_6linalg_weight_t *__pyx_v_mat, __pyx_t_5thinc_6linalg_weight_t const *__pyx_v_x, __pyx_t_5thinc_6linalg_weight_t const *__pyx_v_y, int32_t __pyx_v_nr_row, int32_t __pyx_v_nr_col) {
  int __pyx_v_i;
  int __pyx_v_j;
  int __pyx_v_row;
  int32_t __pyx_t_1;
  int __pyx_t_2;
  int32_t __pyx_t_3;
  int __pyx_t_4;
  int __pyx_t_5;

  /* "thinc/linalg.pxd":366
 *                                  int32_t nr_col) nogil:
 *         cdef int i, j, row
 *         for i in range(nr_row):             # <<<<<<<<<<<<<<
 *             row = i * nr_col
 *             for j in range(nr_col):
 */
  __pyx_t_1 = __pyx_v_nr_row;
  for (__pyx_t_2 = 0; __pyx_t_2 < __pyx_t_1; __pyx_t_2+=1) {
    __pyx_v_i = __pyx_t_2;

    /* "thinc/linalg.pxd":367
 *         cdef int i, j, row
 *         for i in range(nr_row):
 *             row = i * nr_col             # <<<<<<<<<<<<<<
 *             for j in range(nr_col):
 *                 mat[row + j] += x[i] * y[j]
 */
    __pyx_v_row = (__pyx_v_i * __pyx_v_nr_col);

    /* "thinc/linalg.pxd":368
 *         for i in range(nr_row):
 *             row = i * nr_col
 *             for j in range(nr_col):             # <<<<<<<<<<<<<<
 *                 mat[row + j] += x[i] * y[j]
 */
    __pyx_t_3 = __pyx_v_nr_col;
    for (__pyx_t_4 = 0; __pyx_t_4 < __pyx_t_3; __pyx_t_4+=1) {
      __pyx_v_j = __pyx_t_4;

      /* "thinc/linalg.pxd":369
 *             row = i * nr_col
 *             for j in range(nr_col):
 *                 mat[row + j] += x[i] * y[j]             # <<<<<<<<<<<<<<
 */
      __pyx_t_5 = (__pyx_v_row + __pyx_v_j);
      (__pyx_v_mat[__pyx_t_5]) = ((__pyx_v_mat[__pyx_t_5]) + ((__pyx_v_x[__pyx_v_i]) * (__pyx_v_y[__pyx_v_j])));
    }
  }

  /* "thinc/linalg.pxd":360
 * 
 *     @staticmethod
 *     cdef inline void add_outer_i(weight_t* mat,             # <<<<<<<<<<<<<<
 *                                  const weight_t* x,
 *                                  const weight_t* y,
 */

  /* function exit code */
}

static PyObject *__pyx_tp_new_5thinc_6linalg_Matrix(PyTypeObject *t, CYTHON_UNUSED PyObject *a, CYTHON_UNUSED PyObject *k) {
  struct __pyx_obj_5thinc_6linalg_Matrix *p;
  PyObject *o;
  if (likely((t->tp_flags & Py_TPFLAGS_IS_ABSTRACT) == 0)) {
    o = (*t->tp_alloc)(t, 0);
  } else {
    o = (PyObject *) PyBaseObject_Type.tp_new(t, __pyx_empty_tuple, 0);
  }
  if (unlikely(!o)) return 0;
  p = ((struct __pyx_obj_5thinc_6linalg_Matrix *)o);
  p->mem = ((struct __pyx_obj_5cymem_5cymem_Pool *)Py_None); Py_INCREF(Py_None);
  return o;
}

static void __pyx_tp_dealloc_5thinc_6linalg_Matrix(PyObject *o) {
  struct __pyx_obj_5thinc_6linalg_Matrix *p = (struct __pyx_obj_5thinc_6linalg_Matrix *)o;
  #if PY_VERSION_HEX >= 0x030400a1
  if (unlikely(Py_TYPE(o)->tp_finalize) && !_PyGC_FINALIZED(o)) {
    if (PyObject_CallFinalizerFromDealloc(o)) return;
  }
  #endif
  PyObject_GC_UnTrack(o);
  Py_CLEAR(p->mem);
  (*Py_TYPE(o)->tp_free)(o);
}

static int __pyx_tp_traverse_5thinc_6linalg_Matrix(PyObject *o, visitproc v, void *a) {
  int e;
  struct __pyx_obj_5thinc_6linalg_Matrix *p = (struct __pyx_obj_5thinc_6linalg_Matrix *)o;
  if (p->mem) {
    e = (*v)(((PyObject*)p->mem), a); if (e) return e;
  }
  return 0;
}

static int __pyx_tp_clear_5thinc_6linalg_Matrix(PyObject *o) {
  PyObject* tmp;
  struct __pyx_obj_5thinc_6linalg_Matrix *p = (struct __pyx_obj_5thinc_6linalg_Matrix *)o;
  tmp = ((PyObject*)p->mem);
  p->mem = ((struct __pyx_obj_5cymem_5cymem_Pool *)Py_None); Py_INCREF(Py_None);
  Py_XDECREF(tmp);
  return 0;
}

static PyTypeObject __pyx_type_5thinc_6linalg_Matrix = {
  PyVarObject_HEAD_INIT(0, 0)
  "thinc.linalg.Matrix", /*tp_name*/
  sizeof(struct __pyx_obj_5thinc_6linalg_Matrix), /*tp_basicsize*/
  0, /*tp_itemsize*/
  __pyx_tp_dealloc_5thinc_6linalg_Matrix, /*tp_dealloc*/
  0, /*tp_print*/
  0, /*tp_getattr*/
  0, /*tp_setattr*/
  #if PY_MAJOR_VERSION < 3
  0, /*tp_compare*/
  #endif
  #if PY_MAJOR_VERSION >= 3
  0, /*tp_as_async*/
  #endif
  0, /*tp_repr*/
  0, /*tp_as_number*/
  0, /*tp_as_sequence*/
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  0, /*tp_as_buffer*/
  Py_TPFLAGS_DEFAULT|Py_TPFLAGS_HAVE_VERSION_TAG|Py_TPFLAGS_CHECKTYPES|Py_TPFLAGS_HAVE_NEWBUFFER|Py_TPFLAGS_BASETYPE|Py_TPFLAGS_HAVE_GC, /*tp_flags*/
  0, /*tp_doc*/
  __pyx_tp_traverse_5thinc_6linalg_Matrix, /*tp_traverse*/
  __pyx_tp_clear_5thinc_6linalg_Matrix, /*tp_clear*/
  0, /*tp_richcompare*/
  0, /*tp_weaklistoffset*/
  0, /*tp_iter*/
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  0, /*tp_alloc*/
  __pyx_tp_new_5thinc_6linalg_Matrix, /*tp_new*/
  0, /*tp_free*/
  0, /*tp_is_gc*/
  0, /*tp_bases*/
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  0, /*tp_version_tag*/
  #if PY_VERSION_HEX >= 0x030400a1
  0, /*tp_finalize*/
  #endif
};
static struct __pyx_vtabstruct_5thinc_6linalg_Vec __pyx_vtable_5thinc_6linalg_Vec;

static PyObject *__pyx_tp_new_5thinc_6linalg_Vec(PyTypeObject *t, CYTHON_UNUSED PyObject *a, CYTHON_UNUSED PyObject *k) {
  struct __pyx_obj_5thinc_6linalg_Vec *p;
  PyObject *o;
  if (likely((t->tp_flags & Py_TPFLAGS_IS_ABSTRACT) == 0)) {
    o = (*t->tp_alloc)(t, 0);
  } else {
    o = (PyObject *) PyBaseObject_Type.tp_new(t, __pyx_empty_tuple, 0);
  }
  if (unlikely(!o)) return 0;
  p = ((struct __pyx_obj_5thinc_6linalg_Vec *)o);
  p->__pyx_vtab = __pyx_vtabptr_5thinc_6linalg_Vec;
  return o;
}

static void __pyx_tp_dealloc_5thinc_6linalg_Vec(PyObject *o) {
  #if PY_VERSION_HEX >= 0x030400a1
  if (unlikely(Py_TYPE(o)->tp_finalize) && (!PyType_IS_GC(Py_TYPE(o)) || !_PyGC_FINALIZED(o))) {
    if (PyObject_CallFinalizerFromDealloc(o)) return;
  }
  #endif
  (*Py_TYPE(o)->tp_free)(o);
}

static PyTypeObject __pyx_type_5thinc_6linalg_Vec = {
  PyVarObject_HEAD_INIT(0, 0)
  "thinc.linalg.Vec", /*tp_name*/
  sizeof(struct __pyx_obj_5thinc_6linalg_Vec), /*tp_basicsize*/
  0, /*tp_itemsize*/
  __pyx_tp_dealloc_5thinc_6linalg_Vec, /*tp_dealloc*/
  0, /*tp_print*/
  0, /*tp_getattr*/
  0, /*tp_setattr*/
  #if PY_MAJOR_VERSION < 3
  0, /*tp_compare*/
  #endif
  #if PY_MAJOR_VERSION >= 3
  0, /*tp_as_async*/
  #endif
  0, /*tp_repr*/
  0, /*tp_as_number*/
  0, /*tp_as_sequence*/
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  0, /*tp_as_buffer*/
  Py_TPFLAGS_DEFAULT|Py_TPFLAGS_HAVE_VERSION_TAG|Py_TPFLAGS_CHECKTYPES|Py_TPFLAGS_HAVE_NEWBUFFER|Py_TPFLAGS_BASETYPE, /*tp_flags*/
  0, /*tp_doc*/
  0, /*tp_traverse*/
  0, /*tp_clear*/
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  0, /*tp_alloc*/
  __pyx_tp_new_5thinc_6linalg_Vec, /*tp_new*/
  0, /*tp_free*/
  0, /*tp_is_gc*/
  0, /*tp_bases*/
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  0, /*tp_version_tag*/
  #if PY_VERSION_HEX >= 0x030400a1
  0, /*tp_finalize*/
  #endif
};
static struct __pyx_vtabstruct_5thinc_6linalg_VecVec __pyx_vtable_5thinc_6linalg_VecVec;

static PyObject *__pyx_tp_new_5thinc_6linalg_VecVec(PyTypeObject *t, CYTHON_UNUSED PyObject *a, CYTHON_UNUSED PyObject *k) {
  struct __pyx_obj_5thinc_6linalg_VecVec *p;
  PyObject *o;
  if (likely((t->tp_flags & Py_TPFLAGS_IS_ABSTRACT) == 0)) {
    o = (*t->tp_alloc)(t, 0);
  } else {
    o = (PyObject *) PyBaseObject_Type.tp_new(t, __pyx_empty_tuple, 0);
  }
  if (unlikely(!o)) return 0;
  p = ((struct __pyx_obj_5thinc_6linalg_VecVec *)o);
  p->__pyx_vtab = __pyx_vtabptr_5thinc_6linalg_VecVec;
  return o;
}

static void __pyx_tp_dealloc_5thinc_6linalg_VecVec(PyObject *o) {
  #if PY_VERSION_HEX >= 0x030400a1
  if (unlikely(Py_TYPE(o)->tp_finalize) && (!PyType_IS_GC(Py_TYPE(o)) || !_PyGC_FINALIZED(o))) {
    if (PyObject_CallFinalizerFromDealloc(o)) return;
  }
  #endif
  (*Py_TYPE(o)->tp_free)(o);
}

static PyTypeObject __pyx_type_5thinc_6linalg_VecVec = {
  PyVarObject_HEAD_INIT(0, 0)
  "thinc.linalg.VecVec", /*tp_name*/
  sizeof(struct __pyx_obj_5thinc_6linalg_VecVec), /*tp_basicsize*/
  0, /*tp_itemsize*/
  __pyx_tp_dealloc_5thinc_6linalg_VecVec, /*tp_dealloc*/
  0, /*tp_print*/
  0, /*tp_getattr*/
  0, /*tp_setattr*/
  #if PY_MAJOR_VERSION < 3
  0, /*tp_compare*/
  #endif
  #if PY_MAJOR_VERSION >= 3
  0, /*tp_as_async*/
  #endif
  0, /*tp_repr*/
  0, /*tp_as_number*/
  0, /*tp_as_sequence*/
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  0, /*tp_as_buffer*/
  Py_TPFLAGS_DEFAULT|Py_TPFLAGS_HAVE_VERSION_TAG|Py_TPFLAGS_CHECKTYPES|Py_TPFLAGS_HAVE_NEWBUFFER|Py_TPFLAGS_BASETYPE, /*tp_flags*/
  0, /*tp_doc*/
  0, /*tp_traverse*/
  0, /*tp_clear*/
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  0, /*tp_alloc*/
  __pyx_tp_new_5thinc_6linalg_VecVec, /*tp_new*/
  0, /*tp_free*/
  0, /*tp_is_gc*/
  0, /*tp_bases*/
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  0, /*tp_version_tag*/
  #if PY_VERSION_HEX >= 0x030400a1
  0, /*tp_finalize*/
  #endif
};
static struct __pyx_vtabstruct_5thinc_6linalg_MatVec __pyx_vtable_5thinc_6linalg_MatVec;

static PyObject *__pyx_tp_new_5thinc_6linalg_MatVec(PyTypeObject *t, CYTHON_UNUSED PyObject *a, CYTHON_UNUSED PyObject *k) {
  struct __pyx_obj_5thinc_6linalg_MatVec *p;
  PyObject *o;
  if (likely((t->tp_flags & Py_TPFLAGS_IS_ABSTRACT) == 0)) {
    o = (*t->tp_alloc)(t, 0);
  } else {
    o = (PyObject *) PyBaseObject_Type.tp_new(t, __pyx_empty_tuple, 0);
  }
  if (unlikely(!o)) return 0;
  p = ((struct __pyx_obj_5thinc_6linalg_MatVec *)o);
  p->__pyx_vtab = __pyx_vtabptr_5thinc_6linalg_MatVec;
  return o;
}

static void __pyx_tp_dealloc_5thinc_6linalg_MatVec(PyObject *o) {
  #if PY_VERSION_HEX >= 0x030400a1
  if (unlikely(Py_TYPE(o)->tp_finalize) && (!PyType_IS_GC(Py_TYPE(o)) || !_PyGC_FINALIZED(o))) {
    if (PyObject_CallFinalizerFromDealloc(o)) return;
  }
  #endif
  (*Py_TYPE(o)->tp_free)(o);
}

static PyTypeObject __pyx_type_5thinc_6linalg_MatVec = {
  PyVarObject_HEAD_INIT(0, 0)
  "thinc.linalg.MatVec", /*tp_name*/
  sizeof(struct __pyx_obj_5thinc_6linalg_MatVec), /*tp_basicsize*/
  0, /*tp_itemsize*/
  __pyx_tp_dealloc_5thinc_6linalg_MatVec, /*tp_dealloc*/
  0, /*tp_print*/
  0, /*tp_getattr*/
  0, /*tp_setattr*/
  #if PY_MAJOR_VERSION < 3
  0, /*tp_compare*/
  #endif
  #if PY_MAJOR_VERSION >= 3
  0, /*tp_as_async*/
  #endif
  0, /*tp_repr*/
  0, /*tp_as_number*/
  0, /*tp_as_sequence*/
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  0, /*tp_as_buffer*/
  Py_TPFLAGS_DEFAULT|Py_TPFLAGS_HAVE_VERSION_TAG|Py_TPFLAGS_CHECKTYPES|Py_TPFLAGS_HAVE_NEWBUFFER|Py_TPFLAGS_BASETYPE, /*tp_flags*/
  0, /*tp_doc*/
  0, /*tp_traverse*/
  0, /*tp_clear*/
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  0, /*tp_alloc*/
  __pyx_tp_new_5thinc_6linalg_MatVec, /*tp_new*/
  0, /*tp_free*/
  0, /*tp_is_gc*/
  0, /*tp_bases*/
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  0, /*tp_version_tag*/
  #if PY_VERSION_HEX >= 0x030400a1
  0, /*tp_finalize*/
  #endif
};
static struct __pyx_vtabstruct_5thinc_6linalg_MatMat __pyx_vtable_5thinc_6linalg_MatMat;

static PyObject *__pyx_tp_new_5thinc_6linalg_MatMat(PyTypeObject *t, CYTHON_UNUSED PyObject *a, CYTHON_UNUSED PyObject *k) {
  struct __pyx_obj_5thinc_6linalg_MatMat *p;
  PyObject *o;
  if (likely((t->tp_flags & Py_TPFLAGS_IS_ABSTRACT) == 0)) {
    o = (*t->tp_alloc)(t, 0);
  } else {
    o = (PyObject *) PyBaseObject_Type.tp_new(t, __pyx_empty_tuple, 0);
  }
  if (unlikely(!o)) return 0;
  p = ((struct __pyx_obj_5thinc_6linalg_MatMat *)o);
  p->__pyx_vtab = __pyx_vtabptr_5thinc_6linalg_MatMat;
  return o;
}

static void __pyx_tp_dealloc_5thinc_6linalg_MatMat(PyObject *o) {
  #if PY_VERSION_HEX >= 0x030400a1
  if (unlikely(Py_TYPE(o)->tp_finalize) && (!PyType_IS_GC(Py_TYPE(o)) || !_PyGC_FINALIZED(o))) {
    if (PyObject_CallFinalizerFromDealloc(o)) return;
  }
  #endif
  (*Py_TYPE(o)->tp_free)(o);
}

static PyTypeObject __pyx_type_5thinc_6linalg_MatMat = {
  PyVarObject_HEAD_INIT(0, 0)
  "thinc.linalg.MatMat", /*tp_name*/
  sizeof(struct __pyx_obj_5thinc_6linalg_MatMat), /*tp_basicsize*/
  0, /*tp_itemsize*/
  __pyx_tp_dealloc_5thinc_6linalg_MatMat, /*tp_dealloc*/
  0, /*tp_print*/
  0, /*tp_getattr*/
  0, /*tp_setattr*/
  #if PY_MAJOR_VERSION < 3
  0, /*tp_compare*/
  #endif
  #if PY_MAJOR_VERSION >= 3
  0, /*tp_as_async*/
  #endif
  0, /*tp_repr*/
  0, /*tp_as_number*/
  0, /*tp_as_sequence*/
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  0, /*tp_as_buffer*/
  Py_TPFLAGS_DEFAULT|Py_TPFLAGS_HAVE_VERSION_TAG|Py_TPFLAGS_CHECKTYPES|Py_TPFLAGS_HAVE_NEWBUFFER|Py_TPFLAGS_BASETYPE, /*tp_flags*/
  0, /*tp_doc*/
  0, /*tp_traverse*/
  0, /*tp_clear*/
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  0, /*tp_alloc*/
  __pyx_tp_new_5thinc_6linalg_MatMat, /*tp_new*/
  0, /*tp_free*/
  0, /*tp_is_gc*/
  0, /*tp_bases*/
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  0, /*tp_version_tag*/
  #if PY_VERSION_HEX >= 0x030400a1
  0, /*tp_finalize*/
  #endif
};

static PyMethodDef __pyx_methods[] = {
  {0, 0, 0, 0}
};

#if PY_MAJOR_VERSION >= 3
static struct PyModuleDef __pyx_moduledef = {
  #if PY_VERSION_HEX < 0x03020000
    { PyObject_HEAD_INIT(NULL) NULL, 0, NULL },
  #else
    PyModuleDef_HEAD_INIT,
  #endif
    "linalg",
    0, /* m_doc */
    -1, /* m_size */
    __pyx_methods /* m_methods */,
    NULL, /* m_reload */
    NULL, /* m_traverse */
    NULL, /* m_clear */
    NULL /* m_free */
};
#endif

static __Pyx_StringTabEntry __pyx_string_tab[] = {
  {&__pyx_n_s_main, __pyx_k_main, sizeof(__pyx_k_main), 0, 0, 1, 1},
  {&__pyx_n_s_pyx_vtable, __pyx_k_pyx_vtable, sizeof(__pyx_k_pyx_vtable), 0, 0, 1, 1},
  {&__pyx_n_s_range, __pyx_k_range, sizeof(__pyx_k_range), 0, 0, 1, 1},
  {&__pyx_n_s_test, __pyx_k_test, sizeof(__pyx_k_test), 0, 0, 1, 1},
  {0, 0, 0, 0, 0, 0, 0}
};
static int __Pyx_InitCachedBuiltins(void) {
  __pyx_builtin_range = __Pyx_GetBuiltinName(__pyx_n_s_range); if (!__pyx_builtin_range) {__pyx_filename = __pyx_f[0]; __pyx_lineno = 67; __pyx_clineno = __LINE__; goto __pyx_L1_error;}
  return 0;
  __pyx_L1_error:;
  return -1;
}

static int __Pyx_InitCachedConstants(void) {
  __Pyx_RefNannyDeclarations
  __Pyx_RefNannySetupContext("__Pyx_InitCachedConstants", 0);
  __Pyx_RefNannyFinishContext();
  return 0;
}

static int __Pyx_InitGlobals(void) {
  if (__Pyx_InitStrings(__pyx_string_tab) < 0) {__pyx_filename = __pyx_f[1]; __pyx_lineno = 1; __pyx_clineno = __LINE__; goto __pyx_L1_error;};
  return 0;
  __pyx_L1_error:;
  return -1;
}

#if PY_MAJOR_VERSION < 3
PyMODINIT_FUNC initlinalg(void); /*proto*/
PyMODINIT_FUNC initlinalg(void)
#else
PyMODINIT_FUNC PyInit_linalg(void); /*proto*/
PyMODINIT_FUNC PyInit_linalg(void)
#endif
{
  PyObject *__pyx_t_1 = NULL;
  int __pyx_lineno = 0;
  const char *__pyx_filename = NULL;
  int __pyx_clineno = 0;
  __Pyx_RefNannyDeclarations
  #if CYTHON_REFNANNY
  __Pyx_RefNanny = __Pyx_RefNannyImportAPI("refnanny");
  if (!__Pyx_RefNanny) {
      PyErr_Clear();
      __Pyx_RefNanny = __Pyx_RefNannyImportAPI("Cython.Runtime.refnanny");
      if (!__Pyx_RefNanny)
          Py_FatalError("failed to import 'refnanny' module");
  }
  #endif
  __Pyx_RefNannySetupContext("PyMODINIT_FUNC PyInit_linalg(void)", 0);
  if (__Pyx_check_binary_version() < 0) {__pyx_filename = __pyx_f[1]; __pyx_lineno = 1; __pyx_clineno = __LINE__; goto __pyx_L1_error;}
  __pyx_empty_tuple = PyTuple_New(0); if (unlikely(!__pyx_empty_tuple)) {__pyx_filename = __pyx_f[1]; __pyx_lineno = 1; __pyx_clineno = __LINE__; goto __pyx_L1_error;}
  __pyx_empty_bytes = PyBytes_FromStringAndSize("", 0); if (unlikely(!__pyx_empty_bytes)) {__pyx_filename = __pyx_f[1]; __pyx_lineno = 1; __pyx_clineno = __LINE__; goto __pyx_L1_error;}
  #ifdef __Pyx_CyFunction_USED
  if (__pyx_CyFunction_init() < 0) {__pyx_filename = __pyx_f[1]; __pyx_lineno = 1; __pyx_clineno = __LINE__; goto __pyx_L1_error;}
  #endif
  #ifdef __Pyx_FusedFunction_USED
  if (__pyx_FusedFunction_init() < 0) {__pyx_filename = __pyx_f[1]; __pyx_lineno = 1; __pyx_clineno = __LINE__; goto __pyx_L1_error;}
  #endif
  #ifdef __Pyx_Coroutine_USED
  if (__pyx_Coroutine_init() < 0) {__pyx_filename = __pyx_f[1]; __pyx_lineno = 1; __pyx_clineno = __LINE__; goto __pyx_L1_error;}
  #endif
  #ifdef __Pyx_Generator_USED
  if (__pyx_Generator_init() < 0) {__pyx_filename = __pyx_f[1]; __pyx_lineno = 1; __pyx_clineno = __LINE__; goto __pyx_L1_error;}
  #endif
  #ifdef __Pyx_StopAsyncIteration_USED
  if (__pyx_StopAsyncIteration_init() < 0) {__pyx_filename = __pyx_f[1]; __pyx_lineno = 1; __pyx_clineno = __LINE__; goto __pyx_L1_error;}
  #endif
  /*--- Library function declarations ---*/
  /*--- Threads initialization code ---*/
  #if defined(__PYX_FORCE_INIT_THREADS) && __PYX_FORCE_INIT_THREADS
  #ifdef WITH_THREAD /* Python build with threading support? */
  PyEval_InitThreads();
  #endif
  #endif
  /*--- Module creation code ---*/
  #if PY_MAJOR_VERSION < 3
  __pyx_m = Py_InitModule4("linalg", __pyx_methods, 0, 0, PYTHON_API_VERSION); Py_XINCREF(__pyx_m);
  #else
  __pyx_m = PyModule_Create(&__pyx_moduledef);
  #endif
  if (unlikely(!__pyx_m)) {__pyx_filename = __pyx_f[1]; __pyx_lineno = 1; __pyx_clineno = __LINE__; goto __pyx_L1_error;}
  __pyx_d = PyModule_GetDict(__pyx_m); if (unlikely(!__pyx_d)) {__pyx_filename = __pyx_f[1]; __pyx_lineno = 1; __pyx_clineno = __LINE__; goto __pyx_L1_error;}
  Py_INCREF(__pyx_d);
  __pyx_b = PyImport_AddModule(__Pyx_BUILTIN_MODULE_NAME); if (unlikely(!__pyx_b)) {__pyx_filename = __pyx_f[1]; __pyx_lineno = 1; __pyx_clineno = __LINE__; goto __pyx_L1_error;}
  #if CYTHON_COMPILING_IN_PYPY
  Py_INCREF(__pyx_b);
  #endif
  if (PyObject_SetAttrString(__pyx_m, "__builtins__", __pyx_b) < 0) {__pyx_filename = __pyx_f[1]; __pyx_lineno = 1; __pyx_clineno = __LINE__; goto __pyx_L1_error;};
  /*--- Initialize various global constants etc. ---*/
  if (__Pyx_InitGlobals() < 0) {__pyx_filename = __pyx_f[1]; __pyx_lineno = 1; __pyx_clineno = __LINE__; goto __pyx_L1_error;}
  #if PY_MAJOR_VERSION < 3 && (__PYX_DEFAULT_STRING_ENCODING_IS_ASCII || __PYX_DEFAULT_STRING_ENCODING_IS_DEFAULT)
  if (__Pyx_init_sys_getdefaultencoding_params() < 0) {__pyx_filename = __pyx_f[1]; __pyx_lineno = 1; __pyx_clineno = __LINE__; goto __pyx_L1_error;}
  #endif
  if (__pyx_module_is_main_thinc__linalg) {
    if (PyObject_SetAttrString(__pyx_m, "__name__", __pyx_n_s_main) < 0) {__pyx_filename = __pyx_f[1]; __pyx_lineno = 1; __pyx_clineno = __LINE__; goto __pyx_L1_error;}
  }
  #if PY_MAJOR_VERSION >= 3
  {
    PyObject *modules = PyImport_GetModuleDict(); if (unlikely(!modules)) {__pyx_filename = __pyx_f[1]; __pyx_lineno = 1; __pyx_clineno = __LINE__; goto __pyx_L1_error;}
    if (!PyDict_GetItemString(modules, "thinc.linalg")) {
      if (unlikely(PyDict_SetItemString(modules, "thinc.linalg", __pyx_m) < 0)) {__pyx_filename = __pyx_f[1]; __pyx_lineno = 1; __pyx_clineno = __LINE__; goto __pyx_L1_error;}
    }
  }
  #endif
  /*--- Builtin init code ---*/
  if (__Pyx_InitCachedBuiltins() < 0) {__pyx_filename = __pyx_f[1]; __pyx_lineno = 1; __pyx_clineno = __LINE__; goto __pyx_L1_error;}
  /*--- Constants init code ---*/
  if (__Pyx_InitCachedConstants() < 0) {__pyx_filename = __pyx_f[1]; __pyx_lineno = 1; __pyx_clineno = __LINE__; goto __pyx_L1_error;}
  /*--- Global init code ---*/
  /*--- Variable export code ---*/
  /*--- Function export code ---*/
  /*--- Type init code ---*/
  if (PyType_Ready(&__pyx_type_5thinc_6linalg_Matrix) < 0) {__pyx_filename = __pyx_f[0]; __pyx_lineno = 54; __pyx_clineno = __LINE__; goto __pyx_L1_error;}
  __pyx_type_5thinc_6linalg_Matrix.tp_print = 0;
  if (PyObject_SetAttrString(__pyx_m, "Matrix", (PyObject *)&__pyx_type_5thinc_6linalg_Matrix) < 0) {__pyx_filename = __pyx_f[0]; __pyx_lineno = 54; __pyx_clineno = __LINE__; goto __pyx_L1_error;}
  __pyx_ptype_5thinc_6linalg_Matrix = &__pyx_type_5thinc_6linalg_Matrix;
  __pyx_vtabptr_5thinc_6linalg_Vec = &__pyx_vtable_5thinc_6linalg_Vec;
  __pyx_vtable_5thinc_6linalg_Vec.arg_max = (int (*)(__pyx_t_5thinc_6linalg_weight_t const *, int const ))__pyx_f_5thinc_6linalg_3Vec_arg_max;
  __pyx_vtable_5thinc_6linalg_Vec.max = (__pyx_t_5thinc_6linalg_weight_t (*)(__pyx_t_5thinc_6linalg_weight_t const *, int32_t))__pyx_f_5thinc_6linalg_3Vec_max;
  __pyx_vtable_5thinc_6linalg_Vec.sum = (__pyx_t_5thinc_6linalg_weight_t (*)(__pyx_t_5thinc_6linalg_weight_t const *, int32_t))__pyx_f_5thinc_6linalg_3Vec_sum;
  __pyx_vtable_5thinc_6linalg_Vec.add = (void (*)(__pyx_t_5thinc_6linalg_weight_t *, __pyx_t_5thinc_6linalg_weight_t const *, __pyx_t_5thinc_6linalg_weight_t, int32_t))__pyx_f_5thinc_6linalg_3Vec_add;
  __pyx_vtable_5thinc_6linalg_Vec.add_i = (void (*)(__pyx_t_5thinc_6linalg_weight_t *, __pyx_t_5thinc_6linalg_weight_t, int32_t))__pyx_f_5thinc_6linalg_3Vec_add_i;
  __pyx_vtable_5thinc_6linalg_Vec.mul = (void (*)(__pyx_t_5thinc_6linalg_weight_t *, __pyx_t_5thinc_6linalg_weight_t const *, __pyx_t_5thinc_6linalg_weight_t, int32_t))__pyx_f_5thinc_6linalg_3Vec_mul;
  __pyx_vtable_5thinc_6linalg_Vec.mul_i = (void (*)(__pyx_t_5thinc_6linalg_weight_t *, __pyx_t_5thinc_6linalg_weight_t const , int32_t))__pyx_f_5thinc_6linalg_3Vec_mul_i;
  __pyx_vtable_5thinc_6linalg_Vec.pow = (void (*)(__pyx_t_5thinc_6linalg_weight_t *, __pyx_t_5thinc_6linalg_weight_t const *, __pyx_t_5thinc_6linalg_weight_t, int32_t))__pyx_f_5thinc_6linalg_3Vec_pow;
  __pyx_vtable_5thinc_6linalg_Vec.pow_i = (void (*)(__pyx_t_5thinc_6linalg_weight_t *, __pyx_t_5thinc_6linalg_weight_t const , int32_t))__pyx_f_5thinc_6linalg_3Vec_pow_i;
  __pyx_vtable_5thinc_6linalg_Vec.div = (void (*)(__pyx_t_5thinc_6linalg_weight_t *, __pyx_t_5thinc_6linalg_weight_t const *, __pyx_t_5thinc_6linalg_weight_t, int32_t))__pyx_f_5thinc_6linalg_3Vec_div;
  __pyx_vtable_5thinc_6linalg_Vec.div_i = (void (*)(__pyx_t_5thinc_6linalg_weight_t *, __pyx_t_5thinc_6linalg_weight_t const , int32_t))__pyx_f_5thinc_6linalg_3Vec_div_i;
  __pyx_vtable_5thinc_6linalg_Vec.exp = (void (*)(__pyx_t_5thinc_6linalg_weight_t *, __pyx_t_5thinc_6linalg_weight_t const *, int32_t))__pyx_f_5thinc_6linalg_3Vec_exp;
  __pyx_vtable_5thinc_6linalg_Vec.exp_i = (void (*)(__pyx_t_5thinc_6linalg_weight_t *, int32_t))__pyx_f_5thinc_6linalg_3Vec_exp_i;
  __pyx_vtable_5thinc_6linalg_Vec.reciprocal_i = (void (*)(__pyx_t_5thinc_6linalg_weight_t *, int32_t))__pyx_f_5thinc_6linalg_3Vec_reciprocal_i;
  if (PyType_Ready(&__pyx_type_5thinc_6linalg_Vec) < 0) {__pyx_filename = __pyx_f[0]; __pyx_lineno = 61; __pyx_clineno = __LINE__; goto __pyx_L1_error;}
  __pyx_type_5thinc_6linalg_Vec.tp_print = 0;
  if (__Pyx_SetVtable(__pyx_type_5thinc_6linalg_Vec.tp_dict, __pyx_vtabptr_5thinc_6linalg_Vec) < 0) {__pyx_filename = __pyx_f[0]; __pyx_lineno = 61; __pyx_clineno = __LINE__; goto __pyx_L1_error;}
  if (PyObject_SetAttrString(__pyx_m, "Vec", (PyObject *)&__pyx_type_5thinc_6linalg_Vec) < 0) {__pyx_filename = __pyx_f[0]; __pyx_lineno = 61; __pyx_clineno = __LINE__; goto __pyx_L1_error;}
  __pyx_ptype_5thinc_6linalg_Vec = &__pyx_type_5thinc_6linalg_Vec;
  __pyx_vtabptr_5thinc_6linalg_VecVec = &__pyx_vtable_5thinc_6linalg_VecVec;
  __pyx_vtable_5thinc_6linalg_VecVec.add = (void (*)(__pyx_t_5thinc_6linalg_weight_t *, __pyx_t_5thinc_6linalg_weight_t const *, __pyx_t_5thinc_6linalg_weight_t const *, __pyx_t_5thinc_6linalg_weight_t, int32_t))__pyx_f_5thinc_6linalg_6VecVec_add;
  __pyx_vtable_5thinc_6linalg_VecVec.add_i = (void (*)(float *, float const *, float, int32_t))__pyx_f_5thinc_6linalg_6VecVec_add_i;
  __pyx_vtable_5thinc_6linalg_VecVec.add_pow = (void (*)(__pyx_t_5thinc_6linalg_weight_t *, __pyx_t_5thinc_6linalg_weight_t const *, __pyx_t_5thinc_6linalg_weight_t const *, __pyx_t_5thinc_6linalg_weight_t, int32_t))__pyx_f_5thinc_6linalg_6VecVec_add_pow;
  __pyx_vtable_5thinc_6linalg_VecVec.add_pow_i = (void (*)(__pyx_t_5thinc_6linalg_weight_t *, __pyx_t_5thinc_6linalg_weight_t const *, __pyx_t_5thinc_6linalg_weight_t, int32_t))__pyx_f_5thinc_6linalg_6VecVec_add_pow_i;
  __pyx_vtable_5thinc_6linalg_VecVec.mul = (void (*)(__pyx_t_5thinc_6linalg_weight_t *, __pyx_t_5thinc_6linalg_weight_t const *, __pyx_t_5thinc_6linalg_weight_t const *, int32_t))__pyx_f_5thinc_6linalg_6VecVec_mul;
  __pyx_vtable_5thinc_6linalg_VecVec.mul_i = (void (*)(__pyx_t_5thinc_6linalg_weight_t *, __pyx_t_5thinc_6linalg_weight_t const *, int32_t))__pyx_f_5thinc_6linalg_6VecVec_mul_i;
  __pyx_vtable_5thinc_6linalg_VecVec.dot = (__pyx_t_5thinc_6linalg_weight_t (*)(__pyx_t_5thinc_6linalg_weight_t const *, __pyx_t_5thinc_6linalg_weight_t const *, int32_t))__pyx_f_5thinc_6linalg_6VecVec_dot;
  __pyx_vtable_5thinc_6linalg_VecVec.arg_max_if_true = (int (*)(__pyx_t_5thinc_6linalg_weight_t const *, int const *, int const ))__pyx_f_5thinc_6linalg_6VecVec_arg_max_if_true;
  __pyx_vtable_5thinc_6linalg_VecVec.arg_max_if_zero = (int (*)(__pyx_t_5thinc_6linalg_weight_t const *, __pyx_t_5thinc_6linalg_weight_t const *, int const ))__pyx_f_5thinc_6linalg_6VecVec_arg_max_if_zero;
  if (PyType_Ready(&__pyx_type_5thinc_6linalg_VecVec) < 0) {__pyx_filename = __pyx_f[0]; __pyx_lineno = 163; __pyx_clineno = __LINE__; goto __pyx_L1_error;}
  __pyx_type_5thinc_6linalg_VecVec.tp_print = 0;
  if (__Pyx_SetVtable(__pyx_type_5thinc_6linalg_VecVec.tp_dict, __pyx_vtabptr_5thinc_6linalg_VecVec) < 0) {__pyx_filename = __pyx_f[0]; __pyx_lineno = 163; __pyx_clineno = __LINE__; goto __pyx_L1_error;}
  if (PyObject_SetAttrString(__pyx_m, "VecVec", (PyObject *)&__pyx_type_5thinc_6linalg_VecVec) < 0) {__pyx_filename = __pyx_f[0]; __pyx_lineno = 163; __pyx_clineno = __LINE__; goto __pyx_L1_error;}
  __pyx_ptype_5thinc_6linalg_VecVec = &__pyx_type_5thinc_6linalg_VecVec;
  __pyx_vtabptr_5thinc_6linalg_MatVec = &__pyx_vtable_5thinc_6linalg_MatVec;
  __pyx_vtable_5thinc_6linalg_MatVec.mul = (void (*)(__pyx_t_5thinc_6linalg_weight_t *, __pyx_t_5thinc_6linalg_weight_t const *, __pyx_t_5thinc_6linalg_weight_t const *, int32_t, int32_t))__pyx_f_5thinc_6linalg_6MatVec_mul;
  __pyx_vtable_5thinc_6linalg_MatVec.mul_i = (void (*)(__pyx_t_5thinc_6linalg_weight_t *, __pyx_t_5thinc_6linalg_weight_t const *, int32_t, int32_t))__pyx_f_5thinc_6linalg_6MatVec_mul_i;
  __pyx_vtable_5thinc_6linalg_MatVec.dot = (void (*)(__pyx_t_5thinc_6linalg_weight_t *, __pyx_t_5thinc_6linalg_weight_t const *, __pyx_t_5thinc_6linalg_weight_t const *, int32_t, int32_t))__pyx_f_5thinc_6linalg_6MatVec_dot;
  __pyx_vtable_5thinc_6linalg_MatVec.T_dot = (void (*)(__pyx_t_5thinc_6linalg_weight_t *, __pyx_t_5thinc_6linalg_weight_t const *, __pyx_t_5thinc_6linalg_weight_t const *, int32_t, int32_t))__pyx_f_5thinc_6linalg_6MatVec_T_dot;
  if (PyType_Ready(&__pyx_type_5thinc_6linalg_MatVec) < 0) {__pyx_filename = __pyx_f[0]; __pyx_lineno = 247; __pyx_clineno = __LINE__; goto __pyx_L1_error;}
  __pyx_type_5thinc_6linalg_MatVec.tp_print = 0;
  if (__Pyx_SetVtable(__pyx_type_5thinc_6linalg_MatVec.tp_dict, __pyx_vtabptr_5thinc_6linalg_MatVec) < 0) {__pyx_filename = __pyx_f[0]; __pyx_lineno = 247; __pyx_clineno = __LINE__; goto __pyx_L1_error;}
  if (PyObject_SetAttrString(__pyx_m, "MatVec", (PyObject *)&__pyx_type_5thinc_6linalg_MatVec) < 0) {__pyx_filename = __pyx_f[0]; __pyx_lineno = 247; __pyx_clineno = __LINE__; goto __pyx_L1_error;}
  __pyx_ptype_5thinc_6linalg_MatVec = &__pyx_type_5thinc_6linalg_MatVec;
  __pyx_vtabptr_5thinc_6linalg_MatMat = &__pyx_vtable_5thinc_6linalg_MatMat;
  __pyx_vtable_5thinc_6linalg_MatMat.add = (void (*)(__pyx_t_5thinc_6linalg_weight_t *, __pyx_t_5thinc_6linalg_weight_t const *, __pyx_t_5thinc_6linalg_weight_t const *, int32_t, int32_t))__pyx_f_5thinc_6linalg_6MatMat_add;
  __pyx_vtable_5thinc_6linalg_MatMat.add_i = (void (*)(__pyx_t_5thinc_6linalg_weight_t *, __pyx_t_5thinc_6linalg_weight_t const *, int32_t, int32_t))__pyx_f_5thinc_6linalg_6MatMat_add_i;
  __pyx_vtable_5thinc_6linalg_MatMat.mul = (void (*)(__pyx_t_5thinc_6linalg_weight_t *, __pyx_t_5thinc_6linalg_weight_t const *, __pyx_t_5thinc_6linalg_weight_t const *, int32_t, int32_t))__pyx_f_5thinc_6linalg_6MatMat_mul;
  __pyx_vtable_5thinc_6linalg_MatMat.mul_i = (void (*)(__pyx_t_5thinc_6linalg_weight_t *, __pyx_t_5thinc_6linalg_weight_t const *, int32_t, int32_t))__pyx_f_5thinc_6linalg_6MatMat_mul_i;
  __pyx_vtable_5thinc_6linalg_MatMat.add_outer_i = (void (*)(__pyx_t_5thinc_6linalg_weight_t *, __pyx_t_5thinc_6linalg_weight_t const *, __pyx_t_5thinc_6linalg_weight_t const *, int32_t, int32_t))__pyx_f_5thinc_6linalg_6MatMat_add_outer_i;
  if (PyType_Ready(&__pyx_type_5thinc_6linalg_MatMat) < 0) {__pyx_filename = __pyx_f[0]; __pyx_lineno = 322; __pyx_clineno = __LINE__; goto __pyx_L1_error;}
  __pyx_type_5thinc_6linalg_MatMat.tp_print = 0;
  if (__Pyx_SetVtable(__pyx_type_5thinc_6linalg_MatMat.tp_dict, __pyx_vtabptr_5thinc_6linalg_MatMat) < 0) {__pyx_filename = __pyx_f[0]; __pyx_lineno = 322; __pyx_clineno = __LINE__; goto __pyx_L1_error;}
  if (PyObject_SetAttrString(__pyx_m, "MatMat", (PyObject *)&__pyx_type_5thinc_6linalg_MatMat) < 0) {__pyx_filename = __pyx_f[0]; __pyx_lineno = 322; __pyx_clineno = __LINE__; goto __pyx_L1_error;}
  __pyx_ptype_5thinc_6linalg_MatMat = &__pyx_type_5thinc_6linalg_MatMat;
  /*--- Type import code ---*/
  __pyx_ptype_5cymem_5cymem_Pool = __Pyx_ImportType("cymem.cymem", "Pool", sizeof(struct __pyx_obj_5cymem_5cymem_Pool), 1); if (unlikely(!__pyx_ptype_5cymem_5cymem_Pool)) {__pyx_filename = __pyx_f[2]; __pyx_lineno = 1; __pyx_clineno = __LINE__; goto __pyx_L1_error;}
  __pyx_vtabptr_5cymem_5cymem_Pool = (struct __pyx_vtabstruct_5cymem_5cymem_Pool*)__Pyx_GetVtable(__pyx_ptype_5cymem_5cymem_Pool->tp_dict); if (unlikely(!__pyx_vtabptr_5cymem_5cymem_Pool)) {__pyx_filename = __pyx_f[2]; __pyx_lineno = 1; __pyx_clineno = __LINE__; goto __pyx_L1_error;}
  __pyx_ptype_5cymem_5cymem_Address = __Pyx_ImportType("cymem.cymem", "Address", sizeof(struct __pyx_obj_5cymem_5cymem_Address), 1); if (unlikely(!__pyx_ptype_5cymem_5cymem_Address)) {__pyx_filename = __pyx_f[2]; __pyx_lineno = 11; __pyx_clineno = __LINE__; goto __pyx_L1_error;}
  /*--- Variable import code ---*/
  /*--- Function import code ---*/
  /*--- Execution code ---*/
  #if defined(__Pyx_Generator_USED) || defined(__Pyx_Coroutine_USED)
  if (__Pyx_patch_abc() < 0) {__pyx_filename = __pyx_f[1]; __pyx_lineno = 1; __pyx_clineno = __LINE__; goto __pyx_L1_error;}
  #endif

  /* "thinc/linalg.pyx":1
             # <<<<<<<<<<<<<<
 */
  __pyx_t_1 = PyDict_New(); if (unlikely(!__pyx_t_1)) {__pyx_filename = __pyx_f[1]; __pyx_lineno = 1; __pyx_clineno = __LINE__; goto __pyx_L1_error;}
  __Pyx_GOTREF(__pyx_t_1);
  if (PyDict_SetItem(__pyx_d, __pyx_n_s_test, __pyx_t_1) < 0) {__pyx_filename = __pyx_f[1]; __pyx_lineno = 1; __pyx_clineno = __LINE__; goto __pyx_L1_error;}
  __Pyx_DECREF(__pyx_t_1); __pyx_t_1 = 0;

  /* "thinc/linalg.pxd":360
 * 
 *     @staticmethod
 *     cdef inline void add_outer_i(weight_t* mat,             # <<<<<<<<<<<<<<
 *                                  const weight_t* x,
 *                                  const weight_t* y,
 */

  /*--- Wrapped vars code ---*/

  goto __pyx_L0;
  __pyx_L1_error:;
  __Pyx_XDECREF(__pyx_t_1);
  if (__pyx_m) {
    if (__pyx_d) {
      __Pyx_AddTraceback("init thinc.linalg", __pyx_clineno, __pyx_lineno, __pyx_filename);
    }
    Py_DECREF(__pyx_m); __pyx_m = 0;
  } else if (!PyErr_Occurred()) {
    PyErr_SetString(PyExc_ImportError, "init thinc.linalg");
  }
  __pyx_L0:;
  __Pyx_RefNannyFinishContext();
  #if PY_MAJOR_VERSION < 3
  return;
  #else
  return __pyx_m;
  #endif
}

/* --- Runtime support code --- */
#if CYTHON_REFNANNY
static __Pyx_RefNannyAPIStruct *__Pyx_RefNannyImportAPI(const char *modname) {
    PyObject *m = NULL, *p = NULL;
    void *r = NULL;
    m = PyImport_ImportModule((char *)modname);
    if (!m) goto end;
    p = PyObject_GetAttrString(m, (char *)"RefNannyAPI");
    if (!p) goto end;
    r = PyLong_AsVoidPtr(p);
end:
    Py_XDECREF(p);
    Py_XDECREF(m);
    return (__Pyx_RefNannyAPIStruct *)r;
}
#endif

static PyObject *__Pyx_GetBuiltinName(PyObject *name) {
    PyObject* result = __Pyx_PyObject_GetAttrStr(__pyx_b, name);
    if (unlikely(!result)) {
        PyErr_Format(PyExc_NameError,
#if PY_MAJOR_VERSION >= 3
            "name '%U' is not defined", name);
#else
            "name '%.200s' is not defined", PyString_AS_STRING(name));
#endif
    }
    return result;
}

static int __Pyx_SetVtable(PyObject *dict, void *vtable) {
#if PY_VERSION_HEX >= 0x02070000
    PyObject *ob = PyCapsule_New(vtable, 0, 0);
#else
    PyObject *ob = PyCObject_FromVoidPtr(vtable, 0);
#endif
    if (!ob)
        goto bad;
    if (PyDict_SetItem(dict, __pyx_n_s_pyx_vtable, ob) < 0)
        goto bad;
    Py_DECREF(ob);
    return 0;
bad:
    Py_XDECREF(ob);
    return -1;
}

static void* __Pyx_GetVtable(PyObject *dict) {
    void* ptr;
    PyObject *ob = PyObject_GetItem(dict, __pyx_n_s_pyx_vtable);
    if (!ob)
        goto bad;
#if PY_VERSION_HEX >= 0x02070000
    ptr = PyCapsule_GetPointer(ob, 0);
#else
    ptr = PyCObject_AsVoidPtr(ob);
#endif
    if (!ptr && !PyErr_Occurred())
        PyErr_SetString(PyExc_RuntimeError, "invalid vtable found for imported type");
    Py_DECREF(ob);
    return ptr;
bad:
    Py_XDECREF(ob);
    return NULL;
}

static int __pyx_bisect_code_objects(__Pyx_CodeObjectCacheEntry* entries, int count, int code_line) {
    int start = 0, mid = 0, end = count - 1;
    if (end >= 0 && code_line > entries[end].code_line) {
        return count;
    }
    while (start < end) {
        mid = start + (end - start) / 2;
        if (code_line < entries[mid].code_line) {
            end = mid;
        } else if (code_line > entries[mid].code_line) {
             start = mid + 1;
        } else {
            return mid;
        }
    }
    if (code_line <= entries[mid].code_line) {
        return mid;
    } else {
        return mid + 1;
    }
}
static PyCodeObject *__pyx_find_code_object(int code_line) {
    PyCodeObject* code_object;
    int pos;
    if (unlikely(!code_line) || unlikely(!__pyx_code_cache.entries)) {
        return NULL;
    }
    pos = __pyx_bisect_code_objects(__pyx_code_cache.entries, __pyx_code_cache.count, code_line);
    if (unlikely(pos >= __pyx_code_cache.count) || unlikely(__pyx_code_cache.entries[pos].code_line != code_line)) {
        return NULL;
    }
    code_object = __pyx_code_cache.entries[pos].code_object;
    Py_INCREF(code_object);
    return code_object;
}
static void __pyx_insert_code_object(int code_line, PyCodeObject* code_object) {
    int pos, i;
    __Pyx_CodeObjectCacheEntry* entries = __pyx_code_cache.entries;
    if (unlikely(!code_line)) {
        return;
    }
    if (unlikely(!entries)) {
        entries = (__Pyx_CodeObjectCacheEntry*)PyMem_Malloc(64*sizeof(__Pyx_CodeObjectCacheEntry));
        if (likely(entries)) {
            __pyx_code_cache.entries = entries;
            __pyx_code_cache.max_count = 64;
            __pyx_code_cache.count = 1;
            entries[0].code_line = code_line;
            entries[0].code_object = code_object;
            Py_INCREF(code_object);
        }
        return;
    }
    pos = __pyx_bisect_code_objects(__pyx_code_cache.entries, __pyx_code_cache.count, code_line);
    if ((pos < __pyx_code_cache.count) && unlikely(__pyx_code_cache.entries[pos].code_line == code_line)) {
        PyCodeObject* tmp = entries[pos].code_object;
        entries[pos].code_object = code_object;
        Py_DECREF(tmp);
        return;
    }
    if (__pyx_code_cache.count == __pyx_code_cache.max_count) {
        int new_max = __pyx_code_cache.max_count + 64;
        entries = (__Pyx_CodeObjectCacheEntry*)PyMem_Realloc(
            __pyx_code_cache.entries, (size_t)new_max*sizeof(__Pyx_CodeObjectCacheEntry));
        if (unlikely(!entries)) {
            return;
        }
        __pyx_code_cache.entries = entries;
        __pyx_code_cache.max_count = new_max;
    }
    for (i=__pyx_code_cache.count; i>pos; i--) {
        entries[i] = entries[i-1];
    }
    entries[pos].code_line = code_line;
    entries[pos].code_object = code_object;
    __pyx_code_cache.count++;
    Py_INCREF(code_object);
}

#include "compile.h"
#include "frameobject.h"
#include "traceback.h"
static PyCodeObject* __Pyx_CreateCodeObjectForTraceback(
            const char *funcname, int c_line,
            int py_line, const char *filename) {
    PyCodeObject *py_code = 0;
    PyObject *py_srcfile = 0;
    PyObject *py_funcname = 0;
    #if PY_MAJOR_VERSION < 3
    py_srcfile = PyString_FromString(filename);
    #else
    py_srcfile = PyUnicode_FromString(filename);
    #endif
    if (!py_srcfile) goto bad;
    if (c_line) {
        #if PY_MAJOR_VERSION < 3
        py_funcname = PyString_FromFormat( "%s (%s:%d)", funcname, __pyx_cfilenm, c_line);
        #else
        py_funcname = PyUnicode_FromFormat( "%s (%s:%d)", funcname, __pyx_cfilenm, c_line);
        #endif
    }
    else {
        #if PY_MAJOR_VERSION < 3
        py_funcname = PyString_FromString(funcname);
        #else
        py_funcname = PyUnicode_FromString(funcname);
        #endif
    }
    if (!py_funcname) goto bad;
    py_code = __Pyx_PyCode_New(
        0,
        0,
        0,
        0,
        0,
        __pyx_empty_bytes, /*PyObject *code,*/
        __pyx_empty_tuple, /*PyObject *consts,*/
        __pyx_empty_tuple, /*PyObject *names,*/
        __pyx_empty_tuple, /*PyObject *varnames,*/
        __pyx_empty_tuple, /*PyObject *freevars,*/
        __pyx_empty_tuple, /*PyObject *cellvars,*/
        py_srcfile,   /*PyObject *filename,*/
        py_funcname,  /*PyObject *name,*/
        py_line,
        __pyx_empty_bytes  /*PyObject *lnotab*/
    );
    Py_DECREF(py_srcfile);
    Py_DECREF(py_funcname);
    return py_code;
bad:
    Py_XDECREF(py_srcfile);
    Py_XDECREF(py_funcname);
    return NULL;
}
static void __Pyx_AddTraceback(const char *funcname, int c_line,
                               int py_line, const char *filename) {
    PyCodeObject *py_code = 0;
    PyFrameObject *py_frame = 0;
    py_code = __pyx_find_code_object(c_line ? c_line : py_line);
    if (!py_code) {
        py_code = __Pyx_CreateCodeObjectForTraceback(
            funcname, c_line, py_line, filename);
        if (!py_code) goto bad;
        __pyx_insert_code_object(c_line ? c_line : py_line, py_code);
    }
    py_frame = PyFrame_New(
        PyThreadState_GET(), /*PyThreadState *tstate,*/
        py_code,             /*PyCodeObject *code,*/
        __pyx_d,      /*PyObject *globals,*/
        0                    /*PyObject *locals*/
    );
    if (!py_frame) goto bad;
    py_frame->f_lineno = py_line;
    PyTraceBack_Here(py_frame);
bad:
    Py_XDECREF(py_code);
    Py_XDECREF(py_frame);
}

static CYTHON_INLINE PyObject* __Pyx_PyInt_From_int(int value) {
    const int neg_one = (int) -1, const_zero = (int) 0;
    const int is_unsigned = neg_one > const_zero;
    if (is_unsigned) {
        if (sizeof(int) < sizeof(long)) {
            return PyInt_FromLong((long) value);
        } else if (sizeof(int) <= sizeof(unsigned long)) {
            return PyLong_FromUnsignedLong((unsigned long) value);
        } else if (sizeof(int) <= sizeof(unsigned PY_LONG_LONG)) {
            return PyLong_FromUnsignedLongLong((unsigned PY_LONG_LONG) value);
        }
    } else {
        if (sizeof(int) <= sizeof(long)) {
            return PyInt_FromLong((long) value);
        } else if (sizeof(int) <= sizeof(PY_LONG_LONG)) {
            return PyLong_FromLongLong((PY_LONG_LONG) value);
        }
    }
    {
        int one = 1; int little = (int)*(unsigned char *)&one;
        unsigned char *bytes = (unsigned char *)&value;
        return _PyLong_FromByteArray(bytes, sizeof(int),
                                     little, !is_unsigned);
    }
}

#define __PYX_VERIFY_RETURN_INT(target_type, func_type, func_value)\
    __PYX__VERIFY_RETURN_INT(target_type, func_type, func_value, 0)
#define __PYX_VERIFY_RETURN_INT_EXC(target_type, func_type, func_value)\
    __PYX__VERIFY_RETURN_INT(target_type, func_type, func_value, 1)
#define __PYX__VERIFY_RETURN_INT(target_type, func_type, func_value, exc)\
    {\
        func_type value = func_value;\
        if (sizeof(target_type) < sizeof(func_type)) {\
            if (unlikely(value != (func_type) (target_type) value)) {\
                func_type zero = 0;\
                if (exc && unlikely(value == (func_type)-1 && PyErr_Occurred()))\
                    return (target_type) -1;\
                if (is_unsigned && unlikely(value < zero))\
                    goto raise_neg_overflow;\
                else\
                    goto raise_overflow;\
            }\
        }\
        return (target_type) value;\
    }

#if CYTHON_USE_PYLONG_INTERNALS
  #include "longintrepr.h"
#endif

static CYTHON_INLINE int __Pyx_PyInt_As_int(PyObject *x) {
    const int neg_one = (int) -1, const_zero = (int) 0;
    const int is_unsigned = neg_one > const_zero;
#if PY_MAJOR_VERSION < 3
    if (likely(PyInt_Check(x))) {
        if (sizeof(int) < sizeof(long)) {
            __PYX_VERIFY_RETURN_INT(int, long, PyInt_AS_LONG(x))
        } else {
            long val = PyInt_AS_LONG(x);
            if (is_unsigned && unlikely(val < 0)) {
                goto raise_neg_overflow;
            }
            return (int) val;
        }
    } else
#endif
    if (likely(PyLong_Check(x))) {
        if (is_unsigned) {
#if CYTHON_USE_PYLONG_INTERNALS
            const digit* digits = ((PyLongObject*)x)->ob_digit;
            switch (Py_SIZE(x)) {
                case  0: return (int) 0;
                case  1: __PYX_VERIFY_RETURN_INT(int, digit, digits[0])
                case 2:
                    if (8 * sizeof(int) > 1 * PyLong_SHIFT) {
                        if (8 * sizeof(unsigned long) > 2 * PyLong_SHIFT) {
                            __PYX_VERIFY_RETURN_INT(int, unsigned long, (((((unsigned long)digits[1]) << PyLong_SHIFT) | (unsigned long)digits[0])))
                        } else if (8 * sizeof(int) >= 2 * PyLong_SHIFT) {
                            return (int) (((((int)digits[1]) << PyLong_SHIFT) | (int)digits[0]));
                        }
                    }
                    break;
                case 3:
                    if (8 * sizeof(int) > 2 * PyLong_SHIFT) {
                        if (8 * sizeof(unsigned long) > 3 * PyLong_SHIFT) {
                            __PYX_VERIFY_RETURN_INT(int, unsigned long, (((((((unsigned long)digits[2]) << PyLong_SHIFT) | (unsigned long)digits[1]) << PyLong_SHIFT) | (unsigned long)digits[0])))
                        } else if (8 * sizeof(int) >= 3 * PyLong_SHIFT) {
                            return (int) (((((((int)digits[2]) << PyLong_SHIFT) | (int)digits[1]) << PyLong_SHIFT) | (int)digits[0]));
                        }
                    }
                    break;
                case 4:
                    if (8 * sizeof(int) > 3 * PyLong_SHIFT) {
                        if (8 * sizeof(unsigned long) > 4 * PyLong_SHIFT) {
                            __PYX_VERIFY_RETURN_INT(int, unsigned long, (((((((((unsigned long)digits[3]) << PyLong_SHIFT) | (unsigned long)digits[2]) << PyLong_SHIFT) | (unsigned long)digits[1]) << PyLong_SHIFT) | (unsigned long)digits[0])))
                        } else if (8 * sizeof(int) >= 4 * PyLong_SHIFT) {
                            return (int) (((((((((int)digits[3]) << PyLong_SHIFT) | (int)digits[2]) << PyLong_SHIFT) | (int)digits[1]) << PyLong_SHIFT) | (int)digits[0]));
                        }
                    }
                    break;
            }
#endif
#if CYTHON_COMPILING_IN_CPYTHON
            if (unlikely(Py_SIZE(x) < 0)) {
                goto raise_neg_overflow;
            }
#else
            {
                int result = PyObject_RichCompareBool(x, Py_False, Py_LT);
                if (unlikely(result < 0))
                    return (int) -1;
                if (unlikely(result == 1))
                    goto raise_neg_overflow;
            }
#endif
            if (sizeof(int) <= sizeof(unsigned long)) {
                __PYX_VERIFY_RETURN_INT_EXC(int, unsigned long, PyLong_AsUnsignedLong(x))
            } else if (sizeof(int) <= sizeof(unsigned PY_LONG_LONG)) {
                __PYX_VERIFY_RETURN_INT_EXC(int, unsigned PY_LONG_LONG, PyLong_AsUnsignedLongLong(x))
            }
        } else {
#if CYTHON_USE_PYLONG_INTERNALS
            const digit* digits = ((PyLongObject*)x)->ob_digit;
            switch (Py_SIZE(x)) {
                case  0: return (int) 0;
                case -1: __PYX_VERIFY_RETURN_INT(int, sdigit, -(sdigit) digits[0])
                case  1: __PYX_VERIFY_RETURN_INT(int,  digit, +digits[0])
                case -2:
                    if (8 * sizeof(int) - 1 > 1 * PyLong_SHIFT) {
                        if (8 * sizeof(unsigned long) > 2 * PyLong_SHIFT) {
                            __PYX_VERIFY_RETURN_INT(int, long, -(long) (((((unsigned long)digits[1]) << PyLong_SHIFT) | (unsigned long)digits[0])))
                        } else if (8 * sizeof(int) - 1 > 2 * PyLong_SHIFT) {
                            return (int) (((int)-1)*(((((int)digits[1]) << PyLong_SHIFT) | (int)digits[0])));
                        }
                    }
                    break;
                case 2:
                    if (8 * sizeof(int) > 1 * PyLong_SHIFT) {
                        if (8 * sizeof(unsigned long) > 2 * PyLong_SHIFT) {
                            __PYX_VERIFY_RETURN_INT(int, unsigned long, (((((unsigned long)digits[1]) << PyLong_SHIFT) | (unsigned long)digits[0])))
                        } else if (8 * sizeof(int) - 1 > 2 * PyLong_SHIFT) {
                            return (int) ((((((int)digits[1]) << PyLong_SHIFT) | (int)digits[0])));
                        }
                    }
                    break;
                case -3:
                    if (8 * sizeof(int) - 1 > 2 * PyLong_SHIFT) {
                        if (8 * sizeof(unsigned long) > 3 * PyLong_SHIFT) {
                            __PYX_VERIFY_RETURN_INT(int, long, -(long) (((((((unsigned long)digits[2]) << PyLong_SHIFT) | (unsigned long)digits[1]) << PyLong_SHIFT) | (unsigned long)digits[0])))
                        } else if (8 * sizeof(int) - 1 > 3 * PyLong_SHIFT) {
                            return (int) (((int)-1)*(((((((int)digits[2]) << PyLong_SHIFT) | (int)digits[1]) << PyLong_SHIFT) | (int)digits[0])));
                        }
                    }
                    break;
                case 3:
                    if (8 * sizeof(int) > 2 * PyLong_SHIFT) {
                        if (8 * sizeof(unsigned long) > 3 * PyLong_SHIFT) {
                            __PYX_VERIFY_RETURN_INT(int, unsigned long, (((((((unsigned long)digits[2]) << PyLong_SHIFT) | (unsigned long)digits[1]) << PyLong_SHIFT) | (unsigned long)digits[0])))
                        } else if (8 * sizeof(int) - 1 > 3 * PyLong_SHIFT) {
                            return (int) ((((((((int)digits[2]) << PyLong_SHIFT) | (int)digits[1]) << PyLong_SHIFT) | (int)digits[0])));
                        }
                    }
                    break;
                case -4:
                    if (8 * sizeof(int) - 1 > 3 * PyLong_SHIFT) {
                        if (8 * sizeof(unsigned long) > 4 * PyLong_SHIFT) {
                            __PYX_VERIFY_RETURN_INT(int, long, -(long) (((((((((unsigned long)digits[3]) << PyLong_SHIFT) | (unsigned long)digits[2]) << PyLong_SHIFT) | (unsigned long)digits[1]) << PyLong_SHIFT) | (unsigned long)digits[0])))
                        } else if (8 * sizeof(int) - 1 > 4 * PyLong_SHIFT) {
                            return (int) (((int)-1)*(((((((((int)digits[3]) << PyLong_SHIFT) | (int)digits[2]) << PyLong_SHIFT) | (int)digits[1]) << PyLong_SHIFT) | (int)digits[0])));
                        }
                    }
                    break;
                case 4:
                    if (8 * sizeof(int) > 3 * PyLong_SHIFT) {
                        if (8 * sizeof(unsigned long) > 4 * PyLong_SHIFT) {
                            __PYX_VERIFY_RETURN_INT(int, unsigned long, (((((((((unsigned long)digits[3]) << PyLong_SHIFT) | (unsigned long)digits[2]) << PyLong_SHIFT) | (unsigned long)digits[1]) << PyLong_SHIFT) | (unsigned long)digits[0])))
                        } else if (8 * sizeof(int) - 1 > 4 * PyLong_SHIFT) {
                            return (int) ((((((((((int)digits[3]) << PyLong_SHIFT) | (int)digits[2]) << PyLong_SHIFT) | (int)digits[1]) << PyLong_SHIFT) | (int)digits[0])));
                        }
                    }
                    break;
            }
#endif
            if (sizeof(int) <= sizeof(long)) {
                __PYX_VERIFY_RETURN_INT_EXC(int, long, PyLong_AsLong(x))
            } else if (sizeof(int) <= sizeof(PY_LONG_LONG)) {
                __PYX_VERIFY_RETURN_INT_EXC(int, PY_LONG_LONG, PyLong_AsLongLong(x))
            }
        }
        {
#if CYTHON_COMPILING_IN_PYPY && !defined(_PyLong_AsByteArray)
            PyErr_SetString(PyExc_RuntimeError,
                            "_PyLong_AsByteArray() not available in PyPy, cannot convert large numbers");
#else
            int val;
            PyObject *v = __Pyx_PyNumber_Int(x);
 #if PY_MAJOR_VERSION < 3
            if (likely(v) && !PyLong_Check(v)) {
                PyObject *tmp = v;
                v = PyNumber_Long(tmp);
                Py_DECREF(tmp);
            }
 #endif
            if (likely(v)) {
                int one = 1; int is_little = (int)*(unsigned char *)&one;
                unsigned char *bytes = (unsigned char *)&val;
                int ret = _PyLong_AsByteArray((PyLongObject *)v,
                                              bytes, sizeof(val),
                                              is_little, !is_unsigned);
                Py_DECREF(v);
                if (likely(!ret))
                    return val;
            }
#endif
            return (int) -1;
        }
    } else {
        int val;
        PyObject *tmp = __Pyx_PyNumber_Int(x);
        if (!tmp) return (int) -1;
        val = __Pyx_PyInt_As_int(tmp);
        Py_DECREF(tmp);
        return val;
    }
raise_overflow:
    PyErr_SetString(PyExc_OverflowError,
        "value too large to convert to int");
    return (int) -1;
raise_neg_overflow:
    PyErr_SetString(PyExc_OverflowError,
        "can't convert negative value to int");
    return (int) -1;
}

static CYTHON_INLINE PyObject* __Pyx_PyInt_From_int32_t(int32_t value) {
    const int32_t neg_one = (int32_t) -1, const_zero = (int32_t) 0;
    const int is_unsigned = neg_one > const_zero;
    if (is_unsigned) {
        if (sizeof(int32_t) < sizeof(long)) {
            return PyInt_FromLong((long) value);
        } else if (sizeof(int32_t) <= sizeof(unsigned long)) {
            return PyLong_FromUnsignedLong((unsigned long) value);
        } else if (sizeof(int32_t) <= sizeof(unsigned PY_LONG_LONG)) {
            return PyLong_FromUnsignedLongLong((unsigned PY_LONG_LONG) value);
        }
    } else {
        if (sizeof(int32_t) <= sizeof(long)) {
            return PyInt_FromLong((long) value);
        } else if (sizeof(int32_t) <= sizeof(PY_LONG_LONG)) {
            return PyLong_FromLongLong((PY_LONG_LONG) value);
        }
    }
    {
        int one = 1; int little = (int)*(unsigned char *)&one;
        unsigned char *bytes = (unsigned char *)&value;
        return _PyLong_FromByteArray(bytes, sizeof(int32_t),
                                     little, !is_unsigned);
    }
}

static CYTHON_INLINE PyObject* __Pyx_PyInt_From_long(long value) {
    const long neg_one = (long) -1, const_zero = (long) 0;
    const int is_unsigned = neg_one > const_zero;
    if (is_unsigned) {
        if (sizeof(long) < sizeof(long)) {
            return PyInt_FromLong((long) value);
        } else if (sizeof(long) <= sizeof(unsigned long)) {
            return PyLong_FromUnsignedLong((unsigned long) value);
        } else if (sizeof(long) <= sizeof(unsigned PY_LONG_LONG)) {
            return PyLong_FromUnsignedLongLong((unsigned PY_LONG_LONG) value);
        }
    } else {
        if (sizeof(long) <= sizeof(long)) {
            return PyInt_FromLong((long) value);
        } else if (sizeof(long) <= sizeof(PY_LONG_LONG)) {
            return PyLong_FromLongLong((PY_LONG_LONG) value);
        }
    }
    {
        int one = 1; int little = (int)*(unsigned char *)&one;
        unsigned char *bytes = (unsigned char *)&value;
        return _PyLong_FromByteArray(bytes, sizeof(long),
                                     little, !is_unsigned);
    }
}

static CYTHON_INLINE long __Pyx_PyInt_As_long(PyObject *x) {
    const long neg_one = (long) -1, const_zero = (long) 0;
    const int is_unsigned = neg_one > const_zero;
#if PY_MAJOR_VERSION < 3
    if (likely(PyInt_Check(x))) {
        if (sizeof(long) < sizeof(long)) {
            __PYX_VERIFY_RETURN_INT(long, long, PyInt_AS_LONG(x))
        } else {
            long val = PyInt_AS_LONG(x);
            if (is_unsigned && unlikely(val < 0)) {
                goto raise_neg_overflow;
            }
            return (long) val;
        }
    } else
#endif
    if (likely(PyLong_Check(x))) {
        if (is_unsigned) {
#if CYTHON_USE_PYLONG_INTERNALS
            const digit* digits = ((PyLongObject*)x)->ob_digit;
            switch (Py_SIZE(x)) {
                case  0: return (long) 0;
                case  1: __PYX_VERIFY_RETURN_INT(long, digit, digits[0])
                case 2:
                    if (8 * sizeof(long) > 1 * PyLong_SHIFT) {
                        if (8 * sizeof(unsigned long) > 2 * PyLong_SHIFT) {
                            __PYX_VERIFY_RETURN_INT(long, unsigned long, (((((unsigned long)digits[1]) << PyLong_SHIFT) | (unsigned long)digits[0])))
                        } else if (8 * sizeof(long) >= 2 * PyLong_SHIFT) {
                            return (long) (((((long)digits[1]) << PyLong_SHIFT) | (long)digits[0]));
                        }
                    }
                    break;
                case 3:
                    if (8 * sizeof(long) > 2 * PyLong_SHIFT) {
                        if (8 * sizeof(unsigned long) > 3 * PyLong_SHIFT) {
                            __PYX_VERIFY_RETURN_INT(long, unsigned long, (((((((unsigned long)digits[2]) << PyLong_SHIFT) | (unsigned long)digits[1]) << PyLong_SHIFT) | (unsigned long)digits[0])))
                        } else if (8 * sizeof(long) >= 3 * PyLong_SHIFT) {
                            return (long) (((((((long)digits[2]) << PyLong_SHIFT) | (long)digits[1]) << PyLong_SHIFT) | (long)digits[0]));
                        }
                    }
                    break;
                case 4:
                    if (8 * sizeof(long) > 3 * PyLong_SHIFT) {
                        if (8 * sizeof(unsigned long) > 4 * PyLong_SHIFT) {
                            __PYX_VERIFY_RETURN_INT(long, unsigned long, (((((((((unsigned long)digits[3]) << PyLong_SHIFT) | (unsigned long)digits[2]) << PyLong_SHIFT) | (unsigned long)digits[1]) << PyLong_SHIFT) | (unsigned long)digits[0])))
                        } else if (8 * sizeof(long) >= 4 * PyLong_SHIFT) {
                            return (long) (((((((((long)digits[3]) << PyLong_SHIFT) | (long)digits[2]) << PyLong_SHIFT) | (long)digits[1]) << PyLong_SHIFT) | (long)digits[0]));
                        }
                    }
                    break;
            }
#endif
#if CYTHON_COMPILING_IN_CPYTHON
            if (unlikely(Py_SIZE(x) < 0)) {
                goto raise_neg_overflow;
            }
#else
            {
                int result = PyObject_RichCompareBool(x, Py_False, Py_LT);
                if (unlikely(result < 0))
                    return (long) -1;
                if (unlikely(result == 1))
                    goto raise_neg_overflow;
            }
#endif
            if (sizeof(long) <= sizeof(unsigned long)) {
                __PYX_VERIFY_RETURN_INT_EXC(long, unsigned long, PyLong_AsUnsignedLong(x))
            } else if (sizeof(long) <= sizeof(unsigned PY_LONG_LONG)) {
                __PYX_VERIFY_RETURN_INT_EXC(long, unsigned PY_LONG_LONG, PyLong_AsUnsignedLongLong(x))
            }
        } else {
#if CYTHON_USE_PYLONG_INTERNALS
            const digit* digits = ((PyLongObject*)x)->ob_digit;
            switch (Py_SIZE(x)) {
                case  0: return (long) 0;
                case -1: __PYX_VERIFY_RETURN_INT(long, sdigit, -(sdigit) digits[0])
                case  1: __PYX_VERIFY_RETURN_INT(long,  digit, +digits[0])
                case -2:
                    if (8 * sizeof(long) - 1 > 1 * PyLong_SHIFT) {
                        if (8 * sizeof(unsigned long) > 2 * PyLong_SHIFT) {
                            __PYX_VERIFY_RETURN_INT(long, long, -(long) (((((unsigned long)digits[1]) << PyLong_SHIFT) | (unsigned long)digits[0])))
                        } else if (8 * sizeof(long) - 1 > 2 * PyLong_SHIFT) {
                            return (long) (((long)-1)*(((((long)digits[1]) << PyLong_SHIFT) | (long)digits[0])));
                        }
                    }
                    break;
                case 2:
                    if (8 * sizeof(long) > 1 * PyLong_SHIFT) {
                        if (8 * sizeof(unsigned long) > 2 * PyLong_SHIFT) {
                            __PYX_VERIFY_RETURN_INT(long, unsigned long, (((((unsigned long)digits[1]) << PyLong_SHIFT) | (unsigned long)digits[0])))
                        } else if (8 * sizeof(long) - 1 > 2 * PyLong_SHIFT) {
                            return (long) ((((((long)digits[1]) << PyLong_SHIFT) | (long)digits[0])));
                        }
                    }
                    break;
                case -3:
                    if (8 * sizeof(long) - 1 > 2 * PyLong_SHIFT) {
                        if (8 * sizeof(unsigned long) > 3 * PyLong_SHIFT) {
                            __PYX_VERIFY_RETURN_INT(long, long, -(long) (((((((unsigned long)digits[2]) << PyLong_SHIFT) | (unsigned long)digits[1]) << PyLong_SHIFT) | (unsigned long)digits[0])))
                        } else if (8 * sizeof(long) - 1 > 3 * PyLong_SHIFT) {
                            return (long) (((long)-1)*(((((((long)digits[2]) << PyLong_SHIFT) | (long)digits[1]) << PyLong_SHIFT) | (long)digits[0])));
                        }
                    }
                    break;
                case 3:
                    if (8 * sizeof(long) > 2 * PyLong_SHIFT) {
                        if (8 * sizeof(unsigned long) > 3 * PyLong_SHIFT) {
                            __PYX_VERIFY_RETURN_INT(long, unsigned long, (((((((unsigned long)digits[2]) << PyLong_SHIFT) | (unsigned long)digits[1]) << PyLong_SHIFT) | (unsigned long)digits[0])))
                        } else if (8 * sizeof(long) - 1 > 3 * PyLong_SHIFT) {
                            return (long) ((((((((long)digits[2]) << PyLong_SHIFT) | (long)digits[1]) << PyLong_SHIFT) | (long)digits[0])));
                        }
                    }
                    break;
                case -4:
                    if (8 * sizeof(long) - 1 > 3 * PyLong_SHIFT) {
                        if (8 * sizeof(unsigned long) > 4 * PyLong_SHIFT) {
                            __PYX_VERIFY_RETURN_INT(long, long, -(long) (((((((((unsigned long)digits[3]) << PyLong_SHIFT) | (unsigned long)digits[2]) << PyLong_SHIFT) | (unsigned long)digits[1]) << PyLong_SHIFT) | (unsigned long)digits[0])))
                        } else if (8 * sizeof(long) - 1 > 4 * PyLong_SHIFT) {
                            return (long) (((long)-1)*(((((((((long)digits[3]) << PyLong_SHIFT) | (long)digits[2]) << PyLong_SHIFT) | (long)digits[1]) << PyLong_SHIFT) | (long)digits[0])));
                        }
                    }
                    break;
                case 4:
                    if (8 * sizeof(long) > 3 * PyLong_SHIFT) {
                        if (8 * sizeof(unsigned long) > 4 * PyLong_SHIFT) {
                            __PYX_VERIFY_RETURN_INT(long, unsigned long, (((((((((unsigned long)digits[3]) << PyLong_SHIFT) | (unsigned long)digits[2]) << PyLong_SHIFT) | (unsigned long)digits[1]) << PyLong_SHIFT) | (unsigned long)digits[0])))
                        } else if (8 * sizeof(long) - 1 > 4 * PyLong_SHIFT) {
                            return (long) ((((((((((long)digits[3]) << PyLong_SHIFT) | (long)digits[2]) << PyLong_SHIFT) | (long)digits[1]) << PyLong_SHIFT) | (long)digits[0])));
                        }
                    }
                    break;
            }
#endif
            if (sizeof(long) <= sizeof(long)) {
                __PYX_VERIFY_RETURN_INT_EXC(long, long, PyLong_AsLong(x))
            } else if (sizeof(long) <= sizeof(PY_LONG_LONG)) {
                __PYX_VERIFY_RETURN_INT_EXC(long, PY_LONG_LONG, PyLong_AsLongLong(x))
            }
        }
        {
#if CYTHON_COMPILING_IN_PYPY && !defined(_PyLong_AsByteArray)
            PyErr_SetString(PyExc_RuntimeError,
                            "_PyLong_AsByteArray() not available in PyPy, cannot convert large numbers");
#else
            long val;
            PyObject *v = __Pyx_PyNumber_Int(x);
 #if PY_MAJOR_VERSION < 3
            if (likely(v) && !PyLong_Check(v)) {
                PyObject *tmp = v;
                v = PyNumber_Long(tmp);
                Py_DECREF(tmp);
            }
 #endif
            if (likely(v)) {
                int one = 1; int is_little = (int)*(unsigned char *)&one;
                unsigned char *bytes = (unsigned char *)&val;
                int ret = _PyLong_AsByteArray((PyLongObject *)v,
                                              bytes, sizeof(val),
                                              is_little, !is_unsigned);
                Py_DECREF(v);
                if (likely(!ret))
                    return val;
            }
#endif
            return (long) -1;
        }
    } else {
        long val;
        PyObject *tmp = __Pyx_PyNumber_Int(x);
        if (!tmp) return (long) -1;
        val = __Pyx_PyInt_As_long(tmp);
        Py_DECREF(tmp);
        return val;
    }
raise_overflow:
    PyErr_SetString(PyExc_OverflowError,
        "value too large to convert to long");
    return (long) -1;
raise_neg_overflow:
    PyErr_SetString(PyExc_OverflowError,
        "can't convert negative value to long");
    return (long) -1;
}

static int __Pyx_check_binary_version(void) {
    char ctversion[4], rtversion[4];
    PyOS_snprintf(ctversion, 4, "%d.%d", PY_MAJOR_VERSION, PY_MINOR_VERSION);
    PyOS_snprintf(rtversion, 4, "%s", Py_GetVersion());
    if (ctversion[0] != rtversion[0] || ctversion[2] != rtversion[2]) {
        char message[200];
        PyOS_snprintf(message, sizeof(message),
                      "compiletime version %s of module '%.100s' "
                      "does not match runtime version %s",
                      ctversion, __Pyx_MODULE_NAME, rtversion);
        return PyErr_WarnEx(NULL, message, 1);
    }
    return 0;
}

#ifndef __PYX_HAVE_RT_ImportModule
#define __PYX_HAVE_RT_ImportModule
static PyObject *__Pyx_ImportModule(const char *name) {
    PyObject *py_name = 0;
    PyObject *py_module = 0;
    py_name = __Pyx_PyIdentifier_FromString(name);
    if (!py_name)
        goto bad;
    py_module = PyImport_Import(py_name);
    Py_DECREF(py_name);
    return py_module;
bad:
    Py_XDECREF(py_name);
    return 0;
}
#endif

#ifndef __PYX_HAVE_RT_ImportType
#define __PYX_HAVE_RT_ImportType
static PyTypeObject *__Pyx_ImportType(const char *module_name, const char *class_name,
    size_t size, int strict)
{
    PyObject *py_module = 0;
    PyObject *result = 0;
    PyObject *py_name = 0;
    char warning[200];
    Py_ssize_t basicsize;
#ifdef Py_LIMITED_API
    PyObject *py_basicsize;
#endif
    py_module = __Pyx_ImportModule(module_name);
    if (!py_module)
        goto bad;
    py_name = __Pyx_PyIdentifier_FromString(class_name);
    if (!py_name)
        goto bad;
    result = PyObject_GetAttr(py_module, py_name);
    Py_DECREF(py_name);
    py_name = 0;
    Py_DECREF(py_module);
    py_module = 0;
    if (!result)
        goto bad;
    if (!PyType_Check(result)) {
        PyErr_Format(PyExc_TypeError,
            "%.200s.%.200s is not a type object",
            module_name, class_name);
        goto bad;
    }
#ifndef Py_LIMITED_API
    basicsize = ((PyTypeObject *)result)->tp_basicsize;
#else
    py_basicsize = PyObject_GetAttrString(result, "__basicsize__");
    if (!py_basicsize)
        goto bad;
    basicsize = PyLong_AsSsize_t(py_basicsize);
    Py_DECREF(py_basicsize);
    py_basicsize = 0;
    if (basicsize == (Py_ssize_t)-1 && PyErr_Occurred())
        goto bad;
#endif
    if (!strict && (size_t)basicsize > size) {
        PyOS_snprintf(warning, sizeof(warning),
            "%s.%s size changed, may indicate binary incompatibility",
            module_name, class_name);
        if (PyErr_WarnEx(NULL, warning, 0) < 0) goto bad;
    }
    else if ((size_t)basicsize != size) {
        PyErr_Format(PyExc_ValueError,
            "%.200s.%.200s has the wrong size, try recompiling",
            module_name, class_name);
        goto bad;
    }
    return (PyTypeObject *)result;
bad:
    Py_XDECREF(py_module);
    Py_XDECREF(result);
    return NULL;
}
#endif

static int __Pyx_InitStrings(__Pyx_StringTabEntry *t) {
    while (t->p) {
        #if PY_MAJOR_VERSION < 3
        if (t->is_unicode) {
            *t->p = PyUnicode_DecodeUTF8(t->s, t->n - 1, NULL);
        } else if (t->intern) {
            *t->p = PyString_InternFromString(t->s);
        } else {
            *t->p = PyString_FromStringAndSize(t->s, t->n - 1);
        }
        #else
        if (t->is_unicode | t->is_str) {
            if (t->intern) {
                *t->p = PyUnicode_InternFromString(t->s);
            } else if (t->encoding) {
                *t->p = PyUnicode_Decode(t->s, t->n - 1, t->encoding, NULL);
            } else {
                *t->p = PyUnicode_FromStringAndSize(t->s, t->n - 1);
            }
        } else {
            *t->p = PyBytes_FromStringAndSize(t->s, t->n - 1);
        }
        #endif
        if (!*t->p)
            return -1;
        ++t;
    }
    return 0;
}

static CYTHON_INLINE PyObject* __Pyx_PyUnicode_FromString(const char* c_str) {
    return __Pyx_PyUnicode_FromStringAndSize(c_str, (Py_ssize_t)strlen(c_str));
}
static CYTHON_INLINE char* __Pyx_PyObject_AsString(PyObject* o) {
    Py_ssize_t ignore;
    return __Pyx_PyObject_AsStringAndSize(o, &ignore);
}
static CYTHON_INLINE char* __Pyx_PyObject_AsStringAndSize(PyObject* o, Py_ssize_t *length) {
#if CYTHON_COMPILING_IN_CPYTHON && (__PYX_DEFAULT_STRING_ENCODING_IS_ASCII || __PYX_DEFAULT_STRING_ENCODING_IS_DEFAULT)
    if (
#if PY_MAJOR_VERSION < 3 && __PYX_DEFAULT_STRING_ENCODING_IS_ASCII
            __Pyx_sys_getdefaultencoding_not_ascii &&
#endif
            PyUnicode_Check(o)) {
#if PY_VERSION_HEX < 0x03030000
        char* defenc_c;
        PyObject* defenc = _PyUnicode_AsDefaultEncodedString(o, NULL);
        if (!defenc) return NULL;
        defenc_c = PyBytes_AS_STRING(defenc);
#if __PYX_DEFAULT_STRING_ENCODING_IS_ASCII
        {
            char* end = defenc_c + PyBytes_GET_SIZE(defenc);
            char* c;
            for (c = defenc_c; c < end; c++) {
                if ((unsigned char) (*c) >= 128) {
                    PyUnicode_AsASCIIString(o);
                    return NULL;
                }
            }
        }
#endif
        *length = PyBytes_GET_SIZE(defenc);
        return defenc_c;
#else
        if (__Pyx_PyUnicode_READY(o) == -1) return NULL;
#if __PYX_DEFAULT_STRING_ENCODING_IS_ASCII
        if (PyUnicode_IS_ASCII(o)) {
            *length = PyUnicode_GET_LENGTH(o);
            return PyUnicode_AsUTF8(o);
        } else {
            PyUnicode_AsASCIIString(o);
            return NULL;
        }
#else
        return PyUnicode_AsUTF8AndSize(o, length);
#endif
#endif
    } else
#endif
#if (!CYTHON_COMPILING_IN_PYPY) || (defined(PyByteArray_AS_STRING) && defined(PyByteArray_GET_SIZE))
    if (PyByteArray_Check(o)) {
        *length = PyByteArray_GET_SIZE(o);
        return PyByteArray_AS_STRING(o);
    } else
#endif
    {
        char* result;
        int r = PyBytes_AsStringAndSize(o, &result, length);
        if (unlikely(r < 0)) {
            return NULL;
        } else {
            return result;
        }
    }
}
static CYTHON_INLINE int __Pyx_PyObject_IsTrue(PyObject* x) {
   int is_true = x == Py_True;
   if (is_true | (x == Py_False) | (x == Py_None)) return is_true;
   else return PyObject_IsTrue(x);
}
static CYTHON_INLINE PyObject* __Pyx_PyNumber_Int(PyObject* x) {
  PyNumberMethods *m;
  const char *name = NULL;
  PyObject *res = NULL;
#if PY_MAJOR_VERSION < 3
  if (PyInt_Check(x) || PyLong_Check(x))
#else
  if (PyLong_Check(x))
#endif
    return __Pyx_NewRef(x);
  m = Py_TYPE(x)->tp_as_number;
#if PY_MAJOR_VERSION < 3
  if (m && m->nb_int) {
    name = "int";
    res = PyNumber_Int(x);
  }
  else if (m && m->nb_long) {
    name = "long";
    res = PyNumber_Long(x);
  }
#else
  if (m && m->nb_int) {
    name = "int";
    res = PyNumber_Long(x);
  }
#endif
  if (res) {
#if PY_MAJOR_VERSION < 3
    if (!PyInt_Check(res) && !PyLong_Check(res)) {
#else
    if (!PyLong_Check(res)) {
#endif
      PyErr_Format(PyExc_TypeError,
                   "__%.4s__ returned non-%.4s (type %.200s)",
                   name, name, Py_TYPE(res)->tp_name);
      Py_DECREF(res);
      return NULL;
    }
  }
  else if (!PyErr_Occurred()) {
    PyErr_SetString(PyExc_TypeError,
                    "an integer is required");
  }
  return res;
}
static CYTHON_INLINE Py_ssize_t __Pyx_PyIndex_AsSsize_t(PyObject* b) {
  Py_ssize_t ival;
  PyObject *x;
#if PY_MAJOR_VERSION < 3
  if (likely(PyInt_CheckExact(b))) {
    if (sizeof(Py_ssize_t) >= sizeof(long))
        return PyInt_AS_LONG(b);
    else
        return PyInt_AsSsize_t(x);
  }
#endif
  if (likely(PyLong_CheckExact(b))) {
    #if CYTHON_USE_PYLONG_INTERNALS
    const digit* digits = ((PyLongObject*)b)->ob_digit;
    const Py_ssize_t size = Py_SIZE(b);
    if (likely(__Pyx_sst_abs(size) <= 1)) {
        ival = likely(size) ? digits[0] : 0;
        if (size == -1) ival = -ival;
        return ival;
    } else {
      switch (size) {
         case 2:
           if (8 * sizeof(Py_ssize_t) > 2 * PyLong_SHIFT) {
             return (Py_ssize_t) (((((size_t)digits[1]) << PyLong_SHIFT) | (size_t)digits[0]));
           }
           break;
         case -2:
           if (8 * sizeof(Py_ssize_t) > 2 * PyLong_SHIFT) {
             return -(Py_ssize_t) (((((size_t)digits[1]) << PyLong_SHIFT) | (size_t)digits[0]));
           }
           break;
         case 3:
           if (8 * sizeof(Py_ssize_t) > 3 * PyLong_SHIFT) {
             return (Py_ssize_t) (((((((size_t)digits[2]) << PyLong_SHIFT) | (size_t)digits[1]) << PyLong_SHIFT) | (size_t)digits[0]));
           }
           break;
         case -3:
           if (8 * sizeof(Py_ssize_t) > 3 * PyLong_SHIFT) {
             return -(Py_ssize_t) (((((((size_t)digits[2]) << PyLong_SHIFT) | (size_t)digits[1]) << PyLong_SHIFT) | (size_t)digits[0]));
           }
           break;
         case 4:
           if (8 * sizeof(Py_ssize_t) > 4 * PyLong_SHIFT) {
             return (Py_ssize_t) (((((((((size_t)digits[3]) << PyLong_SHIFT) | (size_t)digits[2]) << PyLong_SHIFT) | (size_t)digits[1]) << PyLong_SHIFT) | (size_t)digits[0]));
           }
           break;
         case -4:
           if (8 * sizeof(Py_ssize_t) > 4 * PyLong_SHIFT) {
             return -(Py_ssize_t) (((((((((size_t)digits[3]) << PyLong_SHIFT) | (size_t)digits[2]) << PyLong_SHIFT) | (size_t)digits[1]) << PyLong_SHIFT) | (size_t)digits[0]));
           }
           break;
      }
    }
    #endif
    return PyLong_AsSsize_t(b);
  }
  x = PyNumber_Index(b);
  if (!x) return -1;
  ival = PyInt_AsSsize_t(x);
  Py_DECREF(x);
  return ival;
}
static CYTHON_INLINE PyObject * __Pyx_PyInt_FromSize_t(size_t ival) {
    return PyInt_FromSize_t(ival);
}


#endif /* Py_PYTHON_H */
