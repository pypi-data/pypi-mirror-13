/* Generated by Cython 0.23.4 */

/* BEGIN: Cython Metadata
{
    "distutils": {
        "include_dirs": [
            ".",
            "/home/alex/Apps/anaconda/lib/python3.4/site-packages/numpy/core/include"
        ]
    }
}
END: Cython Metadata */

#define PY_SSIZE_T_CLEAN
#include "Python.h"
#ifndef Py_PYTHON_H
    #error Python headers needed to compile C extensions, please install development version of Python.
#elif PY_VERSION_HEX < 0x02060000 || (0x03000000 <= PY_VERSION_HEX && PY_VERSION_HEX < 0x03020000)
    #error Cython requires Python 2.6+ or Python 3.2+.
#else
#define CYTHON_ABI "0_23_4"
#include <stddef.h>
#ifndef offsetof
#define offsetof(type, member) ( (size_t) & ((type*)0) -> member )
#endif
#if !defined(WIN32) && !defined(MS_WINDOWS)
  #ifndef __stdcall
    #define __stdcall
  #endif
  #ifndef __cdecl
    #define __cdecl
  #endif
  #ifndef __fastcall
    #define __fastcall
  #endif
#endif
#ifndef DL_IMPORT
  #define DL_IMPORT(t) t
#endif
#ifndef DL_EXPORT
  #define DL_EXPORT(t) t
#endif
#ifndef PY_LONG_LONG
  #define PY_LONG_LONG LONG_LONG
#endif
#ifndef Py_HUGE_VAL
  #define Py_HUGE_VAL HUGE_VAL
#endif
#ifdef PYPY_VERSION
#define CYTHON_COMPILING_IN_PYPY 1
#define CYTHON_COMPILING_IN_CPYTHON 0
#else
#define CYTHON_COMPILING_IN_PYPY 0
#define CYTHON_COMPILING_IN_CPYTHON 1
#endif
#if !defined(CYTHON_USE_PYLONG_INTERNALS) && CYTHON_COMPILING_IN_CPYTHON && PY_VERSION_HEX >= 0x02070000
#define CYTHON_USE_PYLONG_INTERNALS 1
#endif
#if CYTHON_COMPILING_IN_PYPY && PY_VERSION_HEX < 0x02070600 && !defined(Py_OptimizeFlag)
#define Py_OptimizeFlag 0
#endif
#define __PYX_BUILD_PY_SSIZE_T "n"
#define CYTHON_FORMAT_SSIZE_T "z"
#if PY_MAJOR_VERSION < 3
  #define __Pyx_BUILTIN_MODULE_NAME "__builtin__"
  #define __Pyx_PyCode_New(a, k, l, s, f, code, c, n, v, fv, cell, fn, name, fline, lnos)\
          PyCode_New(a+k, l, s, f, code, c, n, v, fv, cell, fn, name, fline, lnos)
  #define __Pyx_DefaultClassType PyClass_Type
#else
  #define __Pyx_BUILTIN_MODULE_NAME "builtins"
  #define __Pyx_PyCode_New(a, k, l, s, f, code, c, n, v, fv, cell, fn, name, fline, lnos)\
          PyCode_New(a, k, l, s, f, code, c, n, v, fv, cell, fn, name, fline, lnos)
  #define __Pyx_DefaultClassType PyType_Type
#endif
#ifndef Py_TPFLAGS_CHECKTYPES
  #define Py_TPFLAGS_CHECKTYPES 0
#endif
#ifndef Py_TPFLAGS_HAVE_INDEX
  #define Py_TPFLAGS_HAVE_INDEX 0
#endif
#ifndef Py_TPFLAGS_HAVE_NEWBUFFER
  #define Py_TPFLAGS_HAVE_NEWBUFFER 0
#endif
#ifndef Py_TPFLAGS_HAVE_FINALIZE
  #define Py_TPFLAGS_HAVE_FINALIZE 0
#endif
#if PY_VERSION_HEX > 0x03030000 && defined(PyUnicode_KIND)
  #define CYTHON_PEP393_ENABLED 1
  #define __Pyx_PyUnicode_READY(op)       (likely(PyUnicode_IS_READY(op)) ?\
                                              0 : _PyUnicode_Ready((PyObject *)(op)))
  #define __Pyx_PyUnicode_GET_LENGTH(u)   PyUnicode_GET_LENGTH(u)
  #define __Pyx_PyUnicode_READ_CHAR(u, i) PyUnicode_READ_CHAR(u, i)
  #define __Pyx_PyUnicode_KIND(u)         PyUnicode_KIND(u)
  #define __Pyx_PyUnicode_DATA(u)         PyUnicode_DATA(u)
  #define __Pyx_PyUnicode_READ(k, d, i)   PyUnicode_READ(k, d, i)
#else
  #define CYTHON_PEP393_ENABLED 0
  #define __Pyx_PyUnicode_READY(op)       (0)
  #define __Pyx_PyUnicode_GET_LENGTH(u)   PyUnicode_GET_SIZE(u)
  #define __Pyx_PyUnicode_READ_CHAR(u, i) ((Py_UCS4)(PyUnicode_AS_UNICODE(u)[i]))
  #define __Pyx_PyUnicode_KIND(u)         (sizeof(Py_UNICODE))
  #define __Pyx_PyUnicode_DATA(u)         ((void*)PyUnicode_AS_UNICODE(u))
  #define __Pyx_PyUnicode_READ(k, d, i)   ((void)(k), (Py_UCS4)(((Py_UNICODE*)d)[i]))
#endif
#if CYTHON_COMPILING_IN_PYPY
  #define __Pyx_PyUnicode_Concat(a, b)      PyNumber_Add(a, b)
  #define __Pyx_PyUnicode_ConcatSafe(a, b)  PyNumber_Add(a, b)
#else
  #define __Pyx_PyUnicode_Concat(a, b)      PyUnicode_Concat(a, b)
  #define __Pyx_PyUnicode_ConcatSafe(a, b)  ((unlikely((a) == Py_None) || unlikely((b) == Py_None)) ?\
      PyNumber_Add(a, b) : __Pyx_PyUnicode_Concat(a, b))
#endif
#if CYTHON_COMPILING_IN_PYPY && !defined(PyUnicode_Contains)
  #define PyUnicode_Contains(u, s)  PySequence_Contains(u, s)
#endif
#define __Pyx_PyString_FormatSafe(a, b)   ((unlikely((a) == Py_None)) ? PyNumber_Remainder(a, b) : __Pyx_PyString_Format(a, b))
#define __Pyx_PyUnicode_FormatSafe(a, b)  ((unlikely((a) == Py_None)) ? PyNumber_Remainder(a, b) : PyUnicode_Format(a, b))
#if PY_MAJOR_VERSION >= 3
  #define __Pyx_PyString_Format(a, b)  PyUnicode_Format(a, b)
#else
  #define __Pyx_PyString_Format(a, b)  PyString_Format(a, b)
#endif
#if PY_MAJOR_VERSION >= 3
  #define PyBaseString_Type            PyUnicode_Type
  #define PyStringObject               PyUnicodeObject
  #define PyString_Type                PyUnicode_Type
  #define PyString_Check               PyUnicode_Check
  #define PyString_CheckExact          PyUnicode_CheckExact
#endif
#if PY_MAJOR_VERSION >= 3
  #define __Pyx_PyBaseString_Check(obj) PyUnicode_Check(obj)
  #define __Pyx_PyBaseString_CheckExact(obj) PyUnicode_CheckExact(obj)
#else
  #define __Pyx_PyBaseString_Check(obj) (PyString_Check(obj) || PyUnicode_Check(obj))
  #define __Pyx_PyBaseString_CheckExact(obj) (PyString_CheckExact(obj) || PyUnicode_CheckExact(obj))
#endif
#ifndef PySet_CheckExact
  #define PySet_CheckExact(obj)        (Py_TYPE(obj) == &PySet_Type)
#endif
#define __Pyx_TypeCheck(obj, type) PyObject_TypeCheck(obj, (PyTypeObject *)type)
#if PY_MAJOR_VERSION >= 3
  #define PyIntObject                  PyLongObject
  #define PyInt_Type                   PyLong_Type
  #define PyInt_Check(op)              PyLong_Check(op)
  #define PyInt_CheckExact(op)         PyLong_CheckExact(op)
  #define PyInt_FromString             PyLong_FromString
  #define PyInt_FromUnicode            PyLong_FromUnicode
  #define PyInt_FromLong               PyLong_FromLong
  #define PyInt_FromSize_t             PyLong_FromSize_t
  #define PyInt_FromSsize_t            PyLong_FromSsize_t
  #define PyInt_AsLong                 PyLong_AsLong
  #define PyInt_AS_LONG                PyLong_AS_LONG
  #define PyInt_AsSsize_t              PyLong_AsSsize_t
  #define PyInt_AsUnsignedLongMask     PyLong_AsUnsignedLongMask
  #define PyInt_AsUnsignedLongLongMask PyLong_AsUnsignedLongLongMask
  #define PyNumber_Int                 PyNumber_Long
#endif
#if PY_MAJOR_VERSION >= 3
  #define PyBoolObject                 PyLongObject
#endif
#if PY_MAJOR_VERSION >= 3 && CYTHON_COMPILING_IN_PYPY
  #ifndef PyUnicode_InternFromString
    #define PyUnicode_InternFromString(s) PyUnicode_FromString(s)
  #endif
#endif
#if PY_VERSION_HEX < 0x030200A4
  typedef long Py_hash_t;
  #define __Pyx_PyInt_FromHash_t PyInt_FromLong
  #define __Pyx_PyInt_AsHash_t   PyInt_AsLong
#else
  #define __Pyx_PyInt_FromHash_t PyInt_FromSsize_t
  #define __Pyx_PyInt_AsHash_t   PyInt_AsSsize_t
#endif
#if PY_MAJOR_VERSION >= 3
  #define __Pyx_PyMethod_New(func, self, klass) ((self) ? PyMethod_New(func, self) : PyInstanceMethod_New(func))
#else
  #define __Pyx_PyMethod_New(func, self, klass) PyMethod_New(func, self, klass)
#endif
#if PY_VERSION_HEX >= 0x030500B1
#define __Pyx_PyAsyncMethodsStruct PyAsyncMethods
#define __Pyx_PyType_AsAsync(obj) (Py_TYPE(obj)->tp_as_async)
#elif CYTHON_COMPILING_IN_CPYTHON && PY_MAJOR_VERSION >= 3
typedef struct {
    unaryfunc am_await;
    unaryfunc am_aiter;
    unaryfunc am_anext;
} __Pyx_PyAsyncMethodsStruct;
#define __Pyx_PyType_AsAsync(obj) ((__Pyx_PyAsyncMethodsStruct*) (Py_TYPE(obj)->tp_reserved))
#else
#define __Pyx_PyType_AsAsync(obj) NULL
#endif
#ifndef CYTHON_RESTRICT
  #if defined(__GNUC__)
    #define CYTHON_RESTRICT __restrict__
  #elif defined(_MSC_VER) && _MSC_VER >= 1400
    #define CYTHON_RESTRICT __restrict
  #elif defined (__STDC_VERSION__) && __STDC_VERSION__ >= 199901L
    #define CYTHON_RESTRICT restrict
  #else
    #define CYTHON_RESTRICT
  #endif
#endif
#define __Pyx_void_to_None(void_result) ((void)(void_result), Py_INCREF(Py_None), Py_None)

#ifndef CYTHON_INLINE
  #if defined(__GNUC__)
    #define CYTHON_INLINE __inline__
  #elif defined(_MSC_VER)
    #define CYTHON_INLINE __inline
  #elif defined (__STDC_VERSION__) && __STDC_VERSION__ >= 199901L
    #define CYTHON_INLINE inline
  #else
    #define CYTHON_INLINE
  #endif
#endif

#if defined(WIN32) || defined(MS_WINDOWS)
  #define _USE_MATH_DEFINES
#endif
#include <math.h>
#ifdef NAN
#define __PYX_NAN() ((float) NAN)
#else
static CYTHON_INLINE float __PYX_NAN() {
  float value;
  memset(&value, 0xFF, sizeof(value));
  return value;
}
#endif


#if PY_MAJOR_VERSION >= 3
  #define __Pyx_PyNumber_Divide(x,y)         PyNumber_TrueDivide(x,y)
  #define __Pyx_PyNumber_InPlaceDivide(x,y)  PyNumber_InPlaceTrueDivide(x,y)
#else
  #define __Pyx_PyNumber_Divide(x,y)         PyNumber_TrueDivide(x,y)
  #define __Pyx_PyNumber_InPlaceDivide(x,y)  PyNumber_InPlaceTrueDivide(x,y)
#endif

#ifndef __PYX_EXTERN_C
  #ifdef __cplusplus
    #define __PYX_EXTERN_C extern "C"
  #else
    #define __PYX_EXTERN_C extern
  #endif
#endif

#define __PYX_HAVE__raysect__core__acceleration__accelerator
#define __PYX_HAVE_API__raysect__core__acceleration__accelerator
#ifdef _OPENMP
#include <omp.h>
#endif /* _OPENMP */

#ifdef PYREX_WITHOUT_ASSERTIONS
#define CYTHON_WITHOUT_ASSERTIONS
#endif

#ifndef CYTHON_UNUSED
# if defined(__GNUC__)
#   if !(defined(__cplusplus)) || (__GNUC__ > 3 || (__GNUC__ == 3 && __GNUC_MINOR__ >= 4))
#     define CYTHON_UNUSED __attribute__ ((__unused__))
#   else
#     define CYTHON_UNUSED
#   endif
# elif defined(__ICC) || (defined(__INTEL_COMPILER) && !defined(_MSC_VER))
#   define CYTHON_UNUSED __attribute__ ((__unused__))
# else
#   define CYTHON_UNUSED
# endif
#endif
#ifndef CYTHON_NCP_UNUSED
# if CYTHON_COMPILING_IN_CPYTHON
#  define CYTHON_NCP_UNUSED
# else
#  define CYTHON_NCP_UNUSED CYTHON_UNUSED
# endif
#endif
typedef struct {PyObject **p; char *s; const Py_ssize_t n; const char* encoding;
                const char is_unicode; const char is_str; const char intern; } __Pyx_StringTabEntry;

#define __PYX_DEFAULT_STRING_ENCODING_IS_ASCII 0
#define __PYX_DEFAULT_STRING_ENCODING_IS_DEFAULT 0
#define __PYX_DEFAULT_STRING_ENCODING ""
#define __Pyx_PyObject_FromString __Pyx_PyBytes_FromString
#define __Pyx_PyObject_FromStringAndSize __Pyx_PyBytes_FromStringAndSize
#define __Pyx_uchar_cast(c) ((unsigned char)c)
#define __Pyx_long_cast(x) ((long)x)
#define __Pyx_fits_Py_ssize_t(v, type, is_signed)  (\
    (sizeof(type) < sizeof(Py_ssize_t))  ||\
    (sizeof(type) > sizeof(Py_ssize_t) &&\
          likely(v < (type)PY_SSIZE_T_MAX ||\
                 v == (type)PY_SSIZE_T_MAX)  &&\
          (!is_signed || likely(v > (type)PY_SSIZE_T_MIN ||\
                                v == (type)PY_SSIZE_T_MIN)))  ||\
    (sizeof(type) == sizeof(Py_ssize_t) &&\
          (is_signed || likely(v < (type)PY_SSIZE_T_MAX ||\
                               v == (type)PY_SSIZE_T_MAX)))  )
#if defined (__cplusplus) && __cplusplus >= 201103L
    #include <cstdlib>
    #define __Pyx_sst_abs(value) std::abs(value)
#elif SIZEOF_INT >= SIZEOF_SIZE_T
    #define __Pyx_sst_abs(value) abs(value)
#elif SIZEOF_LONG >= SIZEOF_SIZE_T
    #define __Pyx_sst_abs(value) labs(value)
#elif defined (_MSC_VER) && defined (_M_X64)
    #define __Pyx_sst_abs(value) _abs64(value)
#elif defined (__STDC_VERSION__) && __STDC_VERSION__ >= 199901L
    #define __Pyx_sst_abs(value) llabs(value)
#elif defined (__GNUC__)
    #define __Pyx_sst_abs(value) __builtin_llabs(value)
#else
    #define __Pyx_sst_abs(value) ((value<0) ? -value : value)
#endif
static CYTHON_INLINE char* __Pyx_PyObject_AsString(PyObject*);
static CYTHON_INLINE char* __Pyx_PyObject_AsStringAndSize(PyObject*, Py_ssize_t* length);
#define __Pyx_PyByteArray_FromString(s) PyByteArray_FromStringAndSize((const char*)s, strlen((const char*)s))
#define __Pyx_PyByteArray_FromStringAndSize(s, l) PyByteArray_FromStringAndSize((const char*)s, l)
#define __Pyx_PyBytes_FromString        PyBytes_FromString
#define __Pyx_PyBytes_FromStringAndSize PyBytes_FromStringAndSize
static CYTHON_INLINE PyObject* __Pyx_PyUnicode_FromString(const char*);
#if PY_MAJOR_VERSION < 3
    #define __Pyx_PyStr_FromString        __Pyx_PyBytes_FromString
    #define __Pyx_PyStr_FromStringAndSize __Pyx_PyBytes_FromStringAndSize
#else
    #define __Pyx_PyStr_FromString        __Pyx_PyUnicode_FromString
    #define __Pyx_PyStr_FromStringAndSize __Pyx_PyUnicode_FromStringAndSize
#endif
#define __Pyx_PyObject_AsSString(s)    ((signed char*) __Pyx_PyObject_AsString(s))
#define __Pyx_PyObject_AsUString(s)    ((unsigned char*) __Pyx_PyObject_AsString(s))
#define __Pyx_PyObject_FromCString(s)  __Pyx_PyObject_FromString((const char*)s)
#define __Pyx_PyBytes_FromCString(s)   __Pyx_PyBytes_FromString((const char*)s)
#define __Pyx_PyByteArray_FromCString(s)   __Pyx_PyByteArray_FromString((const char*)s)
#define __Pyx_PyStr_FromCString(s)     __Pyx_PyStr_FromString((const char*)s)
#define __Pyx_PyUnicode_FromCString(s) __Pyx_PyUnicode_FromString((const char*)s)
#if PY_MAJOR_VERSION < 3
static CYTHON_INLINE size_t __Pyx_Py_UNICODE_strlen(const Py_UNICODE *u)
{
    const Py_UNICODE *u_end = u;
    while (*u_end++) ;
    return (size_t)(u_end - u - 1);
}
#else
#define __Pyx_Py_UNICODE_strlen Py_UNICODE_strlen
#endif
#define __Pyx_PyUnicode_FromUnicode(u)       PyUnicode_FromUnicode(u, __Pyx_Py_UNICODE_strlen(u))
#define __Pyx_PyUnicode_FromUnicodeAndLength PyUnicode_FromUnicode
#define __Pyx_PyUnicode_AsUnicode            PyUnicode_AsUnicode
#define __Pyx_NewRef(obj) (Py_INCREF(obj), obj)
#define __Pyx_Owned_Py_None(b) __Pyx_NewRef(Py_None)
#define __Pyx_PyBool_FromLong(b) ((b) ? __Pyx_NewRef(Py_True) : __Pyx_NewRef(Py_False))
static CYTHON_INLINE int __Pyx_PyObject_IsTrue(PyObject*);
static CYTHON_INLINE PyObject* __Pyx_PyNumber_Int(PyObject* x);
static CYTHON_INLINE Py_ssize_t __Pyx_PyIndex_AsSsize_t(PyObject*);
static CYTHON_INLINE PyObject * __Pyx_PyInt_FromSize_t(size_t);
#if CYTHON_COMPILING_IN_CPYTHON
#define __pyx_PyFloat_AsDouble(x) (PyFloat_CheckExact(x) ? PyFloat_AS_DOUBLE(x) : PyFloat_AsDouble(x))
#else
#define __pyx_PyFloat_AsDouble(x) PyFloat_AsDouble(x)
#endif
#define __pyx_PyFloat_AsFloat(x) ((float) __pyx_PyFloat_AsDouble(x))
#if PY_MAJOR_VERSION < 3 && __PYX_DEFAULT_STRING_ENCODING_IS_ASCII
static int __Pyx_sys_getdefaultencoding_not_ascii;
static int __Pyx_init_sys_getdefaultencoding_params(void) {
    PyObject* sys;
    PyObject* default_encoding = NULL;
    PyObject* ascii_chars_u = NULL;
    PyObject* ascii_chars_b = NULL;
    const char* default_encoding_c;
    sys = PyImport_ImportModule("sys");
    if (!sys) goto bad;
    default_encoding = PyObject_CallMethod(sys, (char*) "getdefaultencoding", NULL);
    Py_DECREF(sys);
    if (!default_encoding) goto bad;
    default_encoding_c = PyBytes_AsString(default_encoding);
    if (!default_encoding_c) goto bad;
    if (strcmp(default_encoding_c, "ascii") == 0) {
        __Pyx_sys_getdefaultencoding_not_ascii = 0;
    } else {
        char ascii_chars[128];
        int c;
        for (c = 0; c < 128; c++) {
            ascii_chars[c] = c;
        }
        __Pyx_sys_getdefaultencoding_not_ascii = 1;
        ascii_chars_u = PyUnicode_DecodeASCII(ascii_chars, 128, NULL);
        if (!ascii_chars_u) goto bad;
        ascii_chars_b = PyUnicode_AsEncodedString(ascii_chars_u, default_encoding_c, NULL);
        if (!ascii_chars_b || !PyBytes_Check(ascii_chars_b) || memcmp(ascii_chars, PyBytes_AS_STRING(ascii_chars_b), 128) != 0) {
            PyErr_Format(
                PyExc_ValueError,
                "This module compiled with c_string_encoding=ascii, but default encoding '%.200s' is not a superset of ascii.",
                default_encoding_c);
            goto bad;
        }
        Py_DECREF(ascii_chars_u);
        Py_DECREF(ascii_chars_b);
    }
    Py_DECREF(default_encoding);
    return 0;
bad:
    Py_XDECREF(default_encoding);
    Py_XDECREF(ascii_chars_u);
    Py_XDECREF(ascii_chars_b);
    return -1;
}
#endif
#if __PYX_DEFAULT_STRING_ENCODING_IS_DEFAULT && PY_MAJOR_VERSION >= 3
#define __Pyx_PyUnicode_FromStringAndSize(c_str, size) PyUnicode_DecodeUTF8(c_str, size, NULL)
#else
#define __Pyx_PyUnicode_FromStringAndSize(c_str, size) PyUnicode_Decode(c_str, size, __PYX_DEFAULT_STRING_ENCODING, NULL)
#if __PYX_DEFAULT_STRING_ENCODING_IS_DEFAULT
static char* __PYX_DEFAULT_STRING_ENCODING;
static int __Pyx_init_sys_getdefaultencoding_params(void) {
    PyObject* sys;
    PyObject* default_encoding = NULL;
    char* default_encoding_c;
    sys = PyImport_ImportModule("sys");
    if (!sys) goto bad;
    default_encoding = PyObject_CallMethod(sys, (char*) (const char*) "getdefaultencoding", NULL);
    Py_DECREF(sys);
    if (!default_encoding) goto bad;
    default_encoding_c = PyBytes_AsString(default_encoding);
    if (!default_encoding_c) goto bad;
    __PYX_DEFAULT_STRING_ENCODING = (char*) malloc(strlen(default_encoding_c));
    if (!__PYX_DEFAULT_STRING_ENCODING) goto bad;
    strcpy(__PYX_DEFAULT_STRING_ENCODING, default_encoding_c);
    Py_DECREF(default_encoding);
    return 0;
bad:
    Py_XDECREF(default_encoding);
    return -1;
}
#endif
#endif


/* Test for GCC > 2.95 */
#if defined(__GNUC__)     && (__GNUC__ > 2 || (__GNUC__ == 2 && (__GNUC_MINOR__ > 95)))
  #define likely(x)   __builtin_expect(!!(x), 1)
  #define unlikely(x) __builtin_expect(!!(x), 0)
#else /* !__GNUC__ or GCC < 2.95 */
  #define likely(x)   (x)
  #define unlikely(x) (x)
#endif /* __GNUC__ */

static PyObject *__pyx_m;
static PyObject *__pyx_d;
static PyObject *__pyx_b;
static PyObject *__pyx_empty_tuple;
static PyObject *__pyx_empty_bytes;
static int __pyx_lineno;
static int __pyx_clineno = 0;
static const char * __pyx_cfilenm= __FILE__;
static const char *__pyx_filename;


static const char *__pyx_f[] = {
  "raysect/core/acceleration/accelerator.pyx",
  "raysect/core/math/affinematrix.pxd",
  "raysect/core/math/vector.pxd",
  "raysect/core/math/point.pxd",
  "raysect/core/math/normal.pxd",
  "raysect/core/boundingbox.pxd",
  "raysect/core/classes.pxd",
  "raysect/core/math/_vec3.pxd",
  "raysect/core/math/_mat4.pxd",
  "raysect/core/scenegraph/_nodebase.pxd",
  "raysect/core/scenegraph/node.pxd",
  "raysect/core/scenegraph/primitive.pxd",
};

/*--- Type declarations ---*/
struct __pyx_obj_7raysect_4core_4math_5_vec3__Vec3;
struct __pyx_obj_7raysect_4core_4math_5_mat4__Mat4;
struct __pyx_obj_7raysect_4core_4math_12affinematrix_AffineMatrix3D;
struct __pyx_obj_7raysect_4core_4math_6vector_Vector3D;
struct __pyx_obj_7raysect_4core_4math_5point_Point3D;
struct __pyx_obj_7raysect_4core_4math_5point_Point2D;
struct __pyx_obj_7raysect_4core_4math_6normal_Normal3D;
struct __pyx_obj_7raysect_4core_10scenegraph_9_nodebase__NodeBase;
struct __pyx_obj_7raysect_4core_10scenegraph_4node_Node;
struct __pyx_obj_7raysect_4core_11boundingbox_BoundingBox3D;
struct __pyx_obj_7raysect_4core_11boundingbox_BoundingBox2D;
struct __pyx_obj_7raysect_4core_10scenegraph_9primitive_Primitive;
struct __pyx_obj_7raysect_4core_7classes_Ray;
struct __pyx_obj_7raysect_4core_7classes_Intersection;
struct __pyx_obj_7raysect_4core_7classes_Material;
struct __pyx_obj_7raysect_4core_12acceleration_11accelerator_Accelerator;
struct __pyx_opt_args_7raysect_4core_11boundingbox_13BoundingBox3D_extend;
struct __pyx_opt_args_7raysect_4core_11boundingbox_13BoundingBox2D_extend;

/* "raysect/core/boundingbox.pxd":52
 *     cpdef object union(self, BoundingBox3D box)
 * 
 *     cpdef object extend(self, Point3D point, double padding=*)             # <<<<<<<<<<<<<<
 * 
 *     cpdef double surface_area(self)
 */
struct __pyx_opt_args_7raysect_4core_11boundingbox_13BoundingBox3D_extend {
  int __pyx_n;
  double padding;
};

/* "raysect/core/boundingbox.pxd":93
 *     cpdef object union(self, BoundingBox2D box)
 * 
 *     cpdef object extend(self, Point2D point, double padding=*)             # <<<<<<<<<<<<<<
 * 
 *     cpdef double surface_area(self)
 */
struct __pyx_opt_args_7raysect_4core_11boundingbox_13BoundingBox2D_extend {
  int __pyx_n;
  double padding;
};
struct __pyx_opt_args_7raysect_4core_7classes_3Ray_copy;

/* "raysect/core/classes.pxd":46
 *     cpdef Point3D point_on(self, double t)
 * 
 *     cpdef Ray copy(self, Point3D origin=*, Vector3D direction=*)             # <<<<<<<<<<<<<<
 * 
 * 
 */
struct __pyx_opt_args_7raysect_4core_7classes_3Ray_copy {
  int __pyx_n;
  struct __pyx_obj_7raysect_4core_4math_5point_Point3D *origin;
  struct __pyx_obj_7raysect_4core_4math_6vector_Vector3D *direction;
};

/* "raysect/core/math/_vec3.pxd":32
 * # POSSIBILITY OF SUCH DAMAGE.
 * 
 * cdef class _Vec3:             # <<<<<<<<<<<<<<
 * 
 *     cdef public double x, y, z
 */
struct __pyx_obj_7raysect_4core_4math_5_vec3__Vec3 {
  PyObject_HEAD
  struct __pyx_vtabstruct_7raysect_4core_4math_5_vec3__Vec3 *__pyx_vtab;
  double x;
  double y;
  double z;
};


/* "raysect/core/math/_mat4.pxd":32
 * # POSSIBILITY OF SUCH DAMAGE.
 * 
 * cdef class _Mat4:             # <<<<<<<<<<<<<<
 * 
 *     cdef double m[4][4]
 */
struct __pyx_obj_7raysect_4core_4math_5_mat4__Mat4 {
  PyObject_HEAD
  struct __pyx_vtabstruct_7raysect_4core_4math_5_mat4__Mat4 *__pyx_vtab;
  double m[4][4];
};


/* "raysect/core/math/affinematrix.pxd":35
 * from raysect.core.math.vector cimport Vector3D
 * 
 * cdef class AffineMatrix3D(_Mat4):             # <<<<<<<<<<<<<<
 * 
 *     cpdef AffineMatrix3D inverse(self)
 */
struct __pyx_obj_7raysect_4core_4math_12affinematrix_AffineMatrix3D {
  struct __pyx_obj_7raysect_4core_4math_5_mat4__Mat4 __pyx_base;
};


/* "raysect/core/math/vector.pxd":35
 * from raysect.core.math.affinematrix cimport AffineMatrix3D
 * 
 * cdef class Vector3D(_Vec3):             # <<<<<<<<<<<<<<
 * 
 *     cpdef Vector3D cross(self, _Vec3 v)
 */
struct __pyx_obj_7raysect_4core_4math_6vector_Vector3D {
  struct __pyx_obj_7raysect_4core_4math_5_vec3__Vec3 __pyx_base;
};


/* "raysect/core/math/point.pxd":36
 * from raysect.core.math.affinematrix cimport AffineMatrix3D
 * 
 * cdef class Point3D:             # <<<<<<<<<<<<<<
 * 
 *     cdef public double x, y, z
 */
struct __pyx_obj_7raysect_4core_4math_5point_Point3D {
  PyObject_HEAD
  struct __pyx_vtabstruct_7raysect_4core_4math_5point_Point3D *__pyx_vtab;
  double x;
  double y;
  double z;
};


/* "raysect/core/math/point.pxd":73
 * 
 * 
 * cdef class Point2D:             # <<<<<<<<<<<<<<
 * 
 *     cdef public double x, y
 */
struct __pyx_obj_7raysect_4core_4math_5point_Point2D {
  PyObject_HEAD
  struct __pyx_vtabstruct_7raysect_4core_4math_5point_Point2D *__pyx_vtab;
  double x;
  double y;
};


/* "raysect/core/math/normal.pxd":36
 * from raysect.core.math.affinematrix cimport AffineMatrix3D
 * 
 * cdef class Normal3D(_Vec3):             # <<<<<<<<<<<<<<
 * 
 *     cpdef Vector3D cross(self, _Vec3 v)
 */
struct __pyx_obj_7raysect_4core_4math_6normal_Normal3D {
  struct __pyx_obj_7raysect_4core_4math_5_vec3__Vec3 __pyx_base;
};


/* "raysect/core/scenegraph/_nodebase.pxd":34
 * from raysect.core.math.affinematrix cimport AffineMatrix3D
 * 
 * cdef class _NodeBase:             # <<<<<<<<<<<<<<
 * 
 *     cdef unicode _name
 */
struct __pyx_obj_7raysect_4core_10scenegraph_9_nodebase__NodeBase {
  PyObject_HEAD
  PyObject *_name;
  PyObject *_parent;
  PyObject *children;
  struct __pyx_obj_7raysect_4core_10scenegraph_9_nodebase__NodeBase *root;
  struct __pyx_obj_7raysect_4core_4math_12affinematrix_AffineMatrix3D *_transform;
  struct __pyx_obj_7raysect_4core_4math_12affinematrix_AffineMatrix3D *_root_transform;
  struct __pyx_obj_7raysect_4core_4math_12affinematrix_AffineMatrix3D *_root_transform_inverse;
  int _track_modifications;
};


/* "raysect/core/scenegraph/node.pxd":35
 * from raysect.core.math.affinematrix cimport AffineMatrix3D
 * 
 * cdef class Node(_NodeBase):             # <<<<<<<<<<<<<<
 * 
 *     cpdef AffineMatrix3D to(self, _NodeBase node)
 */
struct __pyx_obj_7raysect_4core_10scenegraph_4node_Node {
  struct __pyx_obj_7raysect_4core_10scenegraph_9_nodebase__NodeBase __pyx_base;
  struct __pyx_vtabstruct_7raysect_4core_10scenegraph_4node_Node *__pyx_vtab;
};


/* "raysect/core/boundingbox.pxd":35
 * from raysect.core.classes cimport Ray
 * 
 * cdef class BoundingBox3D:             # <<<<<<<<<<<<<<
 * 
 *     cdef Point3D lower
 */
struct __pyx_obj_7raysect_4core_11boundingbox_BoundingBox3D {
  PyObject_HEAD
  struct __pyx_vtabstruct_7raysect_4core_11boundingbox_BoundingBox3D *__pyx_vtab;
  struct __pyx_obj_7raysect_4core_4math_5point_Point3D *lower;
  struct __pyx_obj_7raysect_4core_4math_5point_Point3D *upper;
};


/* "raysect/core/boundingbox.pxd":84
 * 
 * 
 * cdef class BoundingBox2D:             # <<<<<<<<<<<<<<
 * 
 *     cdef Point2D lower
 */
struct __pyx_obj_7raysect_4core_11boundingbox_BoundingBox2D {
  PyObject_HEAD
  struct __pyx_vtabstruct_7raysect_4core_11boundingbox_BoundingBox2D *__pyx_vtab;
  struct __pyx_obj_7raysect_4core_4math_5point_Point2D *lower;
  struct __pyx_obj_7raysect_4core_4math_5point_Point2D *upper;
};


/* "raysect/core/scenegraph/primitive.pxd":37
 * from raysect.core.boundingbox cimport BoundingBox3D
 * 
 * cdef class Primitive(Node):             # <<<<<<<<<<<<<<
 * 
 *     cdef Material material
 */
struct __pyx_obj_7raysect_4core_10scenegraph_9primitive_Primitive {
  struct __pyx_obj_7raysect_4core_10scenegraph_4node_Node __pyx_base;
  struct __pyx_obj_7raysect_4core_7classes_Material *material;
};


/* "raysect/core/classes.pxd":38
 * from raysect.core.scenegraph.primitive cimport Primitive
 * 
 * cdef class Ray:             # <<<<<<<<<<<<<<
 * 
 *     cdef public Point3D origin
 */
struct __pyx_obj_7raysect_4core_7classes_Ray {
  PyObject_HEAD
  struct __pyx_vtabstruct_7raysect_4core_7classes_Ray *__pyx_vtab;
  struct __pyx_obj_7raysect_4core_4math_5point_Point3D *origin;
  struct __pyx_obj_7raysect_4core_4math_6vector_Vector3D *direction;
  double max_distance;
};


/* "raysect/core/classes.pxd":60
 * 
 * 
 * cdef class Intersection:             # <<<<<<<<<<<<<<
 * 
 *     cdef public Ray ray
 */
struct __pyx_obj_7raysect_4core_7classes_Intersection {
  PyObject_HEAD
  struct __pyx_obj_7raysect_4core_7classes_Ray *ray;
  double ray_distance;
  int exiting;
  struct __pyx_obj_7raysect_4core_10scenegraph_9primitive_Primitive *primitive;
  struct __pyx_obj_7raysect_4core_4math_5point_Point3D *hit_point;
  struct __pyx_obj_7raysect_4core_4math_5point_Point3D *inside_point;
  struct __pyx_obj_7raysect_4core_4math_5point_Point3D *outside_point;
  struct __pyx_obj_7raysect_4core_4math_6normal_Normal3D *normal;
  struct __pyx_obj_7raysect_4core_4math_12affinematrix_AffineMatrix3D *to_local;
  struct __pyx_obj_7raysect_4core_4math_12affinematrix_AffineMatrix3D *to_world;
};


/* "raysect/core/classes.pxd":94
 * 
 * 
 * cdef class Material:             # <<<<<<<<<<<<<<
 * 
 *     pass
 */
struct __pyx_obj_7raysect_4core_7classes_Material {
  PyObject_HEAD
};


/* "raysect/core/acceleration/accelerator.pxd":36
 * from raysect.core.classes cimport Intersection
 * 
 * cdef class Accelerator:             # <<<<<<<<<<<<<<
 * 
 *     cpdef build(self, list primitives)
 */
struct __pyx_obj_7raysect_4core_12acceleration_11accelerator_Accelerator {
  PyObject_HEAD
  struct __pyx_vtabstruct_7raysect_4core_12acceleration_11accelerator_Accelerator *__pyx_vtab;
};



/* "raysect/core/math/_vec3.pxd":32
 * # POSSIBILITY OF SUCH DAMAGE.
 * 
 * cdef class _Vec3:             # <<<<<<<<<<<<<<
 * 
 *     cdef public double x, y, z
 */

struct __pyx_vtabstruct_7raysect_4core_4math_5_vec3__Vec3 {
  double (*dot)(struct __pyx_obj_7raysect_4core_4math_5_vec3__Vec3 *, struct __pyx_obj_7raysect_4core_4math_5_vec3__Vec3 *, int __pyx_skip_dispatch);
  double (*get_length)(struct __pyx_obj_7raysect_4core_4math_5_vec3__Vec3 *);
  void (*set_length)(struct __pyx_obj_7raysect_4core_4math_5_vec3__Vec3 *, double);
  double (*get_index)(struct __pyx_obj_7raysect_4core_4math_5_vec3__Vec3 *, int);
  void (*set_index)(struct __pyx_obj_7raysect_4core_4math_5_vec3__Vec3 *, int, double);
};
static struct __pyx_vtabstruct_7raysect_4core_4math_5_vec3__Vec3 *__pyx_vtabptr_7raysect_4core_4math_5_vec3__Vec3;


/* "raysect/core/math/_mat4.pxd":32
 * # POSSIBILITY OF SUCH DAMAGE.
 * 
 * cdef class _Mat4:             # <<<<<<<<<<<<<<
 * 
 *     cdef double m[4][4]
 */

struct __pyx_vtabstruct_7raysect_4core_4math_5_mat4__Mat4 {
  double (*get_element)(struct __pyx_obj_7raysect_4core_4math_5_mat4__Mat4 *, int, int);
  void (*set_element)(struct __pyx_obj_7raysect_4core_4math_5_mat4__Mat4 *, int, int, double);
};
static struct __pyx_vtabstruct_7raysect_4core_4math_5_mat4__Mat4 *__pyx_vtabptr_7raysect_4core_4math_5_mat4__Mat4;


/* "raysect/core/math/affinematrix.pxd":35
 * from raysect.core.math.vector cimport Vector3D
 * 
 * cdef class AffineMatrix3D(_Mat4):             # <<<<<<<<<<<<<<
 * 
 *     cpdef AffineMatrix3D inverse(self)
 */

struct __pyx_vtabstruct_7raysect_4core_4math_12affinematrix_AffineMatrix3D {
  struct __pyx_vtabstruct_7raysect_4core_4math_5_mat4__Mat4 __pyx_base;
  struct __pyx_obj_7raysect_4core_4math_12affinematrix_AffineMatrix3D *(*inverse)(struct __pyx_obj_7raysect_4core_4math_12affinematrix_AffineMatrix3D *, int __pyx_skip_dispatch);
  struct __pyx_obj_7raysect_4core_4math_12affinematrix_AffineMatrix3D *(*mul)(struct __pyx_obj_7raysect_4core_4math_12affinematrix_AffineMatrix3D *, struct __pyx_obj_7raysect_4core_4math_12affinematrix_AffineMatrix3D *);
};
static struct __pyx_vtabstruct_7raysect_4core_4math_12affinematrix_AffineMatrix3D *__pyx_vtabptr_7raysect_4core_4math_12affinematrix_AffineMatrix3D;


/* "raysect/core/math/vector.pxd":35
 * from raysect.core.math.affinematrix cimport AffineMatrix3D
 * 
 * cdef class Vector3D(_Vec3):             # <<<<<<<<<<<<<<
 * 
 *     cpdef Vector3D cross(self, _Vec3 v)
 */

struct __pyx_vtabstruct_7raysect_4core_4math_6vector_Vector3D {
  struct __pyx_vtabstruct_7raysect_4core_4math_5_vec3__Vec3 __pyx_base;
  struct __pyx_obj_7raysect_4core_4math_6vector_Vector3D *(*cross)(struct __pyx_obj_7raysect_4core_4math_6vector_Vector3D *, struct __pyx_obj_7raysect_4core_4math_5_vec3__Vec3 *, int __pyx_skip_dispatch);
  struct __pyx_obj_7raysect_4core_4math_6vector_Vector3D *(*normalise)(struct __pyx_obj_7raysect_4core_4math_6vector_Vector3D *, int __pyx_skip_dispatch);
  struct __pyx_obj_7raysect_4core_4math_6vector_Vector3D *(*transform)(struct __pyx_obj_7raysect_4core_4math_6vector_Vector3D *, struct __pyx_obj_7raysect_4core_4math_12affinematrix_AffineMatrix3D *, int __pyx_skip_dispatch);
  struct __pyx_obj_7raysect_4core_4math_6vector_Vector3D *(*neg)(struct __pyx_obj_7raysect_4core_4math_6vector_Vector3D *);
  struct __pyx_obj_7raysect_4core_4math_6vector_Vector3D *(*add)(struct __pyx_obj_7raysect_4core_4math_6vector_Vector3D *, struct __pyx_obj_7raysect_4core_4math_5_vec3__Vec3 *);
  struct __pyx_obj_7raysect_4core_4math_6vector_Vector3D *(*sub)(struct __pyx_obj_7raysect_4core_4math_6vector_Vector3D *, struct __pyx_obj_7raysect_4core_4math_5_vec3__Vec3 *);
  struct __pyx_obj_7raysect_4core_4math_6vector_Vector3D *(*mul)(struct __pyx_obj_7raysect_4core_4math_6vector_Vector3D *, double);
  struct __pyx_obj_7raysect_4core_4math_6vector_Vector3D *(*div)(struct __pyx_obj_7raysect_4core_4math_6vector_Vector3D *, double);
  struct __pyx_obj_7raysect_4core_4math_6vector_Vector3D *(*copy)(struct __pyx_obj_7raysect_4core_4math_6vector_Vector3D *, int __pyx_skip_dispatch);
};
static struct __pyx_vtabstruct_7raysect_4core_4math_6vector_Vector3D *__pyx_vtabptr_7raysect_4core_4math_6vector_Vector3D;


/* "raysect/core/math/point.pxd":36
 * from raysect.core.math.affinematrix cimport AffineMatrix3D
 * 
 * cdef class Point3D:             # <<<<<<<<<<<<<<
 * 
 *     cdef public double x, y, z
 */

struct __pyx_vtabstruct_7raysect_4core_4math_5point_Point3D {
  struct __pyx_obj_7raysect_4core_4math_6vector_Vector3D *(*vector_to)(struct __pyx_obj_7raysect_4core_4math_5point_Point3D *, struct __pyx_obj_7raysect_4core_4math_5point_Point3D *, int __pyx_skip_dispatch);
  double (*distance_to)(struct __pyx_obj_7raysect_4core_4math_5point_Point3D *, struct __pyx_obj_7raysect_4core_4math_5point_Point3D *, int __pyx_skip_dispatch);
  struct __pyx_obj_7raysect_4core_4math_5point_Point3D *(*transform)(struct __pyx_obj_7raysect_4core_4math_5point_Point3D *, struct __pyx_obj_7raysect_4core_4math_12affinematrix_AffineMatrix3D *, int __pyx_skip_dispatch);
  struct __pyx_obj_7raysect_4core_4math_5point_Point3D *(*add)(struct __pyx_obj_7raysect_4core_4math_5point_Point3D *, struct __pyx_obj_7raysect_4core_4math_5_vec3__Vec3 *);
  struct __pyx_obj_7raysect_4core_4math_5point_Point3D *(*sub)(struct __pyx_obj_7raysect_4core_4math_5point_Point3D *, struct __pyx_obj_7raysect_4core_4math_5_vec3__Vec3 *);
  struct __pyx_obj_7raysect_4core_4math_5point_Point3D *(*copy)(struct __pyx_obj_7raysect_4core_4math_5point_Point3D *, int __pyx_skip_dispatch);
  double (*get_index)(struct __pyx_obj_7raysect_4core_4math_5point_Point3D *, int);
  void (*set_index)(struct __pyx_obj_7raysect_4core_4math_5point_Point3D *, int, double);
};
static struct __pyx_vtabstruct_7raysect_4core_4math_5point_Point3D *__pyx_vtabptr_7raysect_4core_4math_5point_Point3D;


/* "raysect/core/math/point.pxd":73
 * 
 * 
 * cdef class Point2D:             # <<<<<<<<<<<<<<
 * 
 *     cdef public double x, y
 */

struct __pyx_vtabstruct_7raysect_4core_4math_5point_Point2D {
  double (*distance_to)(struct __pyx_obj_7raysect_4core_4math_5point_Point2D *, struct __pyx_obj_7raysect_4core_4math_5point_Point2D *, int __pyx_skip_dispatch);
  struct __pyx_obj_7raysect_4core_4math_5point_Point2D *(*copy)(struct __pyx_obj_7raysect_4core_4math_5point_Point2D *, int __pyx_skip_dispatch);
  double (*get_index)(struct __pyx_obj_7raysect_4core_4math_5point_Point2D *, int);
  void (*set_index)(struct __pyx_obj_7raysect_4core_4math_5point_Point2D *, int, double);
};
static struct __pyx_vtabstruct_7raysect_4core_4math_5point_Point2D *__pyx_vtabptr_7raysect_4core_4math_5point_Point2D;


/* "raysect/core/math/normal.pxd":36
 * from raysect.core.math.affinematrix cimport AffineMatrix3D
 * 
 * cdef class Normal3D(_Vec3):             # <<<<<<<<<<<<<<
 * 
 *     cpdef Vector3D cross(self, _Vec3 v)
 */

struct __pyx_vtabstruct_7raysect_4core_4math_6normal_Normal3D {
  struct __pyx_vtabstruct_7raysect_4core_4math_5_vec3__Vec3 __pyx_base;
  struct __pyx_obj_7raysect_4core_4math_6vector_Vector3D *(*cross)(struct __pyx_obj_7raysect_4core_4math_6normal_Normal3D *, struct __pyx_obj_7raysect_4core_4math_5_vec3__Vec3 *, int __pyx_skip_dispatch);
  struct __pyx_obj_7raysect_4core_4math_6normal_Normal3D *(*normalise)(struct __pyx_obj_7raysect_4core_4math_6normal_Normal3D *, int __pyx_skip_dispatch);
  struct __pyx_obj_7raysect_4core_4math_6normal_Normal3D *(*transform)(struct __pyx_obj_7raysect_4core_4math_6normal_Normal3D *, struct __pyx_obj_7raysect_4core_4math_12affinematrix_AffineMatrix3D *, int __pyx_skip_dispatch);
  struct __pyx_obj_7raysect_4core_4math_6normal_Normal3D *(*transform_with_inverse)(struct __pyx_obj_7raysect_4core_4math_6normal_Normal3D *, struct __pyx_obj_7raysect_4core_4math_12affinematrix_AffineMatrix3D *, int __pyx_skip_dispatch);
  struct __pyx_obj_7raysect_4core_4math_6normal_Normal3D *(*neg)(struct __pyx_obj_7raysect_4core_4math_6normal_Normal3D *);
  struct __pyx_obj_7raysect_4core_4math_6normal_Normal3D *(*add)(struct __pyx_obj_7raysect_4core_4math_6normal_Normal3D *, struct __pyx_obj_7raysect_4core_4math_5_vec3__Vec3 *);
  struct __pyx_obj_7raysect_4core_4math_6normal_Normal3D *(*sub)(struct __pyx_obj_7raysect_4core_4math_6normal_Normal3D *, struct __pyx_obj_7raysect_4core_4math_5_vec3__Vec3 *);
  struct __pyx_obj_7raysect_4core_4math_6normal_Normal3D *(*mul)(struct __pyx_obj_7raysect_4core_4math_6normal_Normal3D *, double);
  struct __pyx_obj_7raysect_4core_4math_6normal_Normal3D *(*div)(struct __pyx_obj_7raysect_4core_4math_6normal_Normal3D *, double);
  struct __pyx_obj_7raysect_4core_4math_6normal_Normal3D *(*copy)(struct __pyx_obj_7raysect_4core_4math_6normal_Normal3D *, int __pyx_skip_dispatch);
  struct __pyx_obj_7raysect_4core_4math_6vector_Vector3D *(*as_vector)(struct __pyx_obj_7raysect_4core_4math_6normal_Normal3D *, int __pyx_skip_dispatch);
  struct __pyx_obj_7raysect_4core_4math_6vector_Vector3D *(*orthogonal)(struct __pyx_obj_7raysect_4core_4math_6normal_Normal3D *, int __pyx_skip_dispatch);
};
static struct __pyx_vtabstruct_7raysect_4core_4math_6normal_Normal3D *__pyx_vtabptr_7raysect_4core_4math_6normal_Normal3D;


/* "raysect/core/scenegraph/node.pxd":35
 * from raysect.core.math.affinematrix cimport AffineMatrix3D
 * 
 * cdef class Node(_NodeBase):             # <<<<<<<<<<<<<<
 * 
 *     cpdef AffineMatrix3D to(self, _NodeBase node)
 */

struct __pyx_vtabstruct_7raysect_4core_10scenegraph_4node_Node {
  struct __pyx_obj_7raysect_4core_4math_12affinematrix_AffineMatrix3D *(*to)(struct __pyx_obj_7raysect_4core_10scenegraph_4node_Node *, struct __pyx_obj_7raysect_4core_10scenegraph_9_nodebase__NodeBase *, int __pyx_skip_dispatch);
  struct __pyx_obj_7raysect_4core_4math_12affinematrix_AffineMatrix3D *(*to_local)(struct __pyx_obj_7raysect_4core_10scenegraph_4node_Node *, int __pyx_skip_dispatch);
  struct __pyx_obj_7raysect_4core_4math_12affinematrix_AffineMatrix3D *(*to_root)(struct __pyx_obj_7raysect_4core_10scenegraph_4node_Node *, int __pyx_skip_dispatch);
};
static struct __pyx_vtabstruct_7raysect_4core_10scenegraph_4node_Node *__pyx_vtabptr_7raysect_4core_10scenegraph_4node_Node;


/* "raysect/core/boundingbox.pxd":35
 * from raysect.core.classes cimport Ray
 * 
 * cdef class BoundingBox3D:             # <<<<<<<<<<<<<<
 * 
 *     cdef Point3D lower
 */

struct __pyx_vtabstruct_7raysect_4core_11boundingbox_BoundingBox3D {
  int (*hit)(struct __pyx_obj_7raysect_4core_11boundingbox_BoundingBox3D *, struct __pyx_obj_7raysect_4core_7classes_Ray *, int __pyx_skip_dispatch);
  PyObject *(*full_intersection)(struct __pyx_obj_7raysect_4core_11boundingbox_BoundingBox3D *, struct __pyx_obj_7raysect_4core_7classes_Ray *, int __pyx_skip_dispatch);
  int (*intersect)(struct __pyx_obj_7raysect_4core_11boundingbox_BoundingBox3D *, struct __pyx_obj_7raysect_4core_7classes_Ray *, double *, double *);
  void (*_slab)(struct __pyx_obj_7raysect_4core_11boundingbox_BoundingBox3D *, double, double, double, double, double *, double *);
  int (*contains)(struct __pyx_obj_7raysect_4core_11boundingbox_BoundingBox3D *, struct __pyx_obj_7raysect_4core_4math_5point_Point3D *, int __pyx_skip_dispatch);
  PyObject *(*__pyx_union)(struct __pyx_obj_7raysect_4core_11boundingbox_BoundingBox3D *, struct __pyx_obj_7raysect_4core_11boundingbox_BoundingBox3D *, int __pyx_skip_dispatch);
  PyObject *(*extend)(struct __pyx_obj_7raysect_4core_11boundingbox_BoundingBox3D *, struct __pyx_obj_7raysect_4core_4math_5point_Point3D *, int __pyx_skip_dispatch, struct __pyx_opt_args_7raysect_4core_11boundingbox_13BoundingBox3D_extend *__pyx_optional_args);
  double (*surface_area)(struct __pyx_obj_7raysect_4core_11boundingbox_BoundingBox3D *, int __pyx_skip_dispatch);
  double (*volume)(struct __pyx_obj_7raysect_4core_11boundingbox_BoundingBox3D *, int __pyx_skip_dispatch);
  PyObject *(*vertices)(struct __pyx_obj_7raysect_4core_11boundingbox_BoundingBox3D *, int __pyx_skip_dispatch);
  double (*extent)(struct __pyx_obj_7raysect_4core_11boundingbox_BoundingBox3D *, int, int __pyx_skip_dispatch);
  int (*largest_axis)(struct __pyx_obj_7raysect_4core_11boundingbox_BoundingBox3D *, int __pyx_skip_dispatch);
  double (*largest_extent)(struct __pyx_obj_7raysect_4core_11boundingbox_BoundingBox3D *, int __pyx_skip_dispatch);
  PyObject *(*pad)(struct __pyx_obj_7raysect_4core_11boundingbox_BoundingBox3D *, double, int __pyx_skip_dispatch);
};
static struct __pyx_vtabstruct_7raysect_4core_11boundingbox_BoundingBox3D *__pyx_vtabptr_7raysect_4core_11boundingbox_BoundingBox3D;


/* "raysect/core/boundingbox.pxd":84
 * 
 * 
 * cdef class BoundingBox2D:             # <<<<<<<<<<<<<<
 * 
 *     cdef Point2D lower
 */

struct __pyx_vtabstruct_7raysect_4core_11boundingbox_BoundingBox2D {
  int (*contains)(struct __pyx_obj_7raysect_4core_11boundingbox_BoundingBox2D *, struct __pyx_obj_7raysect_4core_4math_5point_Point2D *, int __pyx_skip_dispatch);
  PyObject *(*__pyx_union)(struct __pyx_obj_7raysect_4core_11boundingbox_BoundingBox2D *, struct __pyx_obj_7raysect_4core_11boundingbox_BoundingBox2D *, int __pyx_skip_dispatch);
  PyObject *(*extend)(struct __pyx_obj_7raysect_4core_11boundingbox_BoundingBox2D *, struct __pyx_obj_7raysect_4core_4math_5point_Point2D *, int __pyx_skip_dispatch, struct __pyx_opt_args_7raysect_4core_11boundingbox_13BoundingBox2D_extend *__pyx_optional_args);
  double (*surface_area)(struct __pyx_obj_7raysect_4core_11boundingbox_BoundingBox2D *, int __pyx_skip_dispatch);
  PyObject *(*vertices)(struct __pyx_obj_7raysect_4core_11boundingbox_BoundingBox2D *, int __pyx_skip_dispatch);
  double (*extent)(struct __pyx_obj_7raysect_4core_11boundingbox_BoundingBox2D *, int, int __pyx_skip_dispatch);
  int (*largest_axis)(struct __pyx_obj_7raysect_4core_11boundingbox_BoundingBox2D *, int __pyx_skip_dispatch);
  double (*largest_extent)(struct __pyx_obj_7raysect_4core_11boundingbox_BoundingBox2D *, int __pyx_skip_dispatch);
  PyObject *(*pad)(struct __pyx_obj_7raysect_4core_11boundingbox_BoundingBox2D *, double, int __pyx_skip_dispatch);
};
static struct __pyx_vtabstruct_7raysect_4core_11boundingbox_BoundingBox2D *__pyx_vtabptr_7raysect_4core_11boundingbox_BoundingBox2D;


/* "raysect/core/scenegraph/primitive.pxd":37
 * from raysect.core.boundingbox cimport BoundingBox3D
 * 
 * cdef class Primitive(Node):             # <<<<<<<<<<<<<<
 * 
 *     cdef Material material
 */

struct __pyx_vtabstruct_7raysect_4core_10scenegraph_9primitive_Primitive {
  struct __pyx_vtabstruct_7raysect_4core_10scenegraph_4node_Node __pyx_base;
  struct __pyx_obj_7raysect_4core_7classes_Intersection *(*hit)(struct __pyx_obj_7raysect_4core_10scenegraph_9primitive_Primitive *, struct __pyx_obj_7raysect_4core_7classes_Ray *, int __pyx_skip_dispatch);
  struct __pyx_obj_7raysect_4core_7classes_Intersection *(*next_intersection)(struct __pyx_obj_7raysect_4core_10scenegraph_9primitive_Primitive *, int __pyx_skip_dispatch);
  int (*contains)(struct __pyx_obj_7raysect_4core_10scenegraph_9primitive_Primitive *, struct __pyx_obj_7raysect_4core_4math_5point_Point3D *, int __pyx_skip_dispatch);
  struct __pyx_obj_7raysect_4core_11boundingbox_BoundingBox3D *(*bounding_box)(struct __pyx_obj_7raysect_4core_10scenegraph_9primitive_Primitive *, int __pyx_skip_dispatch);
  PyObject *(*notify_root)(struct __pyx_obj_7raysect_4core_10scenegraph_9primitive_Primitive *, int __pyx_skip_dispatch);
};
static struct __pyx_vtabstruct_7raysect_4core_10scenegraph_9primitive_Primitive *__pyx_vtabptr_7raysect_4core_10scenegraph_9primitive_Primitive;


/* "raysect/core/classes.pxd":38
 * from raysect.core.scenegraph.primitive cimport Primitive
 * 
 * cdef class Ray:             # <<<<<<<<<<<<<<
 * 
 *     cdef public Point3D origin
 */

struct __pyx_vtabstruct_7raysect_4core_7classes_Ray {
  struct __pyx_obj_7raysect_4core_4math_5point_Point3D *(*point_on)(struct __pyx_obj_7raysect_4core_7classes_Ray *, double, int __pyx_skip_dispatch);
  struct __pyx_obj_7raysect_4core_7classes_Ray *(*copy)(struct __pyx_obj_7raysect_4core_7classes_Ray *, int __pyx_skip_dispatch, struct __pyx_opt_args_7raysect_4core_7classes_3Ray_copy *__pyx_optional_args);
};
static struct __pyx_vtabstruct_7raysect_4core_7classes_Ray *__pyx_vtabptr_7raysect_4core_7classes_Ray;


/* "raysect/core/acceleration/accelerator.pyx":32
 * # POSSIBILITY OF SUCH DAMAGE.
 * 
 * cdef class Accelerator:             # <<<<<<<<<<<<<<
 * 
 *     cpdef build(self, list primitives):
 */

struct __pyx_vtabstruct_7raysect_4core_12acceleration_11accelerator_Accelerator {
  PyObject *(*build)(struct __pyx_obj_7raysect_4core_12acceleration_11accelerator_Accelerator *, PyObject *, int __pyx_skip_dispatch);
  struct __pyx_obj_7raysect_4core_7classes_Intersection *(*hit)(struct __pyx_obj_7raysect_4core_12acceleration_11accelerator_Accelerator *, struct __pyx_obj_7raysect_4core_7classes_Ray *, int __pyx_skip_dispatch);
  PyObject *(*contains)(struct __pyx_obj_7raysect_4core_12acceleration_11accelerator_Accelerator *, struct __pyx_obj_7raysect_4core_4math_5point_Point3D *, int __pyx_skip_dispatch);
};
static struct __pyx_vtabstruct_7raysect_4core_12acceleration_11accelerator_Accelerator *__pyx_vtabptr_7raysect_4core_12acceleration_11accelerator_Accelerator;

/* --- Runtime support code (head) --- */
#ifndef CYTHON_REFNANNY
  #define CYTHON_REFNANNY 0
#endif
#if CYTHON_REFNANNY
  typedef struct {
    void (*INCREF)(void*, PyObject*, int);
    void (*DECREF)(void*, PyObject*, int);
    void (*GOTREF)(void*, PyObject*, int);
    void (*GIVEREF)(void*, PyObject*, int);
    void* (*SetupContext)(const char*, int, const char*);
    void (*FinishContext)(void**);
  } __Pyx_RefNannyAPIStruct;
  static __Pyx_RefNannyAPIStruct *__Pyx_RefNanny = NULL;
  static __Pyx_RefNannyAPIStruct *__Pyx_RefNannyImportAPI(const char *modname);
  #define __Pyx_RefNannyDeclarations void *__pyx_refnanny = NULL;
#ifdef WITH_THREAD
  #define __Pyx_RefNannySetupContext(name, acquire_gil)\
          if (acquire_gil) {\
              PyGILState_STATE __pyx_gilstate_save = PyGILState_Ensure();\
              __pyx_refnanny = __Pyx_RefNanny->SetupContext((name), __LINE__, __FILE__);\
              PyGILState_Release(__pyx_gilstate_save);\
          } else {\
              __pyx_refnanny = __Pyx_RefNanny->SetupContext((name), __LINE__, __FILE__);\
          }
#else
  #define __Pyx_RefNannySetupContext(name, acquire_gil)\
          __pyx_refnanny = __Pyx_RefNanny->SetupContext((name), __LINE__, __FILE__)
#endif
  #define __Pyx_RefNannyFinishContext()\
          __Pyx_RefNanny->FinishContext(&__pyx_refnanny)
  #define __Pyx_INCREF(r)  __Pyx_RefNanny->INCREF(__pyx_refnanny, (PyObject *)(r), __LINE__)
  #define __Pyx_DECREF(r)  __Pyx_RefNanny->DECREF(__pyx_refnanny, (PyObject *)(r), __LINE__)
  #define __Pyx_GOTREF(r)  __Pyx_RefNanny->GOTREF(__pyx_refnanny, (PyObject *)(r), __LINE__)
  #define __Pyx_GIVEREF(r) __Pyx_RefNanny->GIVEREF(__pyx_refnanny, (PyObject *)(r), __LINE__)
  #define __Pyx_XINCREF(r)  do { if((r) != NULL) {__Pyx_INCREF(r); }} while(0)
  #define __Pyx_XDECREF(r)  do { if((r) != NULL) {__Pyx_DECREF(r); }} while(0)
  #define __Pyx_XGOTREF(r)  do { if((r) != NULL) {__Pyx_GOTREF(r); }} while(0)
  #define __Pyx_XGIVEREF(r) do { if((r) != NULL) {__Pyx_GIVEREF(r);}} while(0)
#else
  #define __Pyx_RefNannyDeclarations
  #define __Pyx_RefNannySetupContext(name, acquire_gil)
  #define __Pyx_RefNannyFinishContext()
  #define __Pyx_INCREF(r) Py_INCREF(r)
  #define __Pyx_DECREF(r) Py_DECREF(r)
  #define __Pyx_GOTREF(r)
  #define __Pyx_GIVEREF(r)
  #define __Pyx_XINCREF(r) Py_XINCREF(r)
  #define __Pyx_XDECREF(r) Py_XDECREF(r)
  #define __Pyx_XGOTREF(r)
  #define __Pyx_XGIVEREF(r)
#endif
#define __Pyx_XDECREF_SET(r, v) do {\
        PyObject *tmp = (PyObject *) r;\
        r = v; __Pyx_XDECREF(tmp);\
    } while (0)
#define __Pyx_DECREF_SET(r, v) do {\
        PyObject *tmp = (PyObject *) r;\
        r = v; __Pyx_DECREF(tmp);\
    } while (0)
#define __Pyx_CLEAR(r)    do { PyObject* tmp = ((PyObject*)(r)); r = NULL; __Pyx_DECREF(tmp);} while(0)
#define __Pyx_XCLEAR(r)   do { if((r) != NULL) {PyObject* tmp = ((PyObject*)(r)); r = NULL; __Pyx_DECREF(tmp);}} while(0)

#if CYTHON_COMPILING_IN_CPYTHON
static CYTHON_INLINE PyObject* __Pyx_PyObject_GetAttrStr(PyObject* obj, PyObject* attr_name) {
    PyTypeObject* tp = Py_TYPE(obj);
    if (likely(tp->tp_getattro))
        return tp->tp_getattro(obj, attr_name);
#if PY_MAJOR_VERSION < 3
    if (likely(tp->tp_getattr))
        return tp->tp_getattr(obj, PyString_AS_STRING(attr_name));
#endif
    return PyObject_GetAttr(obj, attr_name);
}
#else
#define __Pyx_PyObject_GetAttrStr(o,n) PyObject_GetAttr(o,n)
#endif

static PyObject *__Pyx_GetBuiltinName(PyObject *name);

#if CYTHON_COMPILING_IN_CPYTHON
static CYTHON_INLINE PyObject* __Pyx_PyObject_Call(PyObject *func, PyObject *arg, PyObject *kw);
#else
#define __Pyx_PyObject_Call(func, arg, kw) PyObject_Call(func, arg, kw)
#endif

#if CYTHON_COMPILING_IN_CPYTHON
static CYTHON_INLINE PyObject* __Pyx_PyObject_CallMethO(PyObject *func, PyObject *arg);
#endif

static CYTHON_INLINE PyObject* __Pyx_PyObject_CallOneArg(PyObject *func, PyObject *arg);

static CYTHON_INLINE int __Pyx_ArgTypeTest(PyObject *obj, PyTypeObject *type, int none_allowed,
    const char *name, int exact);

static CYTHON_INLINE int __Pyx_TypeTest(PyObject *obj, PyTypeObject *type);

static CYTHON_INLINE void __Pyx_ErrRestore(PyObject *type, PyObject *value, PyObject *tb);
static CYTHON_INLINE void __Pyx_ErrFetch(PyObject **type, PyObject **value, PyObject **tb);

static void __Pyx_Raise(PyObject *type, PyObject *value, PyObject *tb, PyObject *cause);

#define __Pyx_tp_new(type_obj, args) __Pyx_tp_new_kwargs(type_obj, args, NULL)
static CYTHON_INLINE PyObject* __Pyx_tp_new_kwargs(PyObject* type_obj, PyObject* args, PyObject* kwargs) {
    return (PyObject*) (((PyTypeObject*)type_obj)->tp_new((PyTypeObject*)type_obj, args, kwargs));
}

static int __Pyx_SetVtable(PyObject *dict, void *vtable);

static void* __Pyx_GetVtable(PyObject *dict);

typedef struct {
    int code_line;
    PyCodeObject* code_object;
} __Pyx_CodeObjectCacheEntry;
struct __Pyx_CodeObjectCache {
    int count;
    int max_count;
    __Pyx_CodeObjectCacheEntry* entries;
};
static struct __Pyx_CodeObjectCache __pyx_code_cache = {0,0,NULL};
static int __pyx_bisect_code_objects(__Pyx_CodeObjectCacheEntry* entries, int count, int code_line);
static PyCodeObject *__pyx_find_code_object(int code_line);
static void __pyx_insert_code_object(int code_line, PyCodeObject* code_object);

static void __Pyx_AddTraceback(const char *funcname, int c_line,
                               int py_line, const char *filename);

static CYTHON_INLINE PyObject* __Pyx_PyInt_From_long(long value);

static CYTHON_INLINE long __Pyx_PyInt_As_long(PyObject *);

static CYTHON_INLINE int __Pyx_PyInt_As_int(PyObject *);

static int __Pyx_check_binary_version(void);

#if !defined(__Pyx_PyIdentifier_FromString)
#if PY_MAJOR_VERSION < 3
  #define __Pyx_PyIdentifier_FromString(s) PyString_FromString(s)
#else
  #define __Pyx_PyIdentifier_FromString(s) PyUnicode_FromString(s)
#endif
#endif

static PyObject *__Pyx_ImportModule(const char *name);

static PyTypeObject *__Pyx_ImportType(const char *module_name, const char *class_name, size_t size, int strict);

static int __Pyx_InitStrings(__Pyx_StringTabEntry *t);

static PyObject *__pyx_f_7raysect_4core_12acceleration_11accelerator_11Accelerator_build(CYTHON_UNUSED struct __pyx_obj_7raysect_4core_12acceleration_11accelerator_Accelerator *__pyx_v_self, CYTHON_UNUSED PyObject *__pyx_v_primitives, int __pyx_skip_dispatch); /* proto*/
static struct __pyx_obj_7raysect_4core_7classes_Intersection *__pyx_f_7raysect_4core_12acceleration_11accelerator_11Accelerator_hit(CYTHON_UNUSED struct __pyx_obj_7raysect_4core_12acceleration_11accelerator_Accelerator *__pyx_v_self, CYTHON_UNUSED struct __pyx_obj_7raysect_4core_7classes_Ray *__pyx_v_ray, int __pyx_skip_dispatch); /* proto*/
static PyObject *__pyx_f_7raysect_4core_12acceleration_11accelerator_11Accelerator_contains(CYTHON_UNUSED struct __pyx_obj_7raysect_4core_12acceleration_11accelerator_Accelerator *__pyx_v_self, CYTHON_UNUSED struct __pyx_obj_7raysect_4core_4math_5point_Point3D *__pyx_v_point, int __pyx_skip_dispatch); /* proto*/

/* Module declarations from 'raysect.core.math._vec3' */
static PyTypeObject *__pyx_ptype_7raysect_4core_4math_5_vec3__Vec3 = 0;

/* Module declarations from 'raysect.core.math._mat4' */
static PyTypeObject *__pyx_ptype_7raysect_4core_4math_5_mat4__Mat4 = 0;

/* Module declarations from 'raysect.core.math.affinematrix' */
static PyTypeObject *__pyx_ptype_7raysect_4core_4math_12affinematrix_AffineMatrix3D = 0;

/* Module declarations from 'raysect.core.math.vector' */
static PyTypeObject *__pyx_ptype_7raysect_4core_4math_6vector_Vector3D = 0;

/* Module declarations from 'raysect.core.math.point' */
static PyTypeObject *__pyx_ptype_7raysect_4core_4math_5point_Point3D = 0;
static PyTypeObject *__pyx_ptype_7raysect_4core_4math_5point_Point2D = 0;

/* Module declarations from 'raysect.core.math.normal' */
static PyTypeObject *__pyx_ptype_7raysect_4core_4math_6normal_Normal3D = 0;

/* Module declarations from 'raysect.core.scenegraph._nodebase' */
static PyTypeObject *__pyx_ptype_7raysect_4core_10scenegraph_9_nodebase__NodeBase = 0;

/* Module declarations from 'raysect.core.scenegraph.node' */
static PyTypeObject *__pyx_ptype_7raysect_4core_10scenegraph_4node_Node = 0;

/* Module declarations from 'raysect.core.boundingbox' */
static PyTypeObject *__pyx_ptype_7raysect_4core_11boundingbox_BoundingBox3D = 0;
static PyTypeObject *__pyx_ptype_7raysect_4core_11boundingbox_BoundingBox2D = 0;

/* Module declarations from 'raysect.core.scenegraph.primitive' */
static PyTypeObject *__pyx_ptype_7raysect_4core_10scenegraph_9primitive_Primitive = 0;

/* Module declarations from 'raysect.core.classes' */
static PyTypeObject *__pyx_ptype_7raysect_4core_7classes_Ray = 0;
static PyTypeObject *__pyx_ptype_7raysect_4core_7classes_Intersection = 0;
static PyTypeObject *__pyx_ptype_7raysect_4core_7classes_Material = 0;

/* Module declarations from 'raysect.core.acceleration.accelerator' */
static PyTypeObject *__pyx_ptype_7raysect_4core_12acceleration_11accelerator_Accelerator = 0;
#define __Pyx_MODULE_NAME "raysect.core.acceleration.accelerator"
int __pyx_module_is_main_raysect__core__acceleration__accelerator = 0;

/* Implementation of 'raysect.core.acceleration.accelerator' */
static PyObject *__pyx_builtin_NotImplementedError;
static char __pyx_k_hit[] = "hit";
static char __pyx_k_main[] = "__main__";
static char __pyx_k_test[] = "__test__";
static char __pyx_k_build[] = "build";
static char __pyx_k_contains[] = "contains";
static char __pyx_k_pyx_vtable[] = "__pyx_vtable__";
static char __pyx_k_NotImplementedError[] = "NotImplementedError";
static char __pyx_k_Accelerator_virtual_method_conta[] = "Accelerator virtual method contains() has not been implemented.";
static char __pyx_k_Accelerator_virtual_method_hit_h[] = "Accelerator virtual method hit() has not been implemented.";
static PyObject *__pyx_kp_u_Accelerator_virtual_method_conta;
static PyObject *__pyx_kp_u_Accelerator_virtual_method_hit_h;
static PyObject *__pyx_n_s_NotImplementedError;
static PyObject *__pyx_n_s_build;
static PyObject *__pyx_n_s_contains;
static PyObject *__pyx_n_s_hit;
static PyObject *__pyx_n_s_main;
static PyObject *__pyx_n_s_pyx_vtable;
static PyObject *__pyx_n_s_test;
static PyObject *__pyx_pf_7raysect_4core_12acceleration_11accelerator_11Accelerator_build(struct __pyx_obj_7raysect_4core_12acceleration_11accelerator_Accelerator *__pyx_v_self, PyObject *__pyx_v_primitives); /* proto */
static PyObject *__pyx_pf_7raysect_4core_12acceleration_11accelerator_11Accelerator_2hit(struct __pyx_obj_7raysect_4core_12acceleration_11accelerator_Accelerator *__pyx_v_self, struct __pyx_obj_7raysect_4core_7classes_Ray *__pyx_v_ray); /* proto */
static PyObject *__pyx_pf_7raysect_4core_12acceleration_11accelerator_11Accelerator_4contains(struct __pyx_obj_7raysect_4core_12acceleration_11accelerator_Accelerator *__pyx_v_self, struct __pyx_obj_7raysect_4core_4math_5point_Point3D *__pyx_v_point); /* proto */
static PyObject *__pyx_tp_new_7raysect_4core_12acceleration_11accelerator_Accelerator(PyTypeObject *t, PyObject *a, PyObject *k); /*proto*/
static PyObject *__pyx_tuple_;
static PyObject *__pyx_tuple__2;

/* "raysect/core/acceleration/accelerator.pyx":34
 * cdef class Accelerator:
 * 
 *     cpdef build(self, list primitives):             # <<<<<<<<<<<<<<
 * 
 *         pass
 */

static PyObject *__pyx_pw_7raysect_4core_12acceleration_11accelerator_11Accelerator_1build(PyObject *__pyx_v_self, PyObject *__pyx_v_primitives); /*proto*/
static PyObject *__pyx_f_7raysect_4core_12acceleration_11accelerator_11Accelerator_build(CYTHON_UNUSED struct __pyx_obj_7raysect_4core_12acceleration_11accelerator_Accelerator *__pyx_v_self, CYTHON_UNUSED PyObject *__pyx_v_primitives, int __pyx_skip_dispatch) {
  PyObject *__pyx_r = NULL;
  __Pyx_RefNannyDeclarations
  PyObject *__pyx_t_1 = NULL;
  PyObject *__pyx_t_2 = NULL;
  PyObject *__pyx_t_3 = NULL;
  PyObject *__pyx_t_4 = NULL;
  PyObject *__pyx_t_5 = NULL;
  int __pyx_lineno = 0;
  const char *__pyx_filename = NULL;
  int __pyx_clineno = 0;
  __Pyx_RefNannySetupContext("build", 0);
  /* Check if called by wrapper */
  if (unlikely(__pyx_skip_dispatch)) ;
  /* Check if overridden in Python */
  else if (unlikely(Py_TYPE(((PyObject *)__pyx_v_self))->tp_dictoffset != 0)) {
    __pyx_t_1 = __Pyx_PyObject_GetAttrStr(((PyObject *)__pyx_v_self), __pyx_n_s_build); if (unlikely(!__pyx_t_1)) {__pyx_filename = __pyx_f[0]; __pyx_lineno = 34; __pyx_clineno = __LINE__; goto __pyx_L1_error;}
    __Pyx_GOTREF(__pyx_t_1);
    if (!PyCFunction_Check(__pyx_t_1) || (PyCFunction_GET_FUNCTION(__pyx_t_1) != (PyCFunction)__pyx_pw_7raysect_4core_12acceleration_11accelerator_11Accelerator_1build)) {
      __Pyx_XDECREF(__pyx_r);
      __Pyx_INCREF(__pyx_t_1);
      __pyx_t_3 = __pyx_t_1; __pyx_t_4 = NULL;
      if (CYTHON_COMPILING_IN_CPYTHON && unlikely(PyMethod_Check(__pyx_t_3))) {
        __pyx_t_4 = PyMethod_GET_SELF(__pyx_t_3);
        if (likely(__pyx_t_4)) {
          PyObject* function = PyMethod_GET_FUNCTION(__pyx_t_3);
          __Pyx_INCREF(__pyx_t_4);
          __Pyx_INCREF(function);
          __Pyx_DECREF_SET(__pyx_t_3, function);
        }
      }
      if (!__pyx_t_4) {
        __pyx_t_2 = __Pyx_PyObject_CallOneArg(__pyx_t_3, __pyx_v_primitives); if (unlikely(!__pyx_t_2)) {__pyx_filename = __pyx_f[0]; __pyx_lineno = 34; __pyx_clineno = __LINE__; goto __pyx_L1_error;}
        __Pyx_GOTREF(__pyx_t_2);
      } else {
        __pyx_t_5 = PyTuple_New(1+1); if (unlikely(!__pyx_t_5)) {__pyx_filename = __pyx_f[0]; __pyx_lineno = 34; __pyx_clineno = __LINE__; goto __pyx_L1_error;}
        __Pyx_GOTREF(__pyx_t_5);
        __Pyx_GIVEREF(__pyx_t_4); PyTuple_SET_ITEM(__pyx_t_5, 0, __pyx_t_4); __pyx_t_4 = NULL;
        __Pyx_INCREF(__pyx_v_primitives);
        __Pyx_GIVEREF(__pyx_v_primitives);
        PyTuple_SET_ITEM(__pyx_t_5, 0+1, __pyx_v_primitives);
        __pyx_t_2 = __Pyx_PyObject_Call(__pyx_t_3, __pyx_t_5, NULL); if (unlikely(!__pyx_t_2)) {__pyx_filename = __pyx_f[0]; __pyx_lineno = 34; __pyx_clineno = __LINE__; goto __pyx_L1_error;}
        __Pyx_GOTREF(__pyx_t_2);
        __Pyx_DECREF(__pyx_t_5); __pyx_t_5 = 0;
      }
      __Pyx_DECREF(__pyx_t_3); __pyx_t_3 = 0;
      __pyx_r = __pyx_t_2;
      __pyx_t_2 = 0;
      __Pyx_DECREF(__pyx_t_1); __pyx_t_1 = 0;
      goto __pyx_L0;
    }
    __Pyx_DECREF(__pyx_t_1); __pyx_t_1 = 0;
  }

  /* "raysect/core/acceleration/accelerator.pyx":36
 *     cpdef build(self, list primitives):
 * 
 *         pass             # <<<<<<<<<<<<<<
 * 
 *     cpdef Intersection hit(self, Ray ray):
 */

  /* function exit code */
  __pyx_r = Py_None; __Pyx_INCREF(Py_None);
  goto __pyx_L0;
  __pyx_L1_error:;
  __Pyx_XDECREF(__pyx_t_1);
  __Pyx_XDECREF(__pyx_t_2);
  __Pyx_XDECREF(__pyx_t_3);
  __Pyx_XDECREF(__pyx_t_4);
  __Pyx_XDECREF(__pyx_t_5);
  __Pyx_AddTraceback("raysect.core.acceleration.accelerator.Accelerator.build", __pyx_clineno, __pyx_lineno, __pyx_filename);
  __pyx_r = 0;
  __pyx_L0:;
  __Pyx_XGIVEREF(__pyx_r);
  __Pyx_RefNannyFinishContext();
  return __pyx_r;
}

/* "raysect/core/acceleration/accelerator.pyx":34
 * cdef class Accelerator:
 * 
 *     cpdef build(self, list primitives):             # <<<<<<<<<<<<<<
 * 
 *         pass
 */

/* Python wrapper */
static PyObject *__pyx_pw_7raysect_4core_12acceleration_11accelerator_11Accelerator_1build(PyObject *__pyx_v_self, PyObject *__pyx_v_primitives); /*proto*/
static PyObject *__pyx_pw_7raysect_4core_12acceleration_11accelerator_11Accelerator_1build(PyObject *__pyx_v_self, PyObject *__pyx_v_primitives) {
  CYTHON_UNUSED int __pyx_lineno = 0;
  CYTHON_UNUSED const char *__pyx_filename = NULL;
  CYTHON_UNUSED int __pyx_clineno = 0;
  PyObject *__pyx_r = 0;
  __Pyx_RefNannyDeclarations
  __Pyx_RefNannySetupContext("build (wrapper)", 0);
  if (unlikely(!__Pyx_ArgTypeTest(((PyObject *)__pyx_v_primitives), (&PyList_Type), 1, "primitives", 1))) {__pyx_filename = __pyx_f[0]; __pyx_lineno = 34; __pyx_clineno = __LINE__; goto __pyx_L1_error;}
  __pyx_r = __pyx_pf_7raysect_4core_12acceleration_11accelerator_11Accelerator_build(((struct __pyx_obj_7raysect_4core_12acceleration_11accelerator_Accelerator *)__pyx_v_self), ((PyObject*)__pyx_v_primitives));

  /* function exit code */
  goto __pyx_L0;
  __pyx_L1_error:;
  __pyx_r = NULL;
  __pyx_L0:;
  __Pyx_RefNannyFinishContext();
  return __pyx_r;
}

static PyObject *__pyx_pf_7raysect_4core_12acceleration_11accelerator_11Accelerator_build(struct __pyx_obj_7raysect_4core_12acceleration_11accelerator_Accelerator *__pyx_v_self, PyObject *__pyx_v_primitives) {
  PyObject *__pyx_r = NULL;
  __Pyx_RefNannyDeclarations
  PyObject *__pyx_t_1 = NULL;
  int __pyx_lineno = 0;
  const char *__pyx_filename = NULL;
  int __pyx_clineno = 0;
  __Pyx_RefNannySetupContext("build", 0);
  __Pyx_XDECREF(__pyx_r);
  __pyx_t_1 = __pyx_f_7raysect_4core_12acceleration_11accelerator_11Accelerator_build(__pyx_v_self, __pyx_v_primitives, 1); if (unlikely(!__pyx_t_1)) {__pyx_filename = __pyx_f[0]; __pyx_lineno = 34; __pyx_clineno = __LINE__; goto __pyx_L1_error;}
  __Pyx_GOTREF(__pyx_t_1);
  __pyx_r = __pyx_t_1;
  __pyx_t_1 = 0;
  goto __pyx_L0;

  /* function exit code */
  __pyx_L1_error:;
  __Pyx_XDECREF(__pyx_t_1);
  __Pyx_AddTraceback("raysect.core.acceleration.accelerator.Accelerator.build", __pyx_clineno, __pyx_lineno, __pyx_filename);
  __pyx_r = NULL;
  __pyx_L0:;
  __Pyx_XGIVEREF(__pyx_r);
  __Pyx_RefNannyFinishContext();
  return __pyx_r;
}

/* "raysect/core/acceleration/accelerator.pyx":38
 *         pass
 * 
 *     cpdef Intersection hit(self, Ray ray):             # <<<<<<<<<<<<<<
 * 
 *         raise NotImplementedError("Accelerator virtual method hit() has not been implemented.")
 */

static PyObject *__pyx_pw_7raysect_4core_12acceleration_11accelerator_11Accelerator_3hit(PyObject *__pyx_v_self, PyObject *__pyx_v_ray); /*proto*/
static struct __pyx_obj_7raysect_4core_7classes_Intersection *__pyx_f_7raysect_4core_12acceleration_11accelerator_11Accelerator_hit(CYTHON_UNUSED struct __pyx_obj_7raysect_4core_12acceleration_11accelerator_Accelerator *__pyx_v_self, CYTHON_UNUSED struct __pyx_obj_7raysect_4core_7classes_Ray *__pyx_v_ray, int __pyx_skip_dispatch) {
  struct __pyx_obj_7raysect_4core_7classes_Intersection *__pyx_r = NULL;
  __Pyx_RefNannyDeclarations
  PyObject *__pyx_t_1 = NULL;
  PyObject *__pyx_t_2 = NULL;
  PyObject *__pyx_t_3 = NULL;
  PyObject *__pyx_t_4 = NULL;
  PyObject *__pyx_t_5 = NULL;
  int __pyx_lineno = 0;
  const char *__pyx_filename = NULL;
  int __pyx_clineno = 0;
  __Pyx_RefNannySetupContext("hit", 0);
  /* Check if called by wrapper */
  if (unlikely(__pyx_skip_dispatch)) ;
  /* Check if overridden in Python */
  else if (unlikely(Py_TYPE(((PyObject *)__pyx_v_self))->tp_dictoffset != 0)) {
    __pyx_t_1 = __Pyx_PyObject_GetAttrStr(((PyObject *)__pyx_v_self), __pyx_n_s_hit); if (unlikely(!__pyx_t_1)) {__pyx_filename = __pyx_f[0]; __pyx_lineno = 38; __pyx_clineno = __LINE__; goto __pyx_L1_error;}
    __Pyx_GOTREF(__pyx_t_1);
    if (!PyCFunction_Check(__pyx_t_1) || (PyCFunction_GET_FUNCTION(__pyx_t_1) != (PyCFunction)__pyx_pw_7raysect_4core_12acceleration_11accelerator_11Accelerator_3hit)) {
      __Pyx_XDECREF(((PyObject *)__pyx_r));
      __Pyx_INCREF(__pyx_t_1);
      __pyx_t_3 = __pyx_t_1; __pyx_t_4 = NULL;
      if (CYTHON_COMPILING_IN_CPYTHON && unlikely(PyMethod_Check(__pyx_t_3))) {
        __pyx_t_4 = PyMethod_GET_SELF(__pyx_t_3);
        if (likely(__pyx_t_4)) {
          PyObject* function = PyMethod_GET_FUNCTION(__pyx_t_3);
          __Pyx_INCREF(__pyx_t_4);
          __Pyx_INCREF(function);
          __Pyx_DECREF_SET(__pyx_t_3, function);
        }
      }
      if (!__pyx_t_4) {
        __pyx_t_2 = __Pyx_PyObject_CallOneArg(__pyx_t_3, ((PyObject *)__pyx_v_ray)); if (unlikely(!__pyx_t_2)) {__pyx_filename = __pyx_f[0]; __pyx_lineno = 38; __pyx_clineno = __LINE__; goto __pyx_L1_error;}
        __Pyx_GOTREF(__pyx_t_2);
      } else {
        __pyx_t_5 = PyTuple_New(1+1); if (unlikely(!__pyx_t_5)) {__pyx_filename = __pyx_f[0]; __pyx_lineno = 38; __pyx_clineno = __LINE__; goto __pyx_L1_error;}
        __Pyx_GOTREF(__pyx_t_5);
        __Pyx_GIVEREF(__pyx_t_4); PyTuple_SET_ITEM(__pyx_t_5, 0, __pyx_t_4); __pyx_t_4 = NULL;
        __Pyx_INCREF(((PyObject *)__pyx_v_ray));
        __Pyx_GIVEREF(((PyObject *)__pyx_v_ray));
        PyTuple_SET_ITEM(__pyx_t_5, 0+1, ((PyObject *)__pyx_v_ray));
        __pyx_t_2 = __Pyx_PyObject_Call(__pyx_t_3, __pyx_t_5, NULL); if (unlikely(!__pyx_t_2)) {__pyx_filename = __pyx_f[0]; __pyx_lineno = 38; __pyx_clineno = __LINE__; goto __pyx_L1_error;}
        __Pyx_GOTREF(__pyx_t_2);
        __Pyx_DECREF(__pyx_t_5); __pyx_t_5 = 0;
      }
      __Pyx_DECREF(__pyx_t_3); __pyx_t_3 = 0;
      if (!(likely(((__pyx_t_2) == Py_None) || likely(__Pyx_TypeTest(__pyx_t_2, __pyx_ptype_7raysect_4core_7classes_Intersection))))) {__pyx_filename = __pyx_f[0]; __pyx_lineno = 38; __pyx_clineno = __LINE__; goto __pyx_L1_error;}
      __pyx_r = ((struct __pyx_obj_7raysect_4core_7classes_Intersection *)__pyx_t_2);
      __pyx_t_2 = 0;
      __Pyx_DECREF(__pyx_t_1); __pyx_t_1 = 0;
      goto __pyx_L0;
    }
    __Pyx_DECREF(__pyx_t_1); __pyx_t_1 = 0;
  }

  /* "raysect/core/acceleration/accelerator.pyx":40
 *     cpdef Intersection hit(self, Ray ray):
 * 
 *         raise NotImplementedError("Accelerator virtual method hit() has not been implemented.")             # <<<<<<<<<<<<<<
 * 
 *     cpdef list contains(self, Point3D point):
 */
  __pyx_t_1 = __Pyx_PyObject_Call(__pyx_builtin_NotImplementedError, __pyx_tuple_, NULL); if (unlikely(!__pyx_t_1)) {__pyx_filename = __pyx_f[0]; __pyx_lineno = 40; __pyx_clineno = __LINE__; goto __pyx_L1_error;}
  __Pyx_GOTREF(__pyx_t_1);
  __Pyx_Raise(__pyx_t_1, 0, 0, 0);
  __Pyx_DECREF(__pyx_t_1); __pyx_t_1 = 0;
  {__pyx_filename = __pyx_f[0]; __pyx_lineno = 40; __pyx_clineno = __LINE__; goto __pyx_L1_error;}

  /* "raysect/core/acceleration/accelerator.pyx":38
 *         pass
 * 
 *     cpdef Intersection hit(self, Ray ray):             # <<<<<<<<<<<<<<
 * 
 *         raise NotImplementedError("Accelerator virtual method hit() has not been implemented.")
 */

  /* function exit code */
  __pyx_L1_error:;
  __Pyx_XDECREF(__pyx_t_1);
  __Pyx_XDECREF(__pyx_t_2);
  __Pyx_XDECREF(__pyx_t_3);
  __Pyx_XDECREF(__pyx_t_4);
  __Pyx_XDECREF(__pyx_t_5);
  __Pyx_AddTraceback("raysect.core.acceleration.accelerator.Accelerator.hit", __pyx_clineno, __pyx_lineno, __pyx_filename);
  __pyx_r = 0;
  __pyx_L0:;
  __Pyx_XGIVEREF((PyObject *)__pyx_r);
  __Pyx_RefNannyFinishContext();
  return __pyx_r;
}

/* Python wrapper */
static PyObject *__pyx_pw_7raysect_4core_12acceleration_11accelerator_11Accelerator_3hit(PyObject *__pyx_v_self, PyObject *__pyx_v_ray); /*proto*/
static PyObject *__pyx_pw_7raysect_4core_12acceleration_11accelerator_11Accelerator_3hit(PyObject *__pyx_v_self, PyObject *__pyx_v_ray) {
  CYTHON_UNUSED int __pyx_lineno = 0;
  CYTHON_UNUSED const char *__pyx_filename = NULL;
  CYTHON_UNUSED int __pyx_clineno = 0;
  PyObject *__pyx_r = 0;
  __Pyx_RefNannyDeclarations
  __Pyx_RefNannySetupContext("hit (wrapper)", 0);
  if (unlikely(!__Pyx_ArgTypeTest(((PyObject *)__pyx_v_ray), __pyx_ptype_7raysect_4core_7classes_Ray, 1, "ray", 0))) {__pyx_filename = __pyx_f[0]; __pyx_lineno = 38; __pyx_clineno = __LINE__; goto __pyx_L1_error;}
  __pyx_r = __pyx_pf_7raysect_4core_12acceleration_11accelerator_11Accelerator_2hit(((struct __pyx_obj_7raysect_4core_12acceleration_11accelerator_Accelerator *)__pyx_v_self), ((struct __pyx_obj_7raysect_4core_7classes_Ray *)__pyx_v_ray));

  /* function exit code */
  goto __pyx_L0;
  __pyx_L1_error:;
  __pyx_r = NULL;
  __pyx_L0:;
  __Pyx_RefNannyFinishContext();
  return __pyx_r;
}

static PyObject *__pyx_pf_7raysect_4core_12acceleration_11accelerator_11Accelerator_2hit(struct __pyx_obj_7raysect_4core_12acceleration_11accelerator_Accelerator *__pyx_v_self, struct __pyx_obj_7raysect_4core_7classes_Ray *__pyx_v_ray) {
  PyObject *__pyx_r = NULL;
  __Pyx_RefNannyDeclarations
  PyObject *__pyx_t_1 = NULL;
  int __pyx_lineno = 0;
  const char *__pyx_filename = NULL;
  int __pyx_clineno = 0;
  __Pyx_RefNannySetupContext("hit", 0);
  __Pyx_XDECREF(__pyx_r);
  __pyx_t_1 = ((PyObject *)__pyx_f_7raysect_4core_12acceleration_11accelerator_11Accelerator_hit(__pyx_v_self, __pyx_v_ray, 1)); if (unlikely(!__pyx_t_1)) {__pyx_filename = __pyx_f[0]; __pyx_lineno = 38; __pyx_clineno = __LINE__; goto __pyx_L1_error;}
  __Pyx_GOTREF(__pyx_t_1);
  __pyx_r = __pyx_t_1;
  __pyx_t_1 = 0;
  goto __pyx_L0;

  /* function exit code */
  __pyx_L1_error:;
  __Pyx_XDECREF(__pyx_t_1);
  __Pyx_AddTraceback("raysect.core.acceleration.accelerator.Accelerator.hit", __pyx_clineno, __pyx_lineno, __pyx_filename);
  __pyx_r = NULL;
  __pyx_L0:;
  __Pyx_XGIVEREF(__pyx_r);
  __Pyx_RefNannyFinishContext();
  return __pyx_r;
}

/* "raysect/core/acceleration/accelerator.pyx":42
 *         raise NotImplementedError("Accelerator virtual method hit() has not been implemented.")
 * 
 *     cpdef list contains(self, Point3D point):             # <<<<<<<<<<<<<<
 * 
 *         raise NotImplementedError("Accelerator virtual method contains() has not been implemented.")
 */

static PyObject *__pyx_pw_7raysect_4core_12acceleration_11accelerator_11Accelerator_5contains(PyObject *__pyx_v_self, PyObject *__pyx_v_point); /*proto*/
static PyObject *__pyx_f_7raysect_4core_12acceleration_11accelerator_11Accelerator_contains(CYTHON_UNUSED struct __pyx_obj_7raysect_4core_12acceleration_11accelerator_Accelerator *__pyx_v_self, CYTHON_UNUSED struct __pyx_obj_7raysect_4core_4math_5point_Point3D *__pyx_v_point, int __pyx_skip_dispatch) {
  PyObject *__pyx_r = NULL;
  __Pyx_RefNannyDeclarations
  PyObject *__pyx_t_1 = NULL;
  PyObject *__pyx_t_2 = NULL;
  PyObject *__pyx_t_3 = NULL;
  PyObject *__pyx_t_4 = NULL;
  PyObject *__pyx_t_5 = NULL;
  int __pyx_lineno = 0;
  const char *__pyx_filename = NULL;
  int __pyx_clineno = 0;
  __Pyx_RefNannySetupContext("contains", 0);
  /* Check if called by wrapper */
  if (unlikely(__pyx_skip_dispatch)) ;
  /* Check if overridden in Python */
  else if (unlikely(Py_TYPE(((PyObject *)__pyx_v_self))->tp_dictoffset != 0)) {
    __pyx_t_1 = __Pyx_PyObject_GetAttrStr(((PyObject *)__pyx_v_self), __pyx_n_s_contains); if (unlikely(!__pyx_t_1)) {__pyx_filename = __pyx_f[0]; __pyx_lineno = 42; __pyx_clineno = __LINE__; goto __pyx_L1_error;}
    __Pyx_GOTREF(__pyx_t_1);
    if (!PyCFunction_Check(__pyx_t_1) || (PyCFunction_GET_FUNCTION(__pyx_t_1) != (PyCFunction)__pyx_pw_7raysect_4core_12acceleration_11accelerator_11Accelerator_5contains)) {
      __Pyx_XDECREF(__pyx_r);
      __Pyx_INCREF(__pyx_t_1);
      __pyx_t_3 = __pyx_t_1; __pyx_t_4 = NULL;
      if (CYTHON_COMPILING_IN_CPYTHON && unlikely(PyMethod_Check(__pyx_t_3))) {
        __pyx_t_4 = PyMethod_GET_SELF(__pyx_t_3);
        if (likely(__pyx_t_4)) {
          PyObject* function = PyMethod_GET_FUNCTION(__pyx_t_3);
          __Pyx_INCREF(__pyx_t_4);
          __Pyx_INCREF(function);
          __Pyx_DECREF_SET(__pyx_t_3, function);
        }
      }
      if (!__pyx_t_4) {
        __pyx_t_2 = __Pyx_PyObject_CallOneArg(__pyx_t_3, ((PyObject *)__pyx_v_point)); if (unlikely(!__pyx_t_2)) {__pyx_filename = __pyx_f[0]; __pyx_lineno = 42; __pyx_clineno = __LINE__; goto __pyx_L1_error;}
        __Pyx_GOTREF(__pyx_t_2);
      } else {
        __pyx_t_5 = PyTuple_New(1+1); if (unlikely(!__pyx_t_5)) {__pyx_filename = __pyx_f[0]; __pyx_lineno = 42; __pyx_clineno = __LINE__; goto __pyx_L1_error;}
        __Pyx_GOTREF(__pyx_t_5);
        __Pyx_GIVEREF(__pyx_t_4); PyTuple_SET_ITEM(__pyx_t_5, 0, __pyx_t_4); __pyx_t_4 = NULL;
        __Pyx_INCREF(((PyObject *)__pyx_v_point));
        __Pyx_GIVEREF(((PyObject *)__pyx_v_point));
        PyTuple_SET_ITEM(__pyx_t_5, 0+1, ((PyObject *)__pyx_v_point));
        __pyx_t_2 = __Pyx_PyObject_Call(__pyx_t_3, __pyx_t_5, NULL); if (unlikely(!__pyx_t_2)) {__pyx_filename = __pyx_f[0]; __pyx_lineno = 42; __pyx_clineno = __LINE__; goto __pyx_L1_error;}
        __Pyx_GOTREF(__pyx_t_2);
        __Pyx_DECREF(__pyx_t_5); __pyx_t_5 = 0;
      }
      __Pyx_DECREF(__pyx_t_3); __pyx_t_3 = 0;
      if (!(likely(PyList_CheckExact(__pyx_t_2))||((__pyx_t_2) == Py_None)||(PyErr_Format(PyExc_TypeError, "Expected %.16s, got %.200s", "list", Py_TYPE(__pyx_t_2)->tp_name), 0))) {__pyx_filename = __pyx_f[0]; __pyx_lineno = 42; __pyx_clineno = __LINE__; goto __pyx_L1_error;}
      __pyx_r = ((PyObject*)__pyx_t_2);
      __pyx_t_2 = 0;
      __Pyx_DECREF(__pyx_t_1); __pyx_t_1 = 0;
      goto __pyx_L0;
    }
    __Pyx_DECREF(__pyx_t_1); __pyx_t_1 = 0;
  }

  /* "raysect/core/acceleration/accelerator.pyx":44
 *     cpdef list contains(self, Point3D point):
 * 
 *         raise NotImplementedError("Accelerator virtual method contains() has not been implemented.")             # <<<<<<<<<<<<<<
 */
  __pyx_t_1 = __Pyx_PyObject_Call(__pyx_builtin_NotImplementedError, __pyx_tuple__2, NULL); if (unlikely(!__pyx_t_1)) {__pyx_filename = __pyx_f[0]; __pyx_lineno = 44; __pyx_clineno = __LINE__; goto __pyx_L1_error;}
  __Pyx_GOTREF(__pyx_t_1);
  __Pyx_Raise(__pyx_t_1, 0, 0, 0);
  __Pyx_DECREF(__pyx_t_1); __pyx_t_1 = 0;
  {__pyx_filename = __pyx_f[0]; __pyx_lineno = 44; __pyx_clineno = __LINE__; goto __pyx_L1_error;}

  /* "raysect/core/acceleration/accelerator.pyx":42
 *         raise NotImplementedError("Accelerator virtual method hit() has not been implemented.")
 * 
 *     cpdef list contains(self, Point3D point):             # <<<<<<<<<<<<<<
 * 
 *         raise NotImplementedError("Accelerator virtual method contains() has not been implemented.")
 */

  /* function exit code */
  __pyx_L1_error:;
  __Pyx_XDECREF(__pyx_t_1);
  __Pyx_XDECREF(__pyx_t_2);
  __Pyx_XDECREF(__pyx_t_3);
  __Pyx_XDECREF(__pyx_t_4);
  __Pyx_XDECREF(__pyx_t_5);
  __Pyx_AddTraceback("raysect.core.acceleration.accelerator.Accelerator.contains", __pyx_clineno, __pyx_lineno, __pyx_filename);
  __pyx_r = 0;
  __pyx_L0:;
  __Pyx_XGIVEREF(__pyx_r);
  __Pyx_RefNannyFinishContext();
  return __pyx_r;
}

/* Python wrapper */
static PyObject *__pyx_pw_7raysect_4core_12acceleration_11accelerator_11Accelerator_5contains(PyObject *__pyx_v_self, PyObject *__pyx_v_point); /*proto*/
static PyObject *__pyx_pw_7raysect_4core_12acceleration_11accelerator_11Accelerator_5contains(PyObject *__pyx_v_self, PyObject *__pyx_v_point) {
  CYTHON_UNUSED int __pyx_lineno = 0;
  CYTHON_UNUSED const char *__pyx_filename = NULL;
  CYTHON_UNUSED int __pyx_clineno = 0;
  PyObject *__pyx_r = 0;
  __Pyx_RefNannyDeclarations
  __Pyx_RefNannySetupContext("contains (wrapper)", 0);
  if (unlikely(!__Pyx_ArgTypeTest(((PyObject *)__pyx_v_point), __pyx_ptype_7raysect_4core_4math_5point_Point3D, 1, "point", 0))) {__pyx_filename = __pyx_f[0]; __pyx_lineno = 42; __pyx_clineno = __LINE__; goto __pyx_L1_error;}
  __pyx_r = __pyx_pf_7raysect_4core_12acceleration_11accelerator_11Accelerator_4contains(((struct __pyx_obj_7raysect_4core_12acceleration_11accelerator_Accelerator *)__pyx_v_self), ((struct __pyx_obj_7raysect_4core_4math_5point_Point3D *)__pyx_v_point));

  /* function exit code */
  goto __pyx_L0;
  __pyx_L1_error:;
  __pyx_r = NULL;
  __pyx_L0:;
  __Pyx_RefNannyFinishContext();
  return __pyx_r;
}

static PyObject *__pyx_pf_7raysect_4core_12acceleration_11accelerator_11Accelerator_4contains(struct __pyx_obj_7raysect_4core_12acceleration_11accelerator_Accelerator *__pyx_v_self, struct __pyx_obj_7raysect_4core_4math_5point_Point3D *__pyx_v_point) {
  PyObject *__pyx_r = NULL;
  __Pyx_RefNannyDeclarations
  PyObject *__pyx_t_1 = NULL;
  int __pyx_lineno = 0;
  const char *__pyx_filename = NULL;
  int __pyx_clineno = 0;
  __Pyx_RefNannySetupContext("contains", 0);
  __Pyx_XDECREF(__pyx_r);
  __pyx_t_1 = __pyx_f_7raysect_4core_12acceleration_11accelerator_11Accelerator_contains(__pyx_v_self, __pyx_v_point, 1); if (unlikely(!__pyx_t_1)) {__pyx_filename = __pyx_f[0]; __pyx_lineno = 42; __pyx_clineno = __LINE__; goto __pyx_L1_error;}
  __Pyx_GOTREF(__pyx_t_1);
  __pyx_r = __pyx_t_1;
  __pyx_t_1 = 0;
  goto __pyx_L0;

  /* function exit code */
  __pyx_L1_error:;
  __Pyx_XDECREF(__pyx_t_1);
  __Pyx_AddTraceback("raysect.core.acceleration.accelerator.Accelerator.contains", __pyx_clineno, __pyx_lineno, __pyx_filename);
  __pyx_r = NULL;
  __pyx_L0:;
  __Pyx_XGIVEREF(__pyx_r);
  __Pyx_RefNannyFinishContext();
  return __pyx_r;
}

/* "raysect/core/math/affinematrix.pxd":56
 * cpdef AffineMatrix3D rotate_basis(Vector3D forward, Vector3D up)
 * 
 * cdef inline AffineMatrix3D new_affinematrix3d(double m00, double m01, double m02, double m03,             # <<<<<<<<<<<<<<
 *                                               double m10, double m11, double m12, double m13,
 *                                               double m20, double m21, double m22, double m23,
 */

static CYTHON_INLINE struct __pyx_obj_7raysect_4core_4math_12affinematrix_AffineMatrix3D *__pyx_f_7raysect_4core_4math_12affinematrix_new_affinematrix3d(double __pyx_v_m00, double __pyx_v_m01, double __pyx_v_m02, double __pyx_v_m03, double __pyx_v_m10, double __pyx_v_m11, double __pyx_v_m12, double __pyx_v_m13, double __pyx_v_m20, double __pyx_v_m21, double __pyx_v_m22, double __pyx_v_m23, double __pyx_v_m30, double __pyx_v_m31, double __pyx_v_m32, double __pyx_v_m33) {
  struct __pyx_obj_7raysect_4core_4math_12affinematrix_AffineMatrix3D *__pyx_v_v = 0;
  struct __pyx_obj_7raysect_4core_4math_12affinematrix_AffineMatrix3D *__pyx_r = NULL;
  __Pyx_RefNannyDeclarations
  PyObject *__pyx_t_1 = NULL;
  int __pyx_lineno = 0;
  const char *__pyx_filename = NULL;
  int __pyx_clineno = 0;
  __Pyx_RefNannySetupContext("new_affinematrix3d", 0);

  /* "raysect/core/math/affinematrix.pxd":68
 * 
 *     cdef AffineMatrix3D v
 *     v = AffineMatrix3D.__new__(AffineMatrix3D)             # <<<<<<<<<<<<<<
 *     v.m[0][0] = m00
 *     v.m[0][1] = m01
 */
  __pyx_t_1 = __Pyx_tp_new(((PyObject *)__pyx_ptype_7raysect_4core_4math_12affinematrix_AffineMatrix3D), __pyx_empty_tuple); if (unlikely(!__pyx_t_1)) {__pyx_filename = __pyx_f[1]; __pyx_lineno = 68; __pyx_clineno = __LINE__; goto __pyx_L1_error;}
  __Pyx_GOTREF(__pyx_t_1);
  if (!(likely(__Pyx_TypeTest(__pyx_t_1, __pyx_ptype_7raysect_4core_4math_12affinematrix_AffineMatrix3D)))) {__pyx_filename = __pyx_f[1]; __pyx_lineno = 68; __pyx_clineno = __LINE__; goto __pyx_L1_error;}
  __pyx_v_v = ((struct __pyx_obj_7raysect_4core_4math_12affinematrix_AffineMatrix3D *)__pyx_t_1);
  __pyx_t_1 = 0;

  /* "raysect/core/math/affinematrix.pxd":69
 *     cdef AffineMatrix3D v
 *     v = AffineMatrix3D.__new__(AffineMatrix3D)
 *     v.m[0][0] = m00             # <<<<<<<<<<<<<<
 *     v.m[0][1] = m01
 *     v.m[0][2] = m02
 */
  ((__pyx_v_v->__pyx_base.m[0])[0]) = __pyx_v_m00;

  /* "raysect/core/math/affinematrix.pxd":70
 *     v = AffineMatrix3D.__new__(AffineMatrix3D)
 *     v.m[0][0] = m00
 *     v.m[0][1] = m01             # <<<<<<<<<<<<<<
 *     v.m[0][2] = m02
 *     v.m[0][3] = m03
 */
  ((__pyx_v_v->__pyx_base.m[0])[1]) = __pyx_v_m01;

  /* "raysect/core/math/affinematrix.pxd":71
 *     v.m[0][0] = m00
 *     v.m[0][1] = m01
 *     v.m[0][2] = m02             # <<<<<<<<<<<<<<
 *     v.m[0][3] = m03
 *     v.m[1][0] = m10
 */
  ((__pyx_v_v->__pyx_base.m[0])[2]) = __pyx_v_m02;

  /* "raysect/core/math/affinematrix.pxd":72
 *     v.m[0][1] = m01
 *     v.m[0][2] = m02
 *     v.m[0][3] = m03             # <<<<<<<<<<<<<<
 *     v.m[1][0] = m10
 *     v.m[1][1] = m11
 */
  ((__pyx_v_v->__pyx_base.m[0])[3]) = __pyx_v_m03;

  /* "raysect/core/math/affinematrix.pxd":73
 *     v.m[0][2] = m02
 *     v.m[0][3] = m03
 *     v.m[1][0] = m10             # <<<<<<<<<<<<<<
 *     v.m[1][1] = m11
 *     v.m[1][2] = m12
 */
  ((__pyx_v_v->__pyx_base.m[1])[0]) = __pyx_v_m10;

  /* "raysect/core/math/affinematrix.pxd":74
 *     v.m[0][3] = m03
 *     v.m[1][0] = m10
 *     v.m[1][1] = m11             # <<<<<<<<<<<<<<
 *     v.m[1][2] = m12
 *     v.m[1][3] = m13
 */
  ((__pyx_v_v->__pyx_base.m[1])[1]) = __pyx_v_m11;

  /* "raysect/core/math/affinematrix.pxd":75
 *     v.m[1][0] = m10
 *     v.m[1][1] = m11
 *     v.m[1][2] = m12             # <<<<<<<<<<<<<<
 *     v.m[1][3] = m13
 *     v.m[2][0] = m20
 */
  ((__pyx_v_v->__pyx_base.m[1])[2]) = __pyx_v_m12;

  /* "raysect/core/math/affinematrix.pxd":76
 *     v.m[1][1] = m11
 *     v.m[1][2] = m12
 *     v.m[1][3] = m13             # <<<<<<<<<<<<<<
 *     v.m[2][0] = m20
 *     v.m[2][1] = m21
 */
  ((__pyx_v_v->__pyx_base.m[1])[3]) = __pyx_v_m13;

  /* "raysect/core/math/affinematrix.pxd":77
 *     v.m[1][2] = m12
 *     v.m[1][3] = m13
 *     v.m[2][0] = m20             # <<<<<<<<<<<<<<
 *     v.m[2][1] = m21
 *     v.m[2][2] = m22
 */
  ((__pyx_v_v->__pyx_base.m[2])[0]) = __pyx_v_m20;

  /* "raysect/core/math/affinematrix.pxd":78
 *     v.m[1][3] = m13
 *     v.m[2][0] = m20
 *     v.m[2][1] = m21             # <<<<<<<<<<<<<<
 *     v.m[2][2] = m22
 *     v.m[2][3] = m23
 */
  ((__pyx_v_v->__pyx_base.m[2])[1]) = __pyx_v_m21;

  /* "raysect/core/math/affinematrix.pxd":79
 *     v.m[2][0] = m20
 *     v.m[2][1] = m21
 *     v.m[2][2] = m22             # <<<<<<<<<<<<<<
 *     v.m[2][3] = m23
 *     v.m[3][0] = m30
 */
  ((__pyx_v_v->__pyx_base.m[2])[2]) = __pyx_v_m22;

  /* "raysect/core/math/affinematrix.pxd":80
 *     v.m[2][1] = m21
 *     v.m[2][2] = m22
 *     v.m[2][3] = m23             # <<<<<<<<<<<<<<
 *     v.m[3][0] = m30
 *     v.m[3][1] = m31
 */
  ((__pyx_v_v->__pyx_base.m[2])[3]) = __pyx_v_m23;

  /* "raysect/core/math/affinematrix.pxd":81
 *     v.m[2][2] = m22
 *     v.m[2][3] = m23
 *     v.m[3][0] = m30             # <<<<<<<<<<<<<<
 *     v.m[3][1] = m31
 *     v.m[3][2] = m32
 */
  ((__pyx_v_v->__pyx_base.m[3])[0]) = __pyx_v_m30;

  /* "raysect/core/math/affinematrix.pxd":82
 *     v.m[2][3] = m23
 *     v.m[3][0] = m30
 *     v.m[3][1] = m31             # <<<<<<<<<<<<<<
 *     v.m[3][2] = m32
 *     v.m[3][3] = m33
 */
  ((__pyx_v_v->__pyx_base.m[3])[1]) = __pyx_v_m31;

  /* "raysect/core/math/affinematrix.pxd":83
 *     v.m[3][0] = m30
 *     v.m[3][1] = m31
 *     v.m[3][2] = m32             # <<<<<<<<<<<<<<
 *     v.m[3][3] = m33
 *     return v
 */
  ((__pyx_v_v->__pyx_base.m[3])[2]) = __pyx_v_m32;

  /* "raysect/core/math/affinematrix.pxd":84
 *     v.m[3][1] = m31
 *     v.m[3][2] = m32
 *     v.m[3][3] = m33             # <<<<<<<<<<<<<<
 *     return v
 */
  ((__pyx_v_v->__pyx_base.m[3])[3]) = __pyx_v_m33;

  /* "raysect/core/math/affinematrix.pxd":85
 *     v.m[3][2] = m32
 *     v.m[3][3] = m33
 *     return v             # <<<<<<<<<<<<<<
 */
  __Pyx_XDECREF(((PyObject *)__pyx_r));
  __Pyx_INCREF(((PyObject *)__pyx_v_v));
  __pyx_r = __pyx_v_v;
  goto __pyx_L0;

  /* "raysect/core/math/affinematrix.pxd":56
 * cpdef AffineMatrix3D rotate_basis(Vector3D forward, Vector3D up)
 * 
 * cdef inline AffineMatrix3D new_affinematrix3d(double m00, double m01, double m02, double m03,             # <<<<<<<<<<<<<<
 *                                               double m10, double m11, double m12, double m13,
 *                                               double m20, double m21, double m22, double m23,
 */

  /* function exit code */
  __pyx_L1_error:;
  __Pyx_XDECREF(__pyx_t_1);
  __Pyx_AddTraceback("raysect.core.math.affinematrix.new_affinematrix3d", __pyx_clineno, __pyx_lineno, __pyx_filename);
  __pyx_r = 0;
  __pyx_L0:;
  __Pyx_XDECREF((PyObject *)__pyx_v_v);
  __Pyx_XGIVEREF((PyObject *)__pyx_r);
  __Pyx_RefNannyFinishContext();
  return __pyx_r;
}

/* "raysect/core/math/vector.pxd":56
 * 
 * 
 * cdef inline Vector3D new_vector3d(double x, double y, double z):             # <<<<<<<<<<<<<<
 *     """
 *     Vector3D factory function.
 */

static CYTHON_INLINE struct __pyx_obj_7raysect_4core_4math_6vector_Vector3D *__pyx_f_7raysect_4core_4math_6vector_new_vector3d(double __pyx_v_x, double __pyx_v_y, double __pyx_v_z) {
  struct __pyx_obj_7raysect_4core_4math_6vector_Vector3D *__pyx_v_v = 0;
  struct __pyx_obj_7raysect_4core_4math_6vector_Vector3D *__pyx_r = NULL;
  __Pyx_RefNannyDeclarations
  PyObject *__pyx_t_1 = NULL;
  int __pyx_lineno = 0;
  const char *__pyx_filename = NULL;
  int __pyx_clineno = 0;
  __Pyx_RefNannySetupContext("new_vector3d", 0);

  /* "raysect/core/math/vector.pxd":65
 * 
 *     cdef Vector3D v
 *     v = Vector3D.__new__(Vector3D)             # <<<<<<<<<<<<<<
 *     v.x = x
 *     v.y = y
 */
  __pyx_t_1 = __Pyx_tp_new(((PyObject *)__pyx_ptype_7raysect_4core_4math_6vector_Vector3D), __pyx_empty_tuple); if (unlikely(!__pyx_t_1)) {__pyx_filename = __pyx_f[2]; __pyx_lineno = 65; __pyx_clineno = __LINE__; goto __pyx_L1_error;}
  __Pyx_GOTREF(__pyx_t_1);
  if (!(likely(__Pyx_TypeTest(__pyx_t_1, __pyx_ptype_7raysect_4core_4math_6vector_Vector3D)))) {__pyx_filename = __pyx_f[2]; __pyx_lineno = 65; __pyx_clineno = __LINE__; goto __pyx_L1_error;}
  __pyx_v_v = ((struct __pyx_obj_7raysect_4core_4math_6vector_Vector3D *)__pyx_t_1);
  __pyx_t_1 = 0;

  /* "raysect/core/math/vector.pxd":66
 *     cdef Vector3D v
 *     v = Vector3D.__new__(Vector3D)
 *     v.x = x             # <<<<<<<<<<<<<<
 *     v.y = y
 *     v.z = z
 */
  __pyx_v_v->__pyx_base.x = __pyx_v_x;

  /* "raysect/core/math/vector.pxd":67
 *     v = Vector3D.__new__(Vector3D)
 *     v.x = x
 *     v.y = y             # <<<<<<<<<<<<<<
 *     v.z = z
 *     return v
 */
  __pyx_v_v->__pyx_base.y = __pyx_v_y;

  /* "raysect/core/math/vector.pxd":68
 *     v.x = x
 *     v.y = y
 *     v.z = z             # <<<<<<<<<<<<<<
 *     return v
 * 
 */
  __pyx_v_v->__pyx_base.z = __pyx_v_z;

  /* "raysect/core/math/vector.pxd":69
 *     v.y = y
 *     v.z = z
 *     return v             # <<<<<<<<<<<<<<
 * 
 */
  __Pyx_XDECREF(((PyObject *)__pyx_r));
  __Pyx_INCREF(((PyObject *)__pyx_v_v));
  __pyx_r = __pyx_v_v;
  goto __pyx_L0;

  /* "raysect/core/math/vector.pxd":56
 * 
 * 
 * cdef inline Vector3D new_vector3d(double x, double y, double z):             # <<<<<<<<<<<<<<
 *     """
 *     Vector3D factory function.
 */

  /* function exit code */
  __pyx_L1_error:;
  __Pyx_XDECREF(__pyx_t_1);
  __Pyx_AddTraceback("raysect.core.math.vector.new_vector3d", __pyx_clineno, __pyx_lineno, __pyx_filename);
  __pyx_r = 0;
  __pyx_L0:;
  __Pyx_XDECREF((PyObject *)__pyx_v_v);
  __Pyx_XGIVEREF((PyObject *)__pyx_r);
  __Pyx_RefNannyFinishContext();
  return __pyx_r;
}

/* "raysect/core/math/point.pxd":57
 * 
 * 
 * cdef inline Point3D new_point3d(double x, double y, double z):             # <<<<<<<<<<<<<<
 *     """
 *     Point3D factory function.
 */

static CYTHON_INLINE struct __pyx_obj_7raysect_4core_4math_5point_Point3D *__pyx_f_7raysect_4core_4math_5point_new_point3d(double __pyx_v_x, double __pyx_v_y, double __pyx_v_z) {
  struct __pyx_obj_7raysect_4core_4math_5point_Point3D *__pyx_v_v = 0;
  struct __pyx_obj_7raysect_4core_4math_5point_Point3D *__pyx_r = NULL;
  __Pyx_RefNannyDeclarations
  PyObject *__pyx_t_1 = NULL;
  int __pyx_lineno = 0;
  const char *__pyx_filename = NULL;
  int __pyx_clineno = 0;
  __Pyx_RefNannySetupContext("new_point3d", 0);

  /* "raysect/core/math/point.pxd":66
 * 
 *     cdef Point3D v
 *     v = Point3D.__new__(Point3D)             # <<<<<<<<<<<<<<
 *     v.x = x
 *     v.y = y
 */
  __pyx_t_1 = __Pyx_tp_new(((PyObject *)__pyx_ptype_7raysect_4core_4math_5point_Point3D), __pyx_empty_tuple); if (unlikely(!__pyx_t_1)) {__pyx_filename = __pyx_f[3]; __pyx_lineno = 66; __pyx_clineno = __LINE__; goto __pyx_L1_error;}
  __Pyx_GOTREF(__pyx_t_1);
  if (!(likely(__Pyx_TypeTest(__pyx_t_1, __pyx_ptype_7raysect_4core_4math_5point_Point3D)))) {__pyx_filename = __pyx_f[3]; __pyx_lineno = 66; __pyx_clineno = __LINE__; goto __pyx_L1_error;}
  __pyx_v_v = ((struct __pyx_obj_7raysect_4core_4math_5point_Point3D *)__pyx_t_1);
  __pyx_t_1 = 0;

  /* "raysect/core/math/point.pxd":67
 *     cdef Point3D v
 *     v = Point3D.__new__(Point3D)
 *     v.x = x             # <<<<<<<<<<<<<<
 *     v.y = y
 *     v.z = z
 */
  __pyx_v_v->x = __pyx_v_x;

  /* "raysect/core/math/point.pxd":68
 *     v = Point3D.__new__(Point3D)
 *     v.x = x
 *     v.y = y             # <<<<<<<<<<<<<<
 *     v.z = z
 *     return v
 */
  __pyx_v_v->y = __pyx_v_y;

  /* "raysect/core/math/point.pxd":69
 *     v.x = x
 *     v.y = y
 *     v.z = z             # <<<<<<<<<<<<<<
 *     return v
 * 
 */
  __pyx_v_v->z = __pyx_v_z;

  /* "raysect/core/math/point.pxd":70
 *     v.y = y
 *     v.z = z
 *     return v             # <<<<<<<<<<<<<<
 * 
 * 
 */
  __Pyx_XDECREF(((PyObject *)__pyx_r));
  __Pyx_INCREF(((PyObject *)__pyx_v_v));
  __pyx_r = __pyx_v_v;
  goto __pyx_L0;

  /* "raysect/core/math/point.pxd":57
 * 
 * 
 * cdef inline Point3D new_point3d(double x, double y, double z):             # <<<<<<<<<<<<<<
 *     """
 *     Point3D factory function.
 */

  /* function exit code */
  __pyx_L1_error:;
  __Pyx_XDECREF(__pyx_t_1);
  __Pyx_AddTraceback("raysect.core.math.point.new_point3d", __pyx_clineno, __pyx_lineno, __pyx_filename);
  __pyx_r = 0;
  __pyx_L0:;
  __Pyx_XDECREF((PyObject *)__pyx_v_v);
  __Pyx_XGIVEREF((PyObject *)__pyx_r);
  __Pyx_RefNannyFinishContext();
  return __pyx_r;
}

/* "raysect/core/math/point.pxd":94
 * 
 * 
 * cdef inline Point2D new_point2d(double x, double y):             # <<<<<<<<<<<<<<
 *     """
 *     Point2D factory function.
 */

static CYTHON_INLINE struct __pyx_obj_7raysect_4core_4math_5point_Point2D *__pyx_f_7raysect_4core_4math_5point_new_point2d(double __pyx_v_x, double __pyx_v_y) {
  struct __pyx_obj_7raysect_4core_4math_5point_Point2D *__pyx_v_a = 0;
  struct __pyx_obj_7raysect_4core_4math_5point_Point2D *__pyx_r = NULL;
  __Pyx_RefNannyDeclarations
  PyObject *__pyx_t_1 = NULL;
  int __pyx_lineno = 0;
  const char *__pyx_filename = NULL;
  int __pyx_clineno = 0;
  __Pyx_RefNannySetupContext("new_point2d", 0);

  /* "raysect/core/math/point.pxd":103
 * 
 *     cdef Point2D a
 *     a = Point2D.__new__(Point2D)             # <<<<<<<<<<<<<<
 *     a.x = x
 *     a.y = y
 */
  __pyx_t_1 = __Pyx_tp_new(((PyObject *)__pyx_ptype_7raysect_4core_4math_5point_Point2D), __pyx_empty_tuple); if (unlikely(!__pyx_t_1)) {__pyx_filename = __pyx_f[3]; __pyx_lineno = 103; __pyx_clineno = __LINE__; goto __pyx_L1_error;}
  __Pyx_GOTREF(__pyx_t_1);
  if (!(likely(__Pyx_TypeTest(__pyx_t_1, __pyx_ptype_7raysect_4core_4math_5point_Point2D)))) {__pyx_filename = __pyx_f[3]; __pyx_lineno = 103; __pyx_clineno = __LINE__; goto __pyx_L1_error;}
  __pyx_v_a = ((struct __pyx_obj_7raysect_4core_4math_5point_Point2D *)__pyx_t_1);
  __pyx_t_1 = 0;

  /* "raysect/core/math/point.pxd":104
 *     cdef Point2D a
 *     a = Point2D.__new__(Point2D)
 *     a.x = x             # <<<<<<<<<<<<<<
 *     a.y = y
 *     return a
 */
  __pyx_v_a->x = __pyx_v_x;

  /* "raysect/core/math/point.pxd":105
 *     a = Point2D.__new__(Point2D)
 *     a.x = x
 *     a.y = y             # <<<<<<<<<<<<<<
 *     return a
 */
  __pyx_v_a->y = __pyx_v_y;

  /* "raysect/core/math/point.pxd":106
 *     a.x = x
 *     a.y = y
 *     return a             # <<<<<<<<<<<<<<
 */
  __Pyx_XDECREF(((PyObject *)__pyx_r));
  __Pyx_INCREF(((PyObject *)__pyx_v_a));
  __pyx_r = __pyx_v_a;
  goto __pyx_L0;

  /* "raysect/core/math/point.pxd":94
 * 
 * 
 * cdef inline Point2D new_point2d(double x, double y):             # <<<<<<<<<<<<<<
 *     """
 *     Point2D factory function.
 */

  /* function exit code */
  __pyx_L1_error:;
  __Pyx_XDECREF(__pyx_t_1);
  __Pyx_AddTraceback("raysect.core.math.point.new_point2d", __pyx_clineno, __pyx_lineno, __pyx_filename);
  __pyx_r = 0;
  __pyx_L0:;
  __Pyx_XDECREF((PyObject *)__pyx_v_a);
  __Pyx_XGIVEREF((PyObject *)__pyx_r);
  __Pyx_RefNannyFinishContext();
  return __pyx_r;
}

/* "raysect/core/math/normal.pxd":63
 * 
 * 
 * cdef inline Normal3D new_normal3d(double x, double y, double z):             # <<<<<<<<<<<<<<
 *     """
 *     Normal3D factory function.
 */

static CYTHON_INLINE struct __pyx_obj_7raysect_4core_4math_6normal_Normal3D *__pyx_f_7raysect_4core_4math_6normal_new_normal3d(double __pyx_v_x, double __pyx_v_y, double __pyx_v_z) {
  struct __pyx_obj_7raysect_4core_4math_6normal_Normal3D *__pyx_v_v = 0;
  struct __pyx_obj_7raysect_4core_4math_6normal_Normal3D *__pyx_r = NULL;
  __Pyx_RefNannyDeclarations
  PyObject *__pyx_t_1 = NULL;
  int __pyx_lineno = 0;
  const char *__pyx_filename = NULL;
  int __pyx_clineno = 0;
  __Pyx_RefNannySetupContext("new_normal3d", 0);

  /* "raysect/core/math/normal.pxd":72
 * 
 *     cdef Normal3D v
 *     v = Normal3D.__new__(Normal3D)             # <<<<<<<<<<<<<<
 *     v.x = x
 *     v.y = y
 */
  __pyx_t_1 = __Pyx_tp_new(((PyObject *)__pyx_ptype_7raysect_4core_4math_6normal_Normal3D), __pyx_empty_tuple); if (unlikely(!__pyx_t_1)) {__pyx_filename = __pyx_f[4]; __pyx_lineno = 72; __pyx_clineno = __LINE__; goto __pyx_L1_error;}
  __Pyx_GOTREF(__pyx_t_1);
  if (!(likely(__Pyx_TypeTest(__pyx_t_1, __pyx_ptype_7raysect_4core_4math_6normal_Normal3D)))) {__pyx_filename = __pyx_f[4]; __pyx_lineno = 72; __pyx_clineno = __LINE__; goto __pyx_L1_error;}
  __pyx_v_v = ((struct __pyx_obj_7raysect_4core_4math_6normal_Normal3D *)__pyx_t_1);
  __pyx_t_1 = 0;

  /* "raysect/core/math/normal.pxd":73
 *     cdef Normal3D v
 *     v = Normal3D.__new__(Normal3D)
 *     v.x = x             # <<<<<<<<<<<<<<
 *     v.y = y
 *     v.z = z
 */
  __pyx_v_v->__pyx_base.x = __pyx_v_x;

  /* "raysect/core/math/normal.pxd":74
 *     v = Normal3D.__new__(Normal3D)
 *     v.x = x
 *     v.y = y             # <<<<<<<<<<<<<<
 *     v.z = z
 *     return v
 */
  __pyx_v_v->__pyx_base.y = __pyx_v_y;

  /* "raysect/core/math/normal.pxd":75
 *     v.x = x
 *     v.y = y
 *     v.z = z             # <<<<<<<<<<<<<<
 *     return v
 */
  __pyx_v_v->__pyx_base.z = __pyx_v_z;

  /* "raysect/core/math/normal.pxd":76
 *     v.y = y
 *     v.z = z
 *     return v             # <<<<<<<<<<<<<<
 */
  __Pyx_XDECREF(((PyObject *)__pyx_r));
  __Pyx_INCREF(((PyObject *)__pyx_v_v));
  __pyx_r = __pyx_v_v;
  goto __pyx_L0;

  /* "raysect/core/math/normal.pxd":63
 * 
 * 
 * cdef inline Normal3D new_normal3d(double x, double y, double z):             # <<<<<<<<<<<<<<
 *     """
 *     Normal3D factory function.
 */

  /* function exit code */
  __pyx_L1_error:;
  __Pyx_XDECREF(__pyx_t_1);
  __Pyx_AddTraceback("raysect.core.math.normal.new_normal3d", __pyx_clineno, __pyx_lineno, __pyx_filename);
  __pyx_r = 0;
  __pyx_L0:;
  __Pyx_XDECREF((PyObject *)__pyx_v_v);
  __Pyx_XGIVEREF((PyObject *)__pyx_r);
  __Pyx_RefNannyFinishContext();
  return __pyx_r;
}

/* "raysect/core/boundingbox.pxd":69
 * 
 * 
 * cdef inline BoundingBox3D new_boundingbox3d(Point3D lower, Point3D upper):             # <<<<<<<<<<<<<<
 *     """
 *     BoundingBox3D factory function.
 */

static CYTHON_INLINE struct __pyx_obj_7raysect_4core_11boundingbox_BoundingBox3D *__pyx_f_7raysect_4core_11boundingbox_new_boundingbox3d(struct __pyx_obj_7raysect_4core_4math_5point_Point3D *__pyx_v_lower, struct __pyx_obj_7raysect_4core_4math_5point_Point3D *__pyx_v_upper) {
  struct __pyx_obj_7raysect_4core_11boundingbox_BoundingBox3D *__pyx_v_v = 0;
  struct __pyx_obj_7raysect_4core_11boundingbox_BoundingBox3D *__pyx_r = NULL;
  __Pyx_RefNannyDeclarations
  PyObject *__pyx_t_1 = NULL;
  int __pyx_lineno = 0;
  const char *__pyx_filename = NULL;
  int __pyx_clineno = 0;
  __Pyx_RefNannySetupContext("new_boundingbox3d", 0);

  /* "raysect/core/boundingbox.pxd":78
 * 
 *     cdef BoundingBox3D v
 *     v = BoundingBox3D.__new__(BoundingBox3D)             # <<<<<<<<<<<<<<
 *     v.lower = lower
 *     v.upper = upper
 */
  __pyx_t_1 = __Pyx_tp_new(((PyObject *)__pyx_ptype_7raysect_4core_11boundingbox_BoundingBox3D), __pyx_empty_tuple); if (unlikely(!__pyx_t_1)) {__pyx_filename = __pyx_f[5]; __pyx_lineno = 78; __pyx_clineno = __LINE__; goto __pyx_L1_error;}
  __Pyx_GOTREF(__pyx_t_1);
  if (!(likely(__Pyx_TypeTest(__pyx_t_1, __pyx_ptype_7raysect_4core_11boundingbox_BoundingBox3D)))) {__pyx_filename = __pyx_f[5]; __pyx_lineno = 78; __pyx_clineno = __LINE__; goto __pyx_L1_error;}
  __pyx_v_v = ((struct __pyx_obj_7raysect_4core_11boundingbox_BoundingBox3D *)__pyx_t_1);
  __pyx_t_1 = 0;

  /* "raysect/core/boundingbox.pxd":79
 *     cdef BoundingBox3D v
 *     v = BoundingBox3D.__new__(BoundingBox3D)
 *     v.lower = lower             # <<<<<<<<<<<<<<
 *     v.upper = upper
 *     return v
 */
  __Pyx_INCREF(((PyObject *)__pyx_v_lower));
  __Pyx_GIVEREF(((PyObject *)__pyx_v_lower));
  __Pyx_GOTREF(__pyx_v_v->lower);
  __Pyx_DECREF(((PyObject *)__pyx_v_v->lower));
  __pyx_v_v->lower = __pyx_v_lower;

  /* "raysect/core/boundingbox.pxd":80
 *     v = BoundingBox3D.__new__(BoundingBox3D)
 *     v.lower = lower
 *     v.upper = upper             # <<<<<<<<<<<<<<
 *     return v
 * 
 */
  __Pyx_INCREF(((PyObject *)__pyx_v_upper));
  __Pyx_GIVEREF(((PyObject *)__pyx_v_upper));
  __Pyx_GOTREF(__pyx_v_v->upper);
  __Pyx_DECREF(((PyObject *)__pyx_v_v->upper));
  __pyx_v_v->upper = __pyx_v_upper;

  /* "raysect/core/boundingbox.pxd":81
 *     v.lower = lower
 *     v.upper = upper
 *     return v             # <<<<<<<<<<<<<<
 * 
 * 
 */
  __Pyx_XDECREF(((PyObject *)__pyx_r));
  __Pyx_INCREF(((PyObject *)__pyx_v_v));
  __pyx_r = __pyx_v_v;
  goto __pyx_L0;

  /* "raysect/core/boundingbox.pxd":69
 * 
 * 
 * cdef inline BoundingBox3D new_boundingbox3d(Point3D lower, Point3D upper):             # <<<<<<<<<<<<<<
 *     """
 *     BoundingBox3D factory function.
 */

  /* function exit code */
  __pyx_L1_error:;
  __Pyx_XDECREF(__pyx_t_1);
  __Pyx_AddTraceback("raysect.core.boundingbox.new_boundingbox3d", __pyx_clineno, __pyx_lineno, __pyx_filename);
  __pyx_r = 0;
  __pyx_L0:;
  __Pyx_XDECREF((PyObject *)__pyx_v_v);
  __Pyx_XGIVEREF((PyObject *)__pyx_r);
  __Pyx_RefNannyFinishContext();
  return __pyx_r;
}

/* "raysect/core/boundingbox.pxd":108
 * 
 * 
 * cdef inline BoundingBox2D new_boundingbox2d(Point2D lower, Point2D upper):             # <<<<<<<<<<<<<<
 *     """
 *     BoundingBox2D factory function.
 */

static CYTHON_INLINE struct __pyx_obj_7raysect_4core_11boundingbox_BoundingBox2D *__pyx_f_7raysect_4core_11boundingbox_new_boundingbox2d(struct __pyx_obj_7raysect_4core_4math_5point_Point2D *__pyx_v_lower, struct __pyx_obj_7raysect_4core_4math_5point_Point2D *__pyx_v_upper) {
  struct __pyx_obj_7raysect_4core_11boundingbox_BoundingBox2D *__pyx_v_b = 0;
  struct __pyx_obj_7raysect_4core_11boundingbox_BoundingBox2D *__pyx_r = NULL;
  __Pyx_RefNannyDeclarations
  PyObject *__pyx_t_1 = NULL;
  int __pyx_lineno = 0;
  const char *__pyx_filename = NULL;
  int __pyx_clineno = 0;
  __Pyx_RefNannySetupContext("new_boundingbox2d", 0);

  /* "raysect/core/boundingbox.pxd":117
 * 
 *     cdef BoundingBox2D b
 *     b = BoundingBox2D.__new__(BoundingBox2D)             # <<<<<<<<<<<<<<
 *     b.lower = lower
 *     b.upper = upper
 */
  __pyx_t_1 = __Pyx_tp_new(((PyObject *)__pyx_ptype_7raysect_4core_11boundingbox_BoundingBox2D), __pyx_empty_tuple); if (unlikely(!__pyx_t_1)) {__pyx_filename = __pyx_f[5]; __pyx_lineno = 117; __pyx_clineno = __LINE__; goto __pyx_L1_error;}
  __Pyx_GOTREF(__pyx_t_1);
  if (!(likely(__Pyx_TypeTest(__pyx_t_1, __pyx_ptype_7raysect_4core_11boundingbox_BoundingBox2D)))) {__pyx_filename = __pyx_f[5]; __pyx_lineno = 117; __pyx_clineno = __LINE__; goto __pyx_L1_error;}
  __pyx_v_b = ((struct __pyx_obj_7raysect_4core_11boundingbox_BoundingBox2D *)__pyx_t_1);
  __pyx_t_1 = 0;

  /* "raysect/core/boundingbox.pxd":118
 *     cdef BoundingBox2D b
 *     b = BoundingBox2D.__new__(BoundingBox2D)
 *     b.lower = lower             # <<<<<<<<<<<<<<
 *     b.upper = upper
 *     return b
 */
  __Pyx_INCREF(((PyObject *)__pyx_v_lower));
  __Pyx_GIVEREF(((PyObject *)__pyx_v_lower));
  __Pyx_GOTREF(__pyx_v_b->lower);
  __Pyx_DECREF(((PyObject *)__pyx_v_b->lower));
  __pyx_v_b->lower = __pyx_v_lower;

  /* "raysect/core/boundingbox.pxd":119
 *     b = BoundingBox2D.__new__(BoundingBox2D)
 *     b.lower = lower
 *     b.upper = upper             # <<<<<<<<<<<<<<
 *     return b
 */
  __Pyx_INCREF(((PyObject *)__pyx_v_upper));
  __Pyx_GIVEREF(((PyObject *)__pyx_v_upper));
  __Pyx_GOTREF(__pyx_v_b->upper);
  __Pyx_DECREF(((PyObject *)__pyx_v_b->upper));
  __pyx_v_b->upper = __pyx_v_upper;

  /* "raysect/core/boundingbox.pxd":120
 *     b.lower = lower
 *     b.upper = upper
 *     return b             # <<<<<<<<<<<<<<
 */
  __Pyx_XDECREF(((PyObject *)__pyx_r));
  __Pyx_INCREF(((PyObject *)__pyx_v_b));
  __pyx_r = __pyx_v_b;
  goto __pyx_L0;

  /* "raysect/core/boundingbox.pxd":108
 * 
 * 
 * cdef inline BoundingBox2D new_boundingbox2d(Point2D lower, Point2D upper):             # <<<<<<<<<<<<<<
 *     """
 *     BoundingBox2D factory function.
 */

  /* function exit code */
  __pyx_L1_error:;
  __Pyx_XDECREF(__pyx_t_1);
  __Pyx_AddTraceback("raysect.core.boundingbox.new_boundingbox2d", __pyx_clineno, __pyx_lineno, __pyx_filename);
  __pyx_r = 0;
  __pyx_L0:;
  __Pyx_XDECREF((PyObject *)__pyx_v_b);
  __Pyx_XGIVEREF((PyObject *)__pyx_r);
  __Pyx_RefNannyFinishContext();
  return __pyx_r;
}

/* "raysect/core/classes.pxd":49
 * 
 * 
 * cdef inline new_ray(Point3D origin, Vector3D direction, double max_distance):             # <<<<<<<<<<<<<<
 * 
 *     cdef Ray ray
 */

static CYTHON_INLINE PyObject *__pyx_f_7raysect_4core_7classes_new_ray(struct __pyx_obj_7raysect_4core_4math_5point_Point3D *__pyx_v_origin, struct __pyx_obj_7raysect_4core_4math_6vector_Vector3D *__pyx_v_direction, double __pyx_v_max_distance) {
  struct __pyx_obj_7raysect_4core_7classes_Ray *__pyx_v_ray = 0;
  PyObject *__pyx_r = NULL;
  __Pyx_RefNannyDeclarations
  PyObject *__pyx_t_1 = NULL;
  int __pyx_lineno = 0;
  const char *__pyx_filename = NULL;
  int __pyx_clineno = 0;
  __Pyx_RefNannySetupContext("new_ray", 0);

  /* "raysect/core/classes.pxd":53
 *     cdef Ray ray
 * 
 *     ray = Ray.__new__(Ray)             # <<<<<<<<<<<<<<
 *     ray.origin = origin
 *     ray.direction = direction
 */
  __pyx_t_1 = __Pyx_tp_new(((PyObject *)__pyx_ptype_7raysect_4core_7classes_Ray), __pyx_empty_tuple); if (unlikely(!__pyx_t_1)) {__pyx_filename = __pyx_f[6]; __pyx_lineno = 53; __pyx_clineno = __LINE__; goto __pyx_L1_error;}
  __Pyx_GOTREF(__pyx_t_1);
  if (!(likely(__Pyx_TypeTest(__pyx_t_1, __pyx_ptype_7raysect_4core_7classes_Ray)))) {__pyx_filename = __pyx_f[6]; __pyx_lineno = 53; __pyx_clineno = __LINE__; goto __pyx_L1_error;}
  __pyx_v_ray = ((struct __pyx_obj_7raysect_4core_7classes_Ray *)__pyx_t_1);
  __pyx_t_1 = 0;

  /* "raysect/core/classes.pxd":54
 * 
 *     ray = Ray.__new__(Ray)
 *     ray.origin = origin             # <<<<<<<<<<<<<<
 *     ray.direction = direction
 *     ray.max_distance = max_distance
 */
  __Pyx_INCREF(((PyObject *)__pyx_v_origin));
  __Pyx_GIVEREF(((PyObject *)__pyx_v_origin));
  __Pyx_GOTREF(__pyx_v_ray->origin);
  __Pyx_DECREF(((PyObject *)__pyx_v_ray->origin));
  __pyx_v_ray->origin = __pyx_v_origin;

  /* "raysect/core/classes.pxd":55
 *     ray = Ray.__new__(Ray)
 *     ray.origin = origin
 *     ray.direction = direction             # <<<<<<<<<<<<<<
 *     ray.max_distance = max_distance
 *     return ray
 */
  __Pyx_INCREF(((PyObject *)__pyx_v_direction));
  __Pyx_GIVEREF(((PyObject *)__pyx_v_direction));
  __Pyx_GOTREF(__pyx_v_ray->direction);
  __Pyx_DECREF(((PyObject *)__pyx_v_ray->direction));
  __pyx_v_ray->direction = __pyx_v_direction;

  /* "raysect/core/classes.pxd":56
 *     ray.origin = origin
 *     ray.direction = direction
 *     ray.max_distance = max_distance             # <<<<<<<<<<<<<<
 *     return ray
 * 
 */
  __pyx_v_ray->max_distance = __pyx_v_max_distance;

  /* "raysect/core/classes.pxd":57
 *     ray.direction = direction
 *     ray.max_distance = max_distance
 *     return ray             # <<<<<<<<<<<<<<
 * 
 * 
 */
  __Pyx_XDECREF(__pyx_r);
  __Pyx_INCREF(((PyObject *)__pyx_v_ray));
  __pyx_r = ((PyObject *)__pyx_v_ray);
  goto __pyx_L0;

  /* "raysect/core/classes.pxd":49
 * 
 * 
 * cdef inline new_ray(Point3D origin, Vector3D direction, double max_distance):             # <<<<<<<<<<<<<<
 * 
 *     cdef Ray ray
 */

  /* function exit code */
  __pyx_L1_error:;
  __Pyx_XDECREF(__pyx_t_1);
  __Pyx_AddTraceback("raysect.core.classes.new_ray", __pyx_clineno, __pyx_lineno, __pyx_filename);
  __pyx_r = 0;
  __pyx_L0:;
  __Pyx_XDECREF((PyObject *)__pyx_v_ray);
  __Pyx_XGIVEREF(__pyx_r);
  __Pyx_RefNannyFinishContext();
  return __pyx_r;
}

/* "raysect/core/classes.pxd":74
 * 
 * 
 * cdef inline Intersection new_intersection(Ray ray, double ray_distance, Primitive primitive,             # <<<<<<<<<<<<<<
 *                                           Point3D hit_point, Point3D inside_point, Point3D outside_point,
 *                                           Normal3D normal, bint exiting, AffineMatrix3D to_local, AffineMatrix3D to_world):
 */

static CYTHON_INLINE struct __pyx_obj_7raysect_4core_7classes_Intersection *__pyx_f_7raysect_4core_7classes_new_intersection(struct __pyx_obj_7raysect_4core_7classes_Ray *__pyx_v_ray, double __pyx_v_ray_distance, struct __pyx_obj_7raysect_4core_10scenegraph_9primitive_Primitive *__pyx_v_primitive, struct __pyx_obj_7raysect_4core_4math_5point_Point3D *__pyx_v_hit_point, struct __pyx_obj_7raysect_4core_4math_5point_Point3D *__pyx_v_inside_point, struct __pyx_obj_7raysect_4core_4math_5point_Point3D *__pyx_v_outside_point, struct __pyx_obj_7raysect_4core_4math_6normal_Normal3D *__pyx_v_normal, int __pyx_v_exiting, struct __pyx_obj_7raysect_4core_4math_12affinematrix_AffineMatrix3D *__pyx_v_to_local, struct __pyx_obj_7raysect_4core_4math_12affinematrix_AffineMatrix3D *__pyx_v_to_world) {
  struct __pyx_obj_7raysect_4core_7classes_Intersection *__pyx_v_intersection = 0;
  struct __pyx_obj_7raysect_4core_7classes_Intersection *__pyx_r = NULL;
  __Pyx_RefNannyDeclarations
  PyObject *__pyx_t_1 = NULL;
  int __pyx_lineno = 0;
  const char *__pyx_filename = NULL;
  int __pyx_clineno = 0;
  __Pyx_RefNannySetupContext("new_intersection", 0);

  /* "raysect/core/classes.pxd":80
 *     cdef Intersection intersection
 * 
 *     intersection = Intersection.__new__(Intersection)             # <<<<<<<<<<<<<<
 *     intersection.ray = ray
 *     intersection.ray_distance = ray_distance
 */
  __pyx_t_1 = __Pyx_tp_new(((PyObject *)__pyx_ptype_7raysect_4core_7classes_Intersection), __pyx_empty_tuple); if (unlikely(!__pyx_t_1)) {__pyx_filename = __pyx_f[6]; __pyx_lineno = 80; __pyx_clineno = __LINE__; goto __pyx_L1_error;}
  __Pyx_GOTREF(__pyx_t_1);
  if (!(likely(__Pyx_TypeTest(__pyx_t_1, __pyx_ptype_7raysect_4core_7classes_Intersection)))) {__pyx_filename = __pyx_f[6]; __pyx_lineno = 80; __pyx_clineno = __LINE__; goto __pyx_L1_error;}
  __pyx_v_intersection = ((struct __pyx_obj_7raysect_4core_7classes_Intersection *)__pyx_t_1);
  __pyx_t_1 = 0;

  /* "raysect/core/classes.pxd":81
 * 
 *     intersection = Intersection.__new__(Intersection)
 *     intersection.ray = ray             # <<<<<<<<<<<<<<
 *     intersection.ray_distance = ray_distance
 *     intersection.exiting = exiting
 */
  __Pyx_INCREF(((PyObject *)__pyx_v_ray));
  __Pyx_GIVEREF(((PyObject *)__pyx_v_ray));
  __Pyx_GOTREF(__pyx_v_intersection->ray);
  __Pyx_DECREF(((PyObject *)__pyx_v_intersection->ray));
  __pyx_v_intersection->ray = __pyx_v_ray;

  /* "raysect/core/classes.pxd":82
 *     intersection = Intersection.__new__(Intersection)
 *     intersection.ray = ray
 *     intersection.ray_distance = ray_distance             # <<<<<<<<<<<<<<
 *     intersection.exiting = exiting
 *     intersection.primitive = primitive
 */
  __pyx_v_intersection->ray_distance = __pyx_v_ray_distance;

  /* "raysect/core/classes.pxd":83
 *     intersection.ray = ray
 *     intersection.ray_distance = ray_distance
 *     intersection.exiting = exiting             # <<<<<<<<<<<<<<
 *     intersection.primitive = primitive
 *     intersection.hit_point = hit_point
 */
  __pyx_v_intersection->exiting = __pyx_v_exiting;

  /* "raysect/core/classes.pxd":84
 *     intersection.ray_distance = ray_distance
 *     intersection.exiting = exiting
 *     intersection.primitive = primitive             # <<<<<<<<<<<<<<
 *     intersection.hit_point = hit_point
 *     intersection.inside_point = inside_point
 */
  __Pyx_INCREF(((PyObject *)__pyx_v_primitive));
  __Pyx_GIVEREF(((PyObject *)__pyx_v_primitive));
  __Pyx_GOTREF(__pyx_v_intersection->primitive);
  __Pyx_DECREF(((PyObject *)__pyx_v_intersection->primitive));
  __pyx_v_intersection->primitive = __pyx_v_primitive;

  /* "raysect/core/classes.pxd":85
 *     intersection.exiting = exiting
 *     intersection.primitive = primitive
 *     intersection.hit_point = hit_point             # <<<<<<<<<<<<<<
 *     intersection.inside_point = inside_point
 *     intersection.outside_point = outside_point
 */
  __Pyx_INCREF(((PyObject *)__pyx_v_hit_point));
  __Pyx_GIVEREF(((PyObject *)__pyx_v_hit_point));
  __Pyx_GOTREF(__pyx_v_intersection->hit_point);
  __Pyx_DECREF(((PyObject *)__pyx_v_intersection->hit_point));
  __pyx_v_intersection->hit_point = __pyx_v_hit_point;

  /* "raysect/core/classes.pxd":86
 *     intersection.primitive = primitive
 *     intersection.hit_point = hit_point
 *     intersection.inside_point = inside_point             # <<<<<<<<<<<<<<
 *     intersection.outside_point = outside_point
 *     intersection.normal = normal
 */
  __Pyx_INCREF(((PyObject *)__pyx_v_inside_point));
  __Pyx_GIVEREF(((PyObject *)__pyx_v_inside_point));
  __Pyx_GOTREF(__pyx_v_intersection->inside_point);
  __Pyx_DECREF(((PyObject *)__pyx_v_intersection->inside_point));
  __pyx_v_intersection->inside_point = __pyx_v_inside_point;

  /* "raysect/core/classes.pxd":87
 *     intersection.hit_point = hit_point
 *     intersection.inside_point = inside_point
 *     intersection.outside_point = outside_point             # <<<<<<<<<<<<<<
 *     intersection.normal = normal
 *     intersection.to_local = to_local
 */
  __Pyx_INCREF(((PyObject *)__pyx_v_outside_point));
  __Pyx_GIVEREF(((PyObject *)__pyx_v_outside_point));
  __Pyx_GOTREF(__pyx_v_intersection->outside_point);
  __Pyx_DECREF(((PyObject *)__pyx_v_intersection->outside_point));
  __pyx_v_intersection->outside_point = __pyx_v_outside_point;

  /* "raysect/core/classes.pxd":88
 *     intersection.inside_point = inside_point
 *     intersection.outside_point = outside_point
 *     intersection.normal = normal             # <<<<<<<<<<<<<<
 *     intersection.to_local = to_local
 *     intersection.to_world = to_world
 */
  __Pyx_INCREF(((PyObject *)__pyx_v_normal));
  __Pyx_GIVEREF(((PyObject *)__pyx_v_normal));
  __Pyx_GOTREF(__pyx_v_intersection->normal);
  __Pyx_DECREF(((PyObject *)__pyx_v_intersection->normal));
  __pyx_v_intersection->normal = __pyx_v_normal;

  /* "raysect/core/classes.pxd":89
 *     intersection.outside_point = outside_point
 *     intersection.normal = normal
 *     intersection.to_local = to_local             # <<<<<<<<<<<<<<
 *     intersection.to_world = to_world
 *     return intersection
 */
  __Pyx_INCREF(((PyObject *)__pyx_v_to_local));
  __Pyx_GIVEREF(((PyObject *)__pyx_v_to_local));
  __Pyx_GOTREF(__pyx_v_intersection->to_local);
  __Pyx_DECREF(((PyObject *)__pyx_v_intersection->to_local));
  __pyx_v_intersection->to_local = __pyx_v_to_local;

  /* "raysect/core/classes.pxd":90
 *     intersection.normal = normal
 *     intersection.to_local = to_local
 *     intersection.to_world = to_world             # <<<<<<<<<<<<<<
 *     return intersection
 * 
 */
  __Pyx_INCREF(((PyObject *)__pyx_v_to_world));
  __Pyx_GIVEREF(((PyObject *)__pyx_v_to_world));
  __Pyx_GOTREF(__pyx_v_intersection->to_world);
  __Pyx_DECREF(((PyObject *)__pyx_v_intersection->to_world));
  __pyx_v_intersection->to_world = __pyx_v_to_world;

  /* "raysect/core/classes.pxd":91
 *     intersection.to_local = to_local
 *     intersection.to_world = to_world
 *     return intersection             # <<<<<<<<<<<<<<
 * 
 * 
 */
  __Pyx_XDECREF(((PyObject *)__pyx_r));
  __Pyx_INCREF(((PyObject *)__pyx_v_intersection));
  __pyx_r = __pyx_v_intersection;
  goto __pyx_L0;

  /* "raysect/core/classes.pxd":74
 * 
 * 
 * cdef inline Intersection new_intersection(Ray ray, double ray_distance, Primitive primitive,             # <<<<<<<<<<<<<<
 *                                           Point3D hit_point, Point3D inside_point, Point3D outside_point,
 *                                           Normal3D normal, bint exiting, AffineMatrix3D to_local, AffineMatrix3D to_world):
 */

  /* function exit code */
  __pyx_L1_error:;
  __Pyx_XDECREF(__pyx_t_1);
  __Pyx_AddTraceback("raysect.core.classes.new_intersection", __pyx_clineno, __pyx_lineno, __pyx_filename);
  __pyx_r = 0;
  __pyx_L0:;
  __Pyx_XDECREF((PyObject *)__pyx_v_intersection);
  __Pyx_XGIVEREF((PyObject *)__pyx_r);
  __Pyx_RefNannyFinishContext();
  return __pyx_r;
}
static struct __pyx_vtabstruct_7raysect_4core_12acceleration_11accelerator_Accelerator __pyx_vtable_7raysect_4core_12acceleration_11accelerator_Accelerator;

static PyObject *__pyx_tp_new_7raysect_4core_12acceleration_11accelerator_Accelerator(PyTypeObject *t, CYTHON_UNUSED PyObject *a, CYTHON_UNUSED PyObject *k) {
  struct __pyx_obj_7raysect_4core_12acceleration_11accelerator_Accelerator *p;
  PyObject *o;
  if (likely((t->tp_flags & Py_TPFLAGS_IS_ABSTRACT) == 0)) {
    o = (*t->tp_alloc)(t, 0);
  } else {
    o = (PyObject *) PyBaseObject_Type.tp_new(t, __pyx_empty_tuple, 0);
  }
  if (unlikely(!o)) return 0;
  p = ((struct __pyx_obj_7raysect_4core_12acceleration_11accelerator_Accelerator *)o);
  p->__pyx_vtab = __pyx_vtabptr_7raysect_4core_12acceleration_11accelerator_Accelerator;
  return o;
}

static void __pyx_tp_dealloc_7raysect_4core_12acceleration_11accelerator_Accelerator(PyObject *o) {
  #if PY_VERSION_HEX >= 0x030400a1
  if (unlikely(Py_TYPE(o)->tp_finalize) && (!PyType_IS_GC(Py_TYPE(o)) || !_PyGC_FINALIZED(o))) {
    if (PyObject_CallFinalizerFromDealloc(o)) return;
  }
  #endif
  (*Py_TYPE(o)->tp_free)(o);
}

static PyMethodDef __pyx_methods_7raysect_4core_12acceleration_11accelerator_Accelerator[] = {
  {"build", (PyCFunction)__pyx_pw_7raysect_4core_12acceleration_11accelerator_11Accelerator_1build, METH_O, 0},
  {"hit", (PyCFunction)__pyx_pw_7raysect_4core_12acceleration_11accelerator_11Accelerator_3hit, METH_O, 0},
  {"contains", (PyCFunction)__pyx_pw_7raysect_4core_12acceleration_11accelerator_11Accelerator_5contains, METH_O, 0},
  {0, 0, 0, 0}
};

static PyTypeObject __pyx_type_7raysect_4core_12acceleration_11accelerator_Accelerator = {
  PyVarObject_HEAD_INIT(0, 0)
  "raysect.core.acceleration.accelerator.Accelerator", /*tp_name*/
  sizeof(struct __pyx_obj_7raysect_4core_12acceleration_11accelerator_Accelerator), /*tp_basicsize*/
  0, /*tp_itemsize*/
  __pyx_tp_dealloc_7raysect_4core_12acceleration_11accelerator_Accelerator, /*tp_dealloc*/
  0, /*tp_print*/
  0, /*tp_getattr*/
  0, /*tp_setattr*/
  #if PY_MAJOR_VERSION < 3
  0, /*tp_compare*/
  #endif
  #if PY_MAJOR_VERSION >= 3
  0, /*tp_as_async*/
  #endif
  0, /*tp_repr*/
  0, /*tp_as_number*/
  0, /*tp_as_sequence*/
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  0, /*tp_as_buffer*/
  Py_TPFLAGS_DEFAULT|Py_TPFLAGS_HAVE_VERSION_TAG|Py_TPFLAGS_CHECKTYPES|Py_TPFLAGS_HAVE_NEWBUFFER|Py_TPFLAGS_BASETYPE, /*tp_flags*/
  0, /*tp_doc*/
  0, /*tp_traverse*/
  0, /*tp_clear*/
  0, /*tp_richcompare*/
  0, /*tp_weaklistoffset*/
  0, /*tp_iter*/
  0, /*tp_iternext*/
  __pyx_methods_7raysect_4core_12acceleration_11accelerator_Accelerator, /*tp_methods*/
  0, /*tp_members*/
  0, /*tp_getset*/
  0, /*tp_base*/
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  0, /*tp_alloc*/
  __pyx_tp_new_7raysect_4core_12acceleration_11accelerator_Accelerator, /*tp_new*/
  0, /*tp_free*/
  0, /*tp_is_gc*/
  0, /*tp_bases*/
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  0, /*tp_version_tag*/
  #if PY_VERSION_HEX >= 0x030400a1
  0, /*tp_finalize*/
  #endif
};

static PyMethodDef __pyx_methods[] = {
  {0, 0, 0, 0}
};

#if PY_MAJOR_VERSION >= 3
static struct PyModuleDef __pyx_moduledef = {
  #if PY_VERSION_HEX < 0x03020000
    { PyObject_HEAD_INIT(NULL) NULL, 0, NULL },
  #else
    PyModuleDef_HEAD_INIT,
  #endif
    "accelerator",
    0, /* m_doc */
    -1, /* m_size */
    __pyx_methods /* m_methods */,
    NULL, /* m_reload */
    NULL, /* m_traverse */
    NULL, /* m_clear */
    NULL /* m_free */
};
#endif

static __Pyx_StringTabEntry __pyx_string_tab[] = {
  {&__pyx_kp_u_Accelerator_virtual_method_conta, __pyx_k_Accelerator_virtual_method_conta, sizeof(__pyx_k_Accelerator_virtual_method_conta), 0, 1, 0, 0},
  {&__pyx_kp_u_Accelerator_virtual_method_hit_h, __pyx_k_Accelerator_virtual_method_hit_h, sizeof(__pyx_k_Accelerator_virtual_method_hit_h), 0, 1, 0, 0},
  {&__pyx_n_s_NotImplementedError, __pyx_k_NotImplementedError, sizeof(__pyx_k_NotImplementedError), 0, 0, 1, 1},
  {&__pyx_n_s_build, __pyx_k_build, sizeof(__pyx_k_build), 0, 0, 1, 1},
  {&__pyx_n_s_contains, __pyx_k_contains, sizeof(__pyx_k_contains), 0, 0, 1, 1},
  {&__pyx_n_s_hit, __pyx_k_hit, sizeof(__pyx_k_hit), 0, 0, 1, 1},
  {&__pyx_n_s_main, __pyx_k_main, sizeof(__pyx_k_main), 0, 0, 1, 1},
  {&__pyx_n_s_pyx_vtable, __pyx_k_pyx_vtable, sizeof(__pyx_k_pyx_vtable), 0, 0, 1, 1},
  {&__pyx_n_s_test, __pyx_k_test, sizeof(__pyx_k_test), 0, 0, 1, 1},
  {0, 0, 0, 0, 0, 0, 0}
};
static int __Pyx_InitCachedBuiltins(void) {
  __pyx_builtin_NotImplementedError = __Pyx_GetBuiltinName(__pyx_n_s_NotImplementedError); if (!__pyx_builtin_NotImplementedError) {__pyx_filename = __pyx_f[0]; __pyx_lineno = 40; __pyx_clineno = __LINE__; goto __pyx_L1_error;}
  return 0;
  __pyx_L1_error:;
  return -1;
}

static int __Pyx_InitCachedConstants(void) {
  __Pyx_RefNannyDeclarations
  __Pyx_RefNannySetupContext("__Pyx_InitCachedConstants", 0);

  /* "raysect/core/acceleration/accelerator.pyx":40
 *     cpdef Intersection hit(self, Ray ray):
 * 
 *         raise NotImplementedError("Accelerator virtual method hit() has not been implemented.")             # <<<<<<<<<<<<<<
 * 
 *     cpdef list contains(self, Point3D point):
 */
  __pyx_tuple_ = PyTuple_Pack(1, __pyx_kp_u_Accelerator_virtual_method_hit_h); if (unlikely(!__pyx_tuple_)) {__pyx_filename = __pyx_f[0]; __pyx_lineno = 40; __pyx_clineno = __LINE__; goto __pyx_L1_error;}
  __Pyx_GOTREF(__pyx_tuple_);
  __Pyx_GIVEREF(__pyx_tuple_);

  /* "raysect/core/acceleration/accelerator.pyx":44
 *     cpdef list contains(self, Point3D point):
 * 
 *         raise NotImplementedError("Accelerator virtual method contains() has not been implemented.")             # <<<<<<<<<<<<<<
 */
  __pyx_tuple__2 = PyTuple_Pack(1, __pyx_kp_u_Accelerator_virtual_method_conta); if (unlikely(!__pyx_tuple__2)) {__pyx_filename = __pyx_f[0]; __pyx_lineno = 44; __pyx_clineno = __LINE__; goto __pyx_L1_error;}
  __Pyx_GOTREF(__pyx_tuple__2);
  __Pyx_GIVEREF(__pyx_tuple__2);
  __Pyx_RefNannyFinishContext();
  return 0;
  __pyx_L1_error:;
  __Pyx_RefNannyFinishContext();
  return -1;
}

static int __Pyx_InitGlobals(void) {
  if (__Pyx_InitStrings(__pyx_string_tab) < 0) {__pyx_filename = __pyx_f[0]; __pyx_lineno = 1; __pyx_clineno = __LINE__; goto __pyx_L1_error;};
  return 0;
  __pyx_L1_error:;
  return -1;
}

#if PY_MAJOR_VERSION < 3
PyMODINIT_FUNC initaccelerator(void); /*proto*/
PyMODINIT_FUNC initaccelerator(void)
#else
PyMODINIT_FUNC PyInit_accelerator(void); /*proto*/
PyMODINIT_FUNC PyInit_accelerator(void)
#endif
{
  PyObject *__pyx_t_1 = NULL;
  int __pyx_lineno = 0;
  const char *__pyx_filename = NULL;
  int __pyx_clineno = 0;
  __Pyx_RefNannyDeclarations
  #if CYTHON_REFNANNY
  __Pyx_RefNanny = __Pyx_RefNannyImportAPI("refnanny");
  if (!__Pyx_RefNanny) {
      PyErr_Clear();
      __Pyx_RefNanny = __Pyx_RefNannyImportAPI("Cython.Runtime.refnanny");
      if (!__Pyx_RefNanny)
          Py_FatalError("failed to import 'refnanny' module");
  }
  #endif
  __Pyx_RefNannySetupContext("PyMODINIT_FUNC PyInit_accelerator(void)", 0);
  if (__Pyx_check_binary_version() < 0) {__pyx_filename = __pyx_f[0]; __pyx_lineno = 1; __pyx_clineno = __LINE__; goto __pyx_L1_error;}
  __pyx_empty_tuple = PyTuple_New(0); if (unlikely(!__pyx_empty_tuple)) {__pyx_filename = __pyx_f[0]; __pyx_lineno = 1; __pyx_clineno = __LINE__; goto __pyx_L1_error;}
  __pyx_empty_bytes = PyBytes_FromStringAndSize("", 0); if (unlikely(!__pyx_empty_bytes)) {__pyx_filename = __pyx_f[0]; __pyx_lineno = 1; __pyx_clineno = __LINE__; goto __pyx_L1_error;}
  #ifdef __Pyx_CyFunction_USED
  if (__pyx_CyFunction_init() < 0) {__pyx_filename = __pyx_f[0]; __pyx_lineno = 1; __pyx_clineno = __LINE__; goto __pyx_L1_error;}
  #endif
  #ifdef __Pyx_FusedFunction_USED
  if (__pyx_FusedFunction_init() < 0) {__pyx_filename = __pyx_f[0]; __pyx_lineno = 1; __pyx_clineno = __LINE__; goto __pyx_L1_error;}
  #endif
  #ifdef __Pyx_Coroutine_USED
  if (__pyx_Coroutine_init() < 0) {__pyx_filename = __pyx_f[0]; __pyx_lineno = 1; __pyx_clineno = __LINE__; goto __pyx_L1_error;}
  #endif
  #ifdef __Pyx_Generator_USED
  if (__pyx_Generator_init() < 0) {__pyx_filename = __pyx_f[0]; __pyx_lineno = 1; __pyx_clineno = __LINE__; goto __pyx_L1_error;}
  #endif
  #ifdef __Pyx_StopAsyncIteration_USED
  if (__pyx_StopAsyncIteration_init() < 0) {__pyx_filename = __pyx_f[0]; __pyx_lineno = 1; __pyx_clineno = __LINE__; goto __pyx_L1_error;}
  #endif
  /*--- Library function declarations ---*/
  /*--- Threads initialization code ---*/
  #if defined(__PYX_FORCE_INIT_THREADS) && __PYX_FORCE_INIT_THREADS
  #ifdef WITH_THREAD /* Python build with threading support? */
  PyEval_InitThreads();
  #endif
  #endif
  /*--- Module creation code ---*/
  #if PY_MAJOR_VERSION < 3
  __pyx_m = Py_InitModule4("accelerator", __pyx_methods, 0, 0, PYTHON_API_VERSION); Py_XINCREF(__pyx_m);
  #else
  __pyx_m = PyModule_Create(&__pyx_moduledef);
  #endif
  if (unlikely(!__pyx_m)) {__pyx_filename = __pyx_f[0]; __pyx_lineno = 1; __pyx_clineno = __LINE__; goto __pyx_L1_error;}
  __pyx_d = PyModule_GetDict(__pyx_m); if (unlikely(!__pyx_d)) {__pyx_filename = __pyx_f[0]; __pyx_lineno = 1; __pyx_clineno = __LINE__; goto __pyx_L1_error;}
  Py_INCREF(__pyx_d);
  __pyx_b = PyImport_AddModule(__Pyx_BUILTIN_MODULE_NAME); if (unlikely(!__pyx_b)) {__pyx_filename = __pyx_f[0]; __pyx_lineno = 1; __pyx_clineno = __LINE__; goto __pyx_L1_error;}
  #if CYTHON_COMPILING_IN_PYPY
  Py_INCREF(__pyx_b);
  #endif
  if (PyObject_SetAttrString(__pyx_m, "__builtins__", __pyx_b) < 0) {__pyx_filename = __pyx_f[0]; __pyx_lineno = 1; __pyx_clineno = __LINE__; goto __pyx_L1_error;};
  /*--- Initialize various global constants etc. ---*/
  if (__Pyx_InitGlobals() < 0) {__pyx_filename = __pyx_f[0]; __pyx_lineno = 1; __pyx_clineno = __LINE__; goto __pyx_L1_error;}
  #if PY_MAJOR_VERSION < 3 && (__PYX_DEFAULT_STRING_ENCODING_IS_ASCII || __PYX_DEFAULT_STRING_ENCODING_IS_DEFAULT)
  if (__Pyx_init_sys_getdefaultencoding_params() < 0) {__pyx_filename = __pyx_f[0]; __pyx_lineno = 1; __pyx_clineno = __LINE__; goto __pyx_L1_error;}
  #endif
  if (__pyx_module_is_main_raysect__core__acceleration__accelerator) {
    if (PyObject_SetAttrString(__pyx_m, "__name__", __pyx_n_s_main) < 0) {__pyx_filename = __pyx_f[0]; __pyx_lineno = 1; __pyx_clineno = __LINE__; goto __pyx_L1_error;}
  }
  #if PY_MAJOR_VERSION >= 3
  {
    PyObject *modules = PyImport_GetModuleDict(); if (unlikely(!modules)) {__pyx_filename = __pyx_f[0]; __pyx_lineno = 1; __pyx_clineno = __LINE__; goto __pyx_L1_error;}
    if (!PyDict_GetItemString(modules, "raysect.core.acceleration.accelerator")) {
      if (unlikely(PyDict_SetItemString(modules, "raysect.core.acceleration.accelerator", __pyx_m) < 0)) {__pyx_filename = __pyx_f[0]; __pyx_lineno = 1; __pyx_clineno = __LINE__; goto __pyx_L1_error;}
    }
  }
  #endif
  /*--- Builtin init code ---*/
  if (__Pyx_InitCachedBuiltins() < 0) {__pyx_filename = __pyx_f[0]; __pyx_lineno = 1; __pyx_clineno = __LINE__; goto __pyx_L1_error;}
  /*--- Constants init code ---*/
  if (__Pyx_InitCachedConstants() < 0) {__pyx_filename = __pyx_f[0]; __pyx_lineno = 1; __pyx_clineno = __LINE__; goto __pyx_L1_error;}
  /*--- Global init code ---*/
  /*--- Variable export code ---*/
  /*--- Function export code ---*/
  /*--- Type init code ---*/
  __pyx_vtabptr_7raysect_4core_12acceleration_11accelerator_Accelerator = &__pyx_vtable_7raysect_4core_12acceleration_11accelerator_Accelerator;
  __pyx_vtable_7raysect_4core_12acceleration_11accelerator_Accelerator.build = (PyObject *(*)(struct __pyx_obj_7raysect_4core_12acceleration_11accelerator_Accelerator *, PyObject *, int __pyx_skip_dispatch))__pyx_f_7raysect_4core_12acceleration_11accelerator_11Accelerator_build;
  __pyx_vtable_7raysect_4core_12acceleration_11accelerator_Accelerator.hit = (struct __pyx_obj_7raysect_4core_7classes_Intersection *(*)(struct __pyx_obj_7raysect_4core_12acceleration_11accelerator_Accelerator *, struct __pyx_obj_7raysect_4core_7classes_Ray *, int __pyx_skip_dispatch))__pyx_f_7raysect_4core_12acceleration_11accelerator_11Accelerator_hit;
  __pyx_vtable_7raysect_4core_12acceleration_11accelerator_Accelerator.contains = (PyObject *(*)(struct __pyx_obj_7raysect_4core_12acceleration_11accelerator_Accelerator *, struct __pyx_obj_7raysect_4core_4math_5point_Point3D *, int __pyx_skip_dispatch))__pyx_f_7raysect_4core_12acceleration_11accelerator_11Accelerator_contains;
  if (PyType_Ready(&__pyx_type_7raysect_4core_12acceleration_11accelerator_Accelerator) < 0) {__pyx_filename = __pyx_f[0]; __pyx_lineno = 32; __pyx_clineno = __LINE__; goto __pyx_L1_error;}
  __pyx_type_7raysect_4core_12acceleration_11accelerator_Accelerator.tp_print = 0;
  if (__Pyx_SetVtable(__pyx_type_7raysect_4core_12acceleration_11accelerator_Accelerator.tp_dict, __pyx_vtabptr_7raysect_4core_12acceleration_11accelerator_Accelerator) < 0) {__pyx_filename = __pyx_f[0]; __pyx_lineno = 32; __pyx_clineno = __LINE__; goto __pyx_L1_error;}
  if (PyObject_SetAttrString(__pyx_m, "Accelerator", (PyObject *)&__pyx_type_7raysect_4core_12acceleration_11accelerator_Accelerator) < 0) {__pyx_filename = __pyx_f[0]; __pyx_lineno = 32; __pyx_clineno = __LINE__; goto __pyx_L1_error;}
  __pyx_ptype_7raysect_4core_12acceleration_11accelerator_Accelerator = &__pyx_type_7raysect_4core_12acceleration_11accelerator_Accelerator;
  /*--- Type import code ---*/
  __pyx_ptype_7raysect_4core_4math_5_vec3__Vec3 = __Pyx_ImportType("raysect.core.math._vec3", "_Vec3", sizeof(struct __pyx_obj_7raysect_4core_4math_5_vec3__Vec3), 1); if (unlikely(!__pyx_ptype_7raysect_4core_4math_5_vec3__Vec3)) {__pyx_filename = __pyx_f[7]; __pyx_lineno = 32; __pyx_clineno = __LINE__; goto __pyx_L1_error;}
  __pyx_vtabptr_7raysect_4core_4math_5_vec3__Vec3 = (struct __pyx_vtabstruct_7raysect_4core_4math_5_vec3__Vec3*)__Pyx_GetVtable(__pyx_ptype_7raysect_4core_4math_5_vec3__Vec3->tp_dict); if (unlikely(!__pyx_vtabptr_7raysect_4core_4math_5_vec3__Vec3)) {__pyx_filename = __pyx_f[7]; __pyx_lineno = 32; __pyx_clineno = __LINE__; goto __pyx_L1_error;}
  __pyx_ptype_7raysect_4core_4math_5_mat4__Mat4 = __Pyx_ImportType("raysect.core.math._mat4", "_Mat4", sizeof(struct __pyx_obj_7raysect_4core_4math_5_mat4__Mat4), 1); if (unlikely(!__pyx_ptype_7raysect_4core_4math_5_mat4__Mat4)) {__pyx_filename = __pyx_f[8]; __pyx_lineno = 32; __pyx_clineno = __LINE__; goto __pyx_L1_error;}
  __pyx_vtabptr_7raysect_4core_4math_5_mat4__Mat4 = (struct __pyx_vtabstruct_7raysect_4core_4math_5_mat4__Mat4*)__Pyx_GetVtable(__pyx_ptype_7raysect_4core_4math_5_mat4__Mat4->tp_dict); if (unlikely(!__pyx_vtabptr_7raysect_4core_4math_5_mat4__Mat4)) {__pyx_filename = __pyx_f[8]; __pyx_lineno = 32; __pyx_clineno = __LINE__; goto __pyx_L1_error;}
  __pyx_ptype_7raysect_4core_4math_12affinematrix_AffineMatrix3D = __Pyx_ImportType("raysect.core.math.affinematrix", "AffineMatrix3D", sizeof(struct __pyx_obj_7raysect_4core_4math_12affinematrix_AffineMatrix3D), 1); if (unlikely(!__pyx_ptype_7raysect_4core_4math_12affinematrix_AffineMatrix3D)) {__pyx_filename = __pyx_f[1]; __pyx_lineno = 35; __pyx_clineno = __LINE__; goto __pyx_L1_error;}
  __pyx_vtabptr_7raysect_4core_4math_12affinematrix_AffineMatrix3D = (struct __pyx_vtabstruct_7raysect_4core_4math_12affinematrix_AffineMatrix3D*)__Pyx_GetVtable(__pyx_ptype_7raysect_4core_4math_12affinematrix_AffineMatrix3D->tp_dict); if (unlikely(!__pyx_vtabptr_7raysect_4core_4math_12affinematrix_AffineMatrix3D)) {__pyx_filename = __pyx_f[1]; __pyx_lineno = 35; __pyx_clineno = __LINE__; goto __pyx_L1_error;}
  __pyx_ptype_7raysect_4core_4math_6vector_Vector3D = __Pyx_ImportType("raysect.core.math.vector", "Vector3D", sizeof(struct __pyx_obj_7raysect_4core_4math_6vector_Vector3D), 1); if (unlikely(!__pyx_ptype_7raysect_4core_4math_6vector_Vector3D)) {__pyx_filename = __pyx_f[2]; __pyx_lineno = 35; __pyx_clineno = __LINE__; goto __pyx_L1_error;}
  __pyx_vtabptr_7raysect_4core_4math_6vector_Vector3D = (struct __pyx_vtabstruct_7raysect_4core_4math_6vector_Vector3D*)__Pyx_GetVtable(__pyx_ptype_7raysect_4core_4math_6vector_Vector3D->tp_dict); if (unlikely(!__pyx_vtabptr_7raysect_4core_4math_6vector_Vector3D)) {__pyx_filename = __pyx_f[2]; __pyx_lineno = 35; __pyx_clineno = __LINE__; goto __pyx_L1_error;}
  __pyx_ptype_7raysect_4core_4math_5point_Point3D = __Pyx_ImportType("raysect.core.math.point", "Point3D", sizeof(struct __pyx_obj_7raysect_4core_4math_5point_Point3D), 1); if (unlikely(!__pyx_ptype_7raysect_4core_4math_5point_Point3D)) {__pyx_filename = __pyx_f[3]; __pyx_lineno = 36; __pyx_clineno = __LINE__; goto __pyx_L1_error;}
  __pyx_vtabptr_7raysect_4core_4math_5point_Point3D = (struct __pyx_vtabstruct_7raysect_4core_4math_5point_Point3D*)__Pyx_GetVtable(__pyx_ptype_7raysect_4core_4math_5point_Point3D->tp_dict); if (unlikely(!__pyx_vtabptr_7raysect_4core_4math_5point_Point3D)) {__pyx_filename = __pyx_f[3]; __pyx_lineno = 36; __pyx_clineno = __LINE__; goto __pyx_L1_error;}
  __pyx_ptype_7raysect_4core_4math_5point_Point2D = __Pyx_ImportType("raysect.core.math.point", "Point2D", sizeof(struct __pyx_obj_7raysect_4core_4math_5point_Point2D), 1); if (unlikely(!__pyx_ptype_7raysect_4core_4math_5point_Point2D)) {__pyx_filename = __pyx_f[3]; __pyx_lineno = 73; __pyx_clineno = __LINE__; goto __pyx_L1_error;}
  __pyx_vtabptr_7raysect_4core_4math_5point_Point2D = (struct __pyx_vtabstruct_7raysect_4core_4math_5point_Point2D*)__Pyx_GetVtable(__pyx_ptype_7raysect_4core_4math_5point_Point2D->tp_dict); if (unlikely(!__pyx_vtabptr_7raysect_4core_4math_5point_Point2D)) {__pyx_filename = __pyx_f[3]; __pyx_lineno = 73; __pyx_clineno = __LINE__; goto __pyx_L1_error;}
  __pyx_ptype_7raysect_4core_4math_6normal_Normal3D = __Pyx_ImportType("raysect.core.math.normal", "Normal3D", sizeof(struct __pyx_obj_7raysect_4core_4math_6normal_Normal3D), 1); if (unlikely(!__pyx_ptype_7raysect_4core_4math_6normal_Normal3D)) {__pyx_filename = __pyx_f[4]; __pyx_lineno = 36; __pyx_clineno = __LINE__; goto __pyx_L1_error;}
  __pyx_vtabptr_7raysect_4core_4math_6normal_Normal3D = (struct __pyx_vtabstruct_7raysect_4core_4math_6normal_Normal3D*)__Pyx_GetVtable(__pyx_ptype_7raysect_4core_4math_6normal_Normal3D->tp_dict); if (unlikely(!__pyx_vtabptr_7raysect_4core_4math_6normal_Normal3D)) {__pyx_filename = __pyx_f[4]; __pyx_lineno = 36; __pyx_clineno = __LINE__; goto __pyx_L1_error;}
  __pyx_ptype_7raysect_4core_10scenegraph_9_nodebase__NodeBase = __Pyx_ImportType("raysect.core.scenegraph._nodebase", "_NodeBase", sizeof(struct __pyx_obj_7raysect_4core_10scenegraph_9_nodebase__NodeBase), 1); if (unlikely(!__pyx_ptype_7raysect_4core_10scenegraph_9_nodebase__NodeBase)) {__pyx_filename = __pyx_f[9]; __pyx_lineno = 34; __pyx_clineno = __LINE__; goto __pyx_L1_error;}
  __pyx_ptype_7raysect_4core_10scenegraph_4node_Node = __Pyx_ImportType("raysect.core.scenegraph.node", "Node", sizeof(struct __pyx_obj_7raysect_4core_10scenegraph_4node_Node), 1); if (unlikely(!__pyx_ptype_7raysect_4core_10scenegraph_4node_Node)) {__pyx_filename = __pyx_f[10]; __pyx_lineno = 35; __pyx_clineno = __LINE__; goto __pyx_L1_error;}
  __pyx_vtabptr_7raysect_4core_10scenegraph_4node_Node = (struct __pyx_vtabstruct_7raysect_4core_10scenegraph_4node_Node*)__Pyx_GetVtable(__pyx_ptype_7raysect_4core_10scenegraph_4node_Node->tp_dict); if (unlikely(!__pyx_vtabptr_7raysect_4core_10scenegraph_4node_Node)) {__pyx_filename = __pyx_f[10]; __pyx_lineno = 35; __pyx_clineno = __LINE__; goto __pyx_L1_error;}
  __pyx_ptype_7raysect_4core_11boundingbox_BoundingBox3D = __Pyx_ImportType("raysect.core.boundingbox", "BoundingBox3D", sizeof(struct __pyx_obj_7raysect_4core_11boundingbox_BoundingBox3D), 1); if (unlikely(!__pyx_ptype_7raysect_4core_11boundingbox_BoundingBox3D)) {__pyx_filename = __pyx_f[5]; __pyx_lineno = 35; __pyx_clineno = __LINE__; goto __pyx_L1_error;}
  __pyx_vtabptr_7raysect_4core_11boundingbox_BoundingBox3D = (struct __pyx_vtabstruct_7raysect_4core_11boundingbox_BoundingBox3D*)__Pyx_GetVtable(__pyx_ptype_7raysect_4core_11boundingbox_BoundingBox3D->tp_dict); if (unlikely(!__pyx_vtabptr_7raysect_4core_11boundingbox_BoundingBox3D)) {__pyx_filename = __pyx_f[5]; __pyx_lineno = 35; __pyx_clineno = __LINE__; goto __pyx_L1_error;}
  __pyx_ptype_7raysect_4core_11boundingbox_BoundingBox2D = __Pyx_ImportType("raysect.core.boundingbox", "BoundingBox2D", sizeof(struct __pyx_obj_7raysect_4core_11boundingbox_BoundingBox2D), 1); if (unlikely(!__pyx_ptype_7raysect_4core_11boundingbox_BoundingBox2D)) {__pyx_filename = __pyx_f[5]; __pyx_lineno = 84; __pyx_clineno = __LINE__; goto __pyx_L1_error;}
  __pyx_vtabptr_7raysect_4core_11boundingbox_BoundingBox2D = (struct __pyx_vtabstruct_7raysect_4core_11boundingbox_BoundingBox2D*)__Pyx_GetVtable(__pyx_ptype_7raysect_4core_11boundingbox_BoundingBox2D->tp_dict); if (unlikely(!__pyx_vtabptr_7raysect_4core_11boundingbox_BoundingBox2D)) {__pyx_filename = __pyx_f[5]; __pyx_lineno = 84; __pyx_clineno = __LINE__; goto __pyx_L1_error;}
  __pyx_ptype_7raysect_4core_10scenegraph_9primitive_Primitive = __Pyx_ImportType("raysect.core.scenegraph.primitive", "Primitive", sizeof(struct __pyx_obj_7raysect_4core_10scenegraph_9primitive_Primitive), 1); if (unlikely(!__pyx_ptype_7raysect_4core_10scenegraph_9primitive_Primitive)) {__pyx_filename = __pyx_f[11]; __pyx_lineno = 37; __pyx_clineno = __LINE__; goto __pyx_L1_error;}
  __pyx_vtabptr_7raysect_4core_10scenegraph_9primitive_Primitive = (struct __pyx_vtabstruct_7raysect_4core_10scenegraph_9primitive_Primitive*)__Pyx_GetVtable(__pyx_ptype_7raysect_4core_10scenegraph_9primitive_Primitive->tp_dict); if (unlikely(!__pyx_vtabptr_7raysect_4core_10scenegraph_9primitive_Primitive)) {__pyx_filename = __pyx_f[11]; __pyx_lineno = 37; __pyx_clineno = __LINE__; goto __pyx_L1_error;}
  __pyx_ptype_7raysect_4core_7classes_Ray = __Pyx_ImportType("raysect.core.classes", "Ray", sizeof(struct __pyx_obj_7raysect_4core_7classes_Ray), 1); if (unlikely(!__pyx_ptype_7raysect_4core_7classes_Ray)) {__pyx_filename = __pyx_f[6]; __pyx_lineno = 38; __pyx_clineno = __LINE__; goto __pyx_L1_error;}
  __pyx_vtabptr_7raysect_4core_7classes_Ray = (struct __pyx_vtabstruct_7raysect_4core_7classes_Ray*)__Pyx_GetVtable(__pyx_ptype_7raysect_4core_7classes_Ray->tp_dict); if (unlikely(!__pyx_vtabptr_7raysect_4core_7classes_Ray)) {__pyx_filename = __pyx_f[6]; __pyx_lineno = 38; __pyx_clineno = __LINE__; goto __pyx_L1_error;}
  __pyx_ptype_7raysect_4core_7classes_Intersection = __Pyx_ImportType("raysect.core.classes", "Intersection", sizeof(struct __pyx_obj_7raysect_4core_7classes_Intersection), 1); if (unlikely(!__pyx_ptype_7raysect_4core_7classes_Intersection)) {__pyx_filename = __pyx_f[6]; __pyx_lineno = 60; __pyx_clineno = __LINE__; goto __pyx_L1_error;}
  __pyx_ptype_7raysect_4core_7classes_Material = __Pyx_ImportType("raysect.core.classes", "Material", sizeof(struct __pyx_obj_7raysect_4core_7classes_Material), 1); if (unlikely(!__pyx_ptype_7raysect_4core_7classes_Material)) {__pyx_filename = __pyx_f[6]; __pyx_lineno = 94; __pyx_clineno = __LINE__; goto __pyx_L1_error;}
  /*--- Variable import code ---*/
  /*--- Function import code ---*/
  /*--- Execution code ---*/
  #if defined(__Pyx_Generator_USED) || defined(__Pyx_Coroutine_USED)
  if (__Pyx_patch_abc() < 0) {__pyx_filename = __pyx_f[0]; __pyx_lineno = 1; __pyx_clineno = __LINE__; goto __pyx_L1_error;}
  #endif

  /* "raysect/core/acceleration/accelerator.pyx":1
 * # cython: language_level=3             # <<<<<<<<<<<<<<
 * 
 * # Copyright (c) 2014, Dr Alex Meakins, Raysect Project
 */
  __pyx_t_1 = PyDict_New(); if (unlikely(!__pyx_t_1)) {__pyx_filename = __pyx_f[0]; __pyx_lineno = 1; __pyx_clineno = __LINE__; goto __pyx_L1_error;}
  __Pyx_GOTREF(__pyx_t_1);
  if (PyDict_SetItem(__pyx_d, __pyx_n_s_test, __pyx_t_1) < 0) {__pyx_filename = __pyx_f[0]; __pyx_lineno = 1; __pyx_clineno = __LINE__; goto __pyx_L1_error;}
  __Pyx_DECREF(__pyx_t_1); __pyx_t_1 = 0;

  /* "raysect/core/classes.pxd":74
 * 
 * 
 * cdef inline Intersection new_intersection(Ray ray, double ray_distance, Primitive primitive,             # <<<<<<<<<<<<<<
 *                                           Point3D hit_point, Point3D inside_point, Point3D outside_point,
 *                                           Normal3D normal, bint exiting, AffineMatrix3D to_local, AffineMatrix3D to_world):
 */

  /*--- Wrapped vars code ---*/

  goto __pyx_L0;
  __pyx_L1_error:;
  __Pyx_XDECREF(__pyx_t_1);
  if (__pyx_m) {
    if (__pyx_d) {
      __Pyx_AddTraceback("init raysect.core.acceleration.accelerator", __pyx_clineno, __pyx_lineno, __pyx_filename);
    }
    Py_DECREF(__pyx_m); __pyx_m = 0;
  } else if (!PyErr_Occurred()) {
    PyErr_SetString(PyExc_ImportError, "init raysect.core.acceleration.accelerator");
  }
  __pyx_L0:;
  __Pyx_RefNannyFinishContext();
  #if PY_MAJOR_VERSION < 3
  return;
  #else
  return __pyx_m;
  #endif
}

/* --- Runtime support code --- */
#if CYTHON_REFNANNY
static __Pyx_RefNannyAPIStruct *__Pyx_RefNannyImportAPI(const char *modname) {
    PyObject *m = NULL, *p = NULL;
    void *r = NULL;
    m = PyImport_ImportModule((char *)modname);
    if (!m) goto end;
    p = PyObject_GetAttrString(m, (char *)"RefNannyAPI");
    if (!p) goto end;
    r = PyLong_AsVoidPtr(p);
end:
    Py_XDECREF(p);
    Py_XDECREF(m);
    return (__Pyx_RefNannyAPIStruct *)r;
}
#endif

static PyObject *__Pyx_GetBuiltinName(PyObject *name) {
    PyObject* result = __Pyx_PyObject_GetAttrStr(__pyx_b, name);
    if (unlikely(!result)) {
        PyErr_Format(PyExc_NameError,
#if PY_MAJOR_VERSION >= 3
            "name '%U' is not defined", name);
#else
            "name '%.200s' is not defined", PyString_AS_STRING(name));
#endif
    }
    return result;
}

#if CYTHON_COMPILING_IN_CPYTHON
static CYTHON_INLINE PyObject* __Pyx_PyObject_Call(PyObject *func, PyObject *arg, PyObject *kw) {
    PyObject *result;
    ternaryfunc call = func->ob_type->tp_call;
    if (unlikely(!call))
        return PyObject_Call(func, arg, kw);
    if (unlikely(Py_EnterRecursiveCall((char*)" while calling a Python object")))
        return NULL;
    result = (*call)(func, arg, kw);
    Py_LeaveRecursiveCall();
    if (unlikely(!result) && unlikely(!PyErr_Occurred())) {
        PyErr_SetString(
            PyExc_SystemError,
            "NULL result without error in PyObject_Call");
    }
    return result;
}
#endif

#if CYTHON_COMPILING_IN_CPYTHON
static CYTHON_INLINE PyObject* __Pyx_PyObject_CallMethO(PyObject *func, PyObject *arg) {
    PyObject *self, *result;
    PyCFunction cfunc;
    cfunc = PyCFunction_GET_FUNCTION(func);
    self = PyCFunction_GET_SELF(func);
    if (unlikely(Py_EnterRecursiveCall((char*)" while calling a Python object")))
        return NULL;
    result = cfunc(self, arg);
    Py_LeaveRecursiveCall();
    if (unlikely(!result) && unlikely(!PyErr_Occurred())) {
        PyErr_SetString(
            PyExc_SystemError,
            "NULL result without error in PyObject_Call");
    }
    return result;
}
#endif

#if CYTHON_COMPILING_IN_CPYTHON
static PyObject* __Pyx__PyObject_CallOneArg(PyObject *func, PyObject *arg) {
    PyObject *result;
    PyObject *args = PyTuple_New(1);
    if (unlikely(!args)) return NULL;
    Py_INCREF(arg);
    PyTuple_SET_ITEM(args, 0, arg);
    result = __Pyx_PyObject_Call(func, args, NULL);
    Py_DECREF(args);
    return result;
}
static CYTHON_INLINE PyObject* __Pyx_PyObject_CallOneArg(PyObject *func, PyObject *arg) {
#ifdef __Pyx_CyFunction_USED
    if (likely(PyCFunction_Check(func) || PyObject_TypeCheck(func, __pyx_CyFunctionType))) {
#else
    if (likely(PyCFunction_Check(func))) {
#endif
        if (likely(PyCFunction_GET_FLAGS(func) & METH_O)) {
            return __Pyx_PyObject_CallMethO(func, arg);
        }
    }
    return __Pyx__PyObject_CallOneArg(func, arg);
}
#else
static CYTHON_INLINE PyObject* __Pyx_PyObject_CallOneArg(PyObject *func, PyObject *arg) {
    PyObject *result;
    PyObject *args = PyTuple_Pack(1, arg);
    if (unlikely(!args)) return NULL;
    result = __Pyx_PyObject_Call(func, args, NULL);
    Py_DECREF(args);
    return result;
}
#endif

static void __Pyx_RaiseArgumentTypeInvalid(const char* name, PyObject *obj, PyTypeObject *type) {
    PyErr_Format(PyExc_TypeError,
        "Argument '%.200s' has incorrect type (expected %.200s, got %.200s)",
        name, type->tp_name, Py_TYPE(obj)->tp_name);
}
static CYTHON_INLINE int __Pyx_ArgTypeTest(PyObject *obj, PyTypeObject *type, int none_allowed,
    const char *name, int exact)
{
    if (unlikely(!type)) {
        PyErr_SetString(PyExc_SystemError, "Missing type object");
        return 0;
    }
    if (none_allowed && obj == Py_None) return 1;
    else if (exact) {
        if (likely(Py_TYPE(obj) == type)) return 1;
        #if PY_MAJOR_VERSION == 2
        else if ((type == &PyBaseString_Type) && likely(__Pyx_PyBaseString_CheckExact(obj))) return 1;
        #endif
    }
    else {
        if (likely(PyObject_TypeCheck(obj, type))) return 1;
    }
    __Pyx_RaiseArgumentTypeInvalid(name, obj, type);
    return 0;
}

static CYTHON_INLINE int __Pyx_TypeTest(PyObject *obj, PyTypeObject *type) {
    if (unlikely(!type)) {
        PyErr_SetString(PyExc_SystemError, "Missing type object");
        return 0;
    }
    if (likely(PyObject_TypeCheck(obj, type)))
        return 1;
    PyErr_Format(PyExc_TypeError, "Cannot convert %.200s to %.200s",
                 Py_TYPE(obj)->tp_name, type->tp_name);
    return 0;
}

static CYTHON_INLINE void __Pyx_ErrRestore(PyObject *type, PyObject *value, PyObject *tb) {
#if CYTHON_COMPILING_IN_CPYTHON
    PyObject *tmp_type, *tmp_value, *tmp_tb;
    PyThreadState *tstate = PyThreadState_GET();
    tmp_type = tstate->curexc_type;
    tmp_value = tstate->curexc_value;
    tmp_tb = tstate->curexc_traceback;
    tstate->curexc_type = type;
    tstate->curexc_value = value;
    tstate->curexc_traceback = tb;
    Py_XDECREF(tmp_type);
    Py_XDECREF(tmp_value);
    Py_XDECREF(tmp_tb);
#else
    PyErr_Restore(type, value, tb);
#endif
}
static CYTHON_INLINE void __Pyx_ErrFetch(PyObject **type, PyObject **value, PyObject **tb) {
#if CYTHON_COMPILING_IN_CPYTHON
    PyThreadState *tstate = PyThreadState_GET();
    *type = tstate->curexc_type;
    *value = tstate->curexc_value;
    *tb = tstate->curexc_traceback;
    tstate->curexc_type = 0;
    tstate->curexc_value = 0;
    tstate->curexc_traceback = 0;
#else
    PyErr_Fetch(type, value, tb);
#endif
}

#if PY_MAJOR_VERSION < 3
static void __Pyx_Raise(PyObject *type, PyObject *value, PyObject *tb,
                        CYTHON_UNUSED PyObject *cause) {
    Py_XINCREF(type);
    if (!value || value == Py_None)
        value = NULL;
    else
        Py_INCREF(value);
    if (!tb || tb == Py_None)
        tb = NULL;
    else {
        Py_INCREF(tb);
        if (!PyTraceBack_Check(tb)) {
            PyErr_SetString(PyExc_TypeError,
                "raise: arg 3 must be a traceback or None");
            goto raise_error;
        }
    }
    if (PyType_Check(type)) {
#if CYTHON_COMPILING_IN_PYPY
        if (!value) {
            Py_INCREF(Py_None);
            value = Py_None;
        }
#endif
        PyErr_NormalizeException(&type, &value, &tb);
    } else {
        if (value) {
            PyErr_SetString(PyExc_TypeError,
                "instance exception may not have a separate value");
            goto raise_error;
        }
        value = type;
        type = (PyObject*) Py_TYPE(type);
        Py_INCREF(type);
        if (!PyType_IsSubtype((PyTypeObject *)type, (PyTypeObject *)PyExc_BaseException)) {
            PyErr_SetString(PyExc_TypeError,
                "raise: exception class must be a subclass of BaseException");
            goto raise_error;
        }
    }
    __Pyx_ErrRestore(type, value, tb);
    return;
raise_error:
    Py_XDECREF(value);
    Py_XDECREF(type);
    Py_XDECREF(tb);
    return;
}
#else
static void __Pyx_Raise(PyObject *type, PyObject *value, PyObject *tb, PyObject *cause) {
    PyObject* owned_instance = NULL;
    if (tb == Py_None) {
        tb = 0;
    } else if (tb && !PyTraceBack_Check(tb)) {
        PyErr_SetString(PyExc_TypeError,
            "raise: arg 3 must be a traceback or None");
        goto bad;
    }
    if (value == Py_None)
        value = 0;
    if (PyExceptionInstance_Check(type)) {
        if (value) {
            PyErr_SetString(PyExc_TypeError,
                "instance exception may not have a separate value");
            goto bad;
        }
        value = type;
        type = (PyObject*) Py_TYPE(value);
    } else if (PyExceptionClass_Check(type)) {
        PyObject *instance_class = NULL;
        if (value && PyExceptionInstance_Check(value)) {
            instance_class = (PyObject*) Py_TYPE(value);
            if (instance_class != type) {
                int is_subclass = PyObject_IsSubclass(instance_class, type);
                if (!is_subclass) {
                    instance_class = NULL;
                } else if (unlikely(is_subclass == -1)) {
                    goto bad;
                } else {
                    type = instance_class;
                }
            }
        }
        if (!instance_class) {
            PyObject *args;
            if (!value)
                args = PyTuple_New(0);
            else if (PyTuple_Check(value)) {
                Py_INCREF(value);
                args = value;
            } else
                args = PyTuple_Pack(1, value);
            if (!args)
                goto bad;
            owned_instance = PyObject_Call(type, args, NULL);
            Py_DECREF(args);
            if (!owned_instance)
                goto bad;
            value = owned_instance;
            if (!PyExceptionInstance_Check(value)) {
                PyErr_Format(PyExc_TypeError,
                             "calling %R should have returned an instance of "
                             "BaseException, not %R",
                             type, Py_TYPE(value));
                goto bad;
            }
        }
    } else {
        PyErr_SetString(PyExc_TypeError,
            "raise: exception class must be a subclass of BaseException");
        goto bad;
    }
#if PY_VERSION_HEX >= 0x03030000
    if (cause) {
#else
    if (cause && cause != Py_None) {
#endif
        PyObject *fixed_cause;
        if (cause == Py_None) {
            fixed_cause = NULL;
        } else if (PyExceptionClass_Check(cause)) {
            fixed_cause = PyObject_CallObject(cause, NULL);
            if (fixed_cause == NULL)
                goto bad;
        } else if (PyExceptionInstance_Check(cause)) {
            fixed_cause = cause;
            Py_INCREF(fixed_cause);
        } else {
            PyErr_SetString(PyExc_TypeError,
                            "exception causes must derive from "
                            "BaseException");
            goto bad;
        }
        PyException_SetCause(value, fixed_cause);
    }
    PyErr_SetObject(type, value);
    if (tb) {
#if CYTHON_COMPILING_IN_PYPY
        PyObject *tmp_type, *tmp_value, *tmp_tb;
        PyErr_Fetch(&tmp_type, &tmp_value, &tmp_tb);
        Py_INCREF(tb);
        PyErr_Restore(tmp_type, tmp_value, tb);
        Py_XDECREF(tmp_tb);
#else
        PyThreadState *tstate = PyThreadState_GET();
        PyObject* tmp_tb = tstate->curexc_traceback;
        if (tb != tmp_tb) {
            Py_INCREF(tb);
            tstate->curexc_traceback = tb;
            Py_XDECREF(tmp_tb);
        }
#endif
    }
bad:
    Py_XDECREF(owned_instance);
    return;
}
#endif

static int __Pyx_SetVtable(PyObject *dict, void *vtable) {
#if PY_VERSION_HEX >= 0x02070000
    PyObject *ob = PyCapsule_New(vtable, 0, 0);
#else
    PyObject *ob = PyCObject_FromVoidPtr(vtable, 0);
#endif
    if (!ob)
        goto bad;
    if (PyDict_SetItem(dict, __pyx_n_s_pyx_vtable, ob) < 0)
        goto bad;
    Py_DECREF(ob);
    return 0;
bad:
    Py_XDECREF(ob);
    return -1;
}

static void* __Pyx_GetVtable(PyObject *dict) {
    void* ptr;
    PyObject *ob = PyObject_GetItem(dict, __pyx_n_s_pyx_vtable);
    if (!ob)
        goto bad;
#if PY_VERSION_HEX >= 0x02070000
    ptr = PyCapsule_GetPointer(ob, 0);
#else
    ptr = PyCObject_AsVoidPtr(ob);
#endif
    if (!ptr && !PyErr_Occurred())
        PyErr_SetString(PyExc_RuntimeError, "invalid vtable found for imported type");
    Py_DECREF(ob);
    return ptr;
bad:
    Py_XDECREF(ob);
    return NULL;
}

static int __pyx_bisect_code_objects(__Pyx_CodeObjectCacheEntry* entries, int count, int code_line) {
    int start = 0, mid = 0, end = count - 1;
    if (end >= 0 && code_line > entries[end].code_line) {
        return count;
    }
    while (start < end) {
        mid = start + (end - start) / 2;
        if (code_line < entries[mid].code_line) {
            end = mid;
        } else if (code_line > entries[mid].code_line) {
             start = mid + 1;
        } else {
            return mid;
        }
    }
    if (code_line <= entries[mid].code_line) {
        return mid;
    } else {
        return mid + 1;
    }
}
static PyCodeObject *__pyx_find_code_object(int code_line) {
    PyCodeObject* code_object;
    int pos;
    if (unlikely(!code_line) || unlikely(!__pyx_code_cache.entries)) {
        return NULL;
    }
    pos = __pyx_bisect_code_objects(__pyx_code_cache.entries, __pyx_code_cache.count, code_line);
    if (unlikely(pos >= __pyx_code_cache.count) || unlikely(__pyx_code_cache.entries[pos].code_line != code_line)) {
        return NULL;
    }
    code_object = __pyx_code_cache.entries[pos].code_object;
    Py_INCREF(code_object);
    return code_object;
}
static void __pyx_insert_code_object(int code_line, PyCodeObject* code_object) {
    int pos, i;
    __Pyx_CodeObjectCacheEntry* entries = __pyx_code_cache.entries;
    if (unlikely(!code_line)) {
        return;
    }
    if (unlikely(!entries)) {
        entries = (__Pyx_CodeObjectCacheEntry*)PyMem_Malloc(64*sizeof(__Pyx_CodeObjectCacheEntry));
        if (likely(entries)) {
            __pyx_code_cache.entries = entries;
            __pyx_code_cache.max_count = 64;
            __pyx_code_cache.count = 1;
            entries[0].code_line = code_line;
            entries[0].code_object = code_object;
            Py_INCREF(code_object);
        }
        return;
    }
    pos = __pyx_bisect_code_objects(__pyx_code_cache.entries, __pyx_code_cache.count, code_line);
    if ((pos < __pyx_code_cache.count) && unlikely(__pyx_code_cache.entries[pos].code_line == code_line)) {
        PyCodeObject* tmp = entries[pos].code_object;
        entries[pos].code_object = code_object;
        Py_DECREF(tmp);
        return;
    }
    if (__pyx_code_cache.count == __pyx_code_cache.max_count) {
        int new_max = __pyx_code_cache.max_count + 64;
        entries = (__Pyx_CodeObjectCacheEntry*)PyMem_Realloc(
            __pyx_code_cache.entries, (size_t)new_max*sizeof(__Pyx_CodeObjectCacheEntry));
        if (unlikely(!entries)) {
            return;
        }
        __pyx_code_cache.entries = entries;
        __pyx_code_cache.max_count = new_max;
    }
    for (i=__pyx_code_cache.count; i>pos; i--) {
        entries[i] = entries[i-1];
    }
    entries[pos].code_line = code_line;
    entries[pos].code_object = code_object;
    __pyx_code_cache.count++;
    Py_INCREF(code_object);
}

#include "compile.h"
#include "frameobject.h"
#include "traceback.h"
static PyCodeObject* __Pyx_CreateCodeObjectForTraceback(
            const char *funcname, int c_line,
            int py_line, const char *filename) {
    PyCodeObject *py_code = 0;
    PyObject *py_srcfile = 0;
    PyObject *py_funcname = 0;
    #if PY_MAJOR_VERSION < 3
    py_srcfile = PyString_FromString(filename);
    #else
    py_srcfile = PyUnicode_FromString(filename);
    #endif
    if (!py_srcfile) goto bad;
    if (c_line) {
        #if PY_MAJOR_VERSION < 3
        py_funcname = PyString_FromFormat( "%s (%s:%d)", funcname, __pyx_cfilenm, c_line);
        #else
        py_funcname = PyUnicode_FromFormat( "%s (%s:%d)", funcname, __pyx_cfilenm, c_line);
        #endif
    }
    else {
        #if PY_MAJOR_VERSION < 3
        py_funcname = PyString_FromString(funcname);
        #else
        py_funcname = PyUnicode_FromString(funcname);
        #endif
    }
    if (!py_funcname) goto bad;
    py_code = __Pyx_PyCode_New(
        0,
        0,
        0,
        0,
        0,
        __pyx_empty_bytes, /*PyObject *code,*/
        __pyx_empty_tuple, /*PyObject *consts,*/
        __pyx_empty_tuple, /*PyObject *names,*/
        __pyx_empty_tuple, /*PyObject *varnames,*/
        __pyx_empty_tuple, /*PyObject *freevars,*/
        __pyx_empty_tuple, /*PyObject *cellvars,*/
        py_srcfile,   /*PyObject *filename,*/
        py_funcname,  /*PyObject *name,*/
        py_line,
        __pyx_empty_bytes  /*PyObject *lnotab*/
    );
    Py_DECREF(py_srcfile);
    Py_DECREF(py_funcname);
    return py_code;
bad:
    Py_XDECREF(py_srcfile);
    Py_XDECREF(py_funcname);
    return NULL;
}
static void __Pyx_AddTraceback(const char *funcname, int c_line,
                               int py_line, const char *filename) {
    PyCodeObject *py_code = 0;
    PyFrameObject *py_frame = 0;
    py_code = __pyx_find_code_object(c_line ? c_line : py_line);
    if (!py_code) {
        py_code = __Pyx_CreateCodeObjectForTraceback(
            funcname, c_line, py_line, filename);
        if (!py_code) goto bad;
        __pyx_insert_code_object(c_line ? c_line : py_line, py_code);
    }
    py_frame = PyFrame_New(
        PyThreadState_GET(), /*PyThreadState *tstate,*/
        py_code,             /*PyCodeObject *code,*/
        __pyx_d,      /*PyObject *globals,*/
        0                    /*PyObject *locals*/
    );
    if (!py_frame) goto bad;
    py_frame->f_lineno = py_line;
    PyTraceBack_Here(py_frame);
bad:
    Py_XDECREF(py_code);
    Py_XDECREF(py_frame);
}

static CYTHON_INLINE PyObject* __Pyx_PyInt_From_long(long value) {
    const long neg_one = (long) -1, const_zero = (long) 0;
    const int is_unsigned = neg_one > const_zero;
    if (is_unsigned) {
        if (sizeof(long) < sizeof(long)) {
            return PyInt_FromLong((long) value);
        } else if (sizeof(long) <= sizeof(unsigned long)) {
            return PyLong_FromUnsignedLong((unsigned long) value);
        } else if (sizeof(long) <= sizeof(unsigned PY_LONG_LONG)) {
            return PyLong_FromUnsignedLongLong((unsigned PY_LONG_LONG) value);
        }
    } else {
        if (sizeof(long) <= sizeof(long)) {
            return PyInt_FromLong((long) value);
        } else if (sizeof(long) <= sizeof(PY_LONG_LONG)) {
            return PyLong_FromLongLong((PY_LONG_LONG) value);
        }
    }
    {
        int one = 1; int little = (int)*(unsigned char *)&one;
        unsigned char *bytes = (unsigned char *)&value;
        return _PyLong_FromByteArray(bytes, sizeof(long),
                                     little, !is_unsigned);
    }
}

#define __PYX_VERIFY_RETURN_INT(target_type, func_type, func_value)\
    __PYX__VERIFY_RETURN_INT(target_type, func_type, func_value, 0)
#define __PYX_VERIFY_RETURN_INT_EXC(target_type, func_type, func_value)\
    __PYX__VERIFY_RETURN_INT(target_type, func_type, func_value, 1)
#define __PYX__VERIFY_RETURN_INT(target_type, func_type, func_value, exc)\
    {\
        func_type value = func_value;\
        if (sizeof(target_type) < sizeof(func_type)) {\
            if (unlikely(value != (func_type) (target_type) value)) {\
                func_type zero = 0;\
                if (exc && unlikely(value == (func_type)-1 && PyErr_Occurred()))\
                    return (target_type) -1;\
                if (is_unsigned && unlikely(value < zero))\
                    goto raise_neg_overflow;\
                else\
                    goto raise_overflow;\
            }\
        }\
        return (target_type) value;\
    }

#if CYTHON_USE_PYLONG_INTERNALS
  #include "longintrepr.h"
#endif

static CYTHON_INLINE long __Pyx_PyInt_As_long(PyObject *x) {
    const long neg_one = (long) -1, const_zero = (long) 0;
    const int is_unsigned = neg_one > const_zero;
#if PY_MAJOR_VERSION < 3
    if (likely(PyInt_Check(x))) {
        if (sizeof(long) < sizeof(long)) {
            __PYX_VERIFY_RETURN_INT(long, long, PyInt_AS_LONG(x))
        } else {
            long val = PyInt_AS_LONG(x);
            if (is_unsigned && unlikely(val < 0)) {
                goto raise_neg_overflow;
            }
            return (long) val;
        }
    } else
#endif
    if (likely(PyLong_Check(x))) {
        if (is_unsigned) {
#if CYTHON_USE_PYLONG_INTERNALS
            const digit* digits = ((PyLongObject*)x)->ob_digit;
            switch (Py_SIZE(x)) {
                case  0: return (long) 0;
                case  1: __PYX_VERIFY_RETURN_INT(long, digit, digits[0])
                case 2:
                    if (8 * sizeof(long) > 1 * PyLong_SHIFT) {
                        if (8 * sizeof(unsigned long) > 2 * PyLong_SHIFT) {
                            __PYX_VERIFY_RETURN_INT(long, unsigned long, (((((unsigned long)digits[1]) << PyLong_SHIFT) | (unsigned long)digits[0])))
                        } else if (8 * sizeof(long) >= 2 * PyLong_SHIFT) {
                            return (long) (((((long)digits[1]) << PyLong_SHIFT) | (long)digits[0]));
                        }
                    }
                    break;
                case 3:
                    if (8 * sizeof(long) > 2 * PyLong_SHIFT) {
                        if (8 * sizeof(unsigned long) > 3 * PyLong_SHIFT) {
                            __PYX_VERIFY_RETURN_INT(long, unsigned long, (((((((unsigned long)digits[2]) << PyLong_SHIFT) | (unsigned long)digits[1]) << PyLong_SHIFT) | (unsigned long)digits[0])))
                        } else if (8 * sizeof(long) >= 3 * PyLong_SHIFT) {
                            return (long) (((((((long)digits[2]) << PyLong_SHIFT) | (long)digits[1]) << PyLong_SHIFT) | (long)digits[0]));
                        }
                    }
                    break;
                case 4:
                    if (8 * sizeof(long) > 3 * PyLong_SHIFT) {
                        if (8 * sizeof(unsigned long) > 4 * PyLong_SHIFT) {
                            __PYX_VERIFY_RETURN_INT(long, unsigned long, (((((((((unsigned long)digits[3]) << PyLong_SHIFT) | (unsigned long)digits[2]) << PyLong_SHIFT) | (unsigned long)digits[1]) << PyLong_SHIFT) | (unsigned long)digits[0])))
                        } else if (8 * sizeof(long) >= 4 * PyLong_SHIFT) {
                            return (long) (((((((((long)digits[3]) << PyLong_SHIFT) | (long)digits[2]) << PyLong_SHIFT) | (long)digits[1]) << PyLong_SHIFT) | (long)digits[0]));
                        }
                    }
                    break;
            }
#endif
#if CYTHON_COMPILING_IN_CPYTHON
            if (unlikely(Py_SIZE(x) < 0)) {
                goto raise_neg_overflow;
            }
#else
            {
                int result = PyObject_RichCompareBool(x, Py_False, Py_LT);
                if (unlikely(result < 0))
                    return (long) -1;
                if (unlikely(result == 1))
                    goto raise_neg_overflow;
            }
#endif
            if (sizeof(long) <= sizeof(unsigned long)) {
                __PYX_VERIFY_RETURN_INT_EXC(long, unsigned long, PyLong_AsUnsignedLong(x))
            } else if (sizeof(long) <= sizeof(unsigned PY_LONG_LONG)) {
                __PYX_VERIFY_RETURN_INT_EXC(long, unsigned PY_LONG_LONG, PyLong_AsUnsignedLongLong(x))
            }
        } else {
#if CYTHON_USE_PYLONG_INTERNALS
            const digit* digits = ((PyLongObject*)x)->ob_digit;
            switch (Py_SIZE(x)) {
                case  0: return (long) 0;
                case -1: __PYX_VERIFY_RETURN_INT(long, sdigit, -(sdigit) digits[0])
                case  1: __PYX_VERIFY_RETURN_INT(long,  digit, +digits[0])
                case -2:
                    if (8 * sizeof(long) - 1 > 1 * PyLong_SHIFT) {
                        if (8 * sizeof(unsigned long) > 2 * PyLong_SHIFT) {
                            __PYX_VERIFY_RETURN_INT(long, long, -(long) (((((unsigned long)digits[1]) << PyLong_SHIFT) | (unsigned long)digits[0])))
                        } else if (8 * sizeof(long) - 1 > 2 * PyLong_SHIFT) {
                            return (long) (((long)-1)*(((((long)digits[1]) << PyLong_SHIFT) | (long)digits[0])));
                        }
                    }
                    break;
                case 2:
                    if (8 * sizeof(long) > 1 * PyLong_SHIFT) {
                        if (8 * sizeof(unsigned long) > 2 * PyLong_SHIFT) {
                            __PYX_VERIFY_RETURN_INT(long, unsigned long, (((((unsigned long)digits[1]) << PyLong_SHIFT) | (unsigned long)digits[0])))
                        } else if (8 * sizeof(long) - 1 > 2 * PyLong_SHIFT) {
                            return (long) ((((((long)digits[1]) << PyLong_SHIFT) | (long)digits[0])));
                        }
                    }
                    break;
                case -3:
                    if (8 * sizeof(long) - 1 > 2 * PyLong_SHIFT) {
                        if (8 * sizeof(unsigned long) > 3 * PyLong_SHIFT) {
                            __PYX_VERIFY_RETURN_INT(long, long, -(long) (((((((unsigned long)digits[2]) << PyLong_SHIFT) | (unsigned long)digits[1]) << PyLong_SHIFT) | (unsigned long)digits[0])))
                        } else if (8 * sizeof(long) - 1 > 3 * PyLong_SHIFT) {
                            return (long) (((long)-1)*(((((((long)digits[2]) << PyLong_SHIFT) | (long)digits[1]) << PyLong_SHIFT) | (long)digits[0])));
                        }
                    }
                    break;
                case 3:
                    if (8 * sizeof(long) > 2 * PyLong_SHIFT) {
                        if (8 * sizeof(unsigned long) > 3 * PyLong_SHIFT) {
                            __PYX_VERIFY_RETURN_INT(long, unsigned long, (((((((unsigned long)digits[2]) << PyLong_SHIFT) | (unsigned long)digits[1]) << PyLong_SHIFT) | (unsigned long)digits[0])))
                        } else if (8 * sizeof(long) - 1 > 3 * PyLong_SHIFT) {
                            return (long) ((((((((long)digits[2]) << PyLong_SHIFT) | (long)digits[1]) << PyLong_SHIFT) | (long)digits[0])));
                        }
                    }
                    break;
                case -4:
                    if (8 * sizeof(long) - 1 > 3 * PyLong_SHIFT) {
                        if (8 * sizeof(unsigned long) > 4 * PyLong_SHIFT) {
                            __PYX_VERIFY_RETURN_INT(long, long, -(long) (((((((((unsigned long)digits[3]) << PyLong_SHIFT) | (unsigned long)digits[2]) << PyLong_SHIFT) | (unsigned long)digits[1]) << PyLong_SHIFT) | (unsigned long)digits[0])))
                        } else if (8 * sizeof(long) - 1 > 4 * PyLong_SHIFT) {
                            return (long) (((long)-1)*(((((((((long)digits[3]) << PyLong_SHIFT) | (long)digits[2]) << PyLong_SHIFT) | (long)digits[1]) << PyLong_SHIFT) | (long)digits[0])));
                        }
                    }
                    break;
                case 4:
                    if (8 * sizeof(long) > 3 * PyLong_SHIFT) {
                        if (8 * sizeof(unsigned long) > 4 * PyLong_SHIFT) {
                            __PYX_VERIFY_RETURN_INT(long, unsigned long, (((((((((unsigned long)digits[3]) << PyLong_SHIFT) | (unsigned long)digits[2]) << PyLong_SHIFT) | (unsigned long)digits[1]) << PyLong_SHIFT) | (unsigned long)digits[0])))
                        } else if (8 * sizeof(long) - 1 > 4 * PyLong_SHIFT) {
                            return (long) ((((((((((long)digits[3]) << PyLong_SHIFT) | (long)digits[2]) << PyLong_SHIFT) | (long)digits[1]) << PyLong_SHIFT) | (long)digits[0])));
                        }
                    }
                    break;
            }
#endif
            if (sizeof(long) <= sizeof(long)) {
                __PYX_VERIFY_RETURN_INT_EXC(long, long, PyLong_AsLong(x))
            } else if (sizeof(long) <= sizeof(PY_LONG_LONG)) {
                __PYX_VERIFY_RETURN_INT_EXC(long, PY_LONG_LONG, PyLong_AsLongLong(x))
            }
        }
        {
#if CYTHON_COMPILING_IN_PYPY && !defined(_PyLong_AsByteArray)
            PyErr_SetString(PyExc_RuntimeError,
                            "_PyLong_AsByteArray() not available in PyPy, cannot convert large numbers");
#else
            long val;
            PyObject *v = __Pyx_PyNumber_Int(x);
 #if PY_MAJOR_VERSION < 3
            if (likely(v) && !PyLong_Check(v)) {
                PyObject *tmp = v;
                v = PyNumber_Long(tmp);
                Py_DECREF(tmp);
            }
 #endif
            if (likely(v)) {
                int one = 1; int is_little = (int)*(unsigned char *)&one;
                unsigned char *bytes = (unsigned char *)&val;
                int ret = _PyLong_AsByteArray((PyLongObject *)v,
                                              bytes, sizeof(val),
                                              is_little, !is_unsigned);
                Py_DECREF(v);
                if (likely(!ret))
                    return val;
            }
#endif
            return (long) -1;
        }
    } else {
        long val;
        PyObject *tmp = __Pyx_PyNumber_Int(x);
        if (!tmp) return (long) -1;
        val = __Pyx_PyInt_As_long(tmp);
        Py_DECREF(tmp);
        return val;
    }
raise_overflow:
    PyErr_SetString(PyExc_OverflowError,
        "value too large to convert to long");
    return (long) -1;
raise_neg_overflow:
    PyErr_SetString(PyExc_OverflowError,
        "can't convert negative value to long");
    return (long) -1;
}

static CYTHON_INLINE int __Pyx_PyInt_As_int(PyObject *x) {
    const int neg_one = (int) -1, const_zero = (int) 0;
    const int is_unsigned = neg_one > const_zero;
#if PY_MAJOR_VERSION < 3
    if (likely(PyInt_Check(x))) {
        if (sizeof(int) < sizeof(long)) {
            __PYX_VERIFY_RETURN_INT(int, long, PyInt_AS_LONG(x))
        } else {
            long val = PyInt_AS_LONG(x);
            if (is_unsigned && unlikely(val < 0)) {
                goto raise_neg_overflow;
            }
            return (int) val;
        }
    } else
#endif
    if (likely(PyLong_Check(x))) {
        if (is_unsigned) {
#if CYTHON_USE_PYLONG_INTERNALS
            const digit* digits = ((PyLongObject*)x)->ob_digit;
            switch (Py_SIZE(x)) {
                case  0: return (int) 0;
                case  1: __PYX_VERIFY_RETURN_INT(int, digit, digits[0])
                case 2:
                    if (8 * sizeof(int) > 1 * PyLong_SHIFT) {
                        if (8 * sizeof(unsigned long) > 2 * PyLong_SHIFT) {
                            __PYX_VERIFY_RETURN_INT(int, unsigned long, (((((unsigned long)digits[1]) << PyLong_SHIFT) | (unsigned long)digits[0])))
                        } else if (8 * sizeof(int) >= 2 * PyLong_SHIFT) {
                            return (int) (((((int)digits[1]) << PyLong_SHIFT) | (int)digits[0]));
                        }
                    }
                    break;
                case 3:
                    if (8 * sizeof(int) > 2 * PyLong_SHIFT) {
                        if (8 * sizeof(unsigned long) > 3 * PyLong_SHIFT) {
                            __PYX_VERIFY_RETURN_INT(int, unsigned long, (((((((unsigned long)digits[2]) << PyLong_SHIFT) | (unsigned long)digits[1]) << PyLong_SHIFT) | (unsigned long)digits[0])))
                        } else if (8 * sizeof(int) >= 3 * PyLong_SHIFT) {
                            return (int) (((((((int)digits[2]) << PyLong_SHIFT) | (int)digits[1]) << PyLong_SHIFT) | (int)digits[0]));
                        }
                    }
                    break;
                case 4:
                    if (8 * sizeof(int) > 3 * PyLong_SHIFT) {
                        if (8 * sizeof(unsigned long) > 4 * PyLong_SHIFT) {
                            __PYX_VERIFY_RETURN_INT(int, unsigned long, (((((((((unsigned long)digits[3]) << PyLong_SHIFT) | (unsigned long)digits[2]) << PyLong_SHIFT) | (unsigned long)digits[1]) << PyLong_SHIFT) | (unsigned long)digits[0])))
                        } else if (8 * sizeof(int) >= 4 * PyLong_SHIFT) {
                            return (int) (((((((((int)digits[3]) << PyLong_SHIFT) | (int)digits[2]) << PyLong_SHIFT) | (int)digits[1]) << PyLong_SHIFT) | (int)digits[0]));
                        }
                    }
                    break;
            }
#endif
#if CYTHON_COMPILING_IN_CPYTHON
            if (unlikely(Py_SIZE(x) < 0)) {
                goto raise_neg_overflow;
            }
#else
            {
                int result = PyObject_RichCompareBool(x, Py_False, Py_LT);
                if (unlikely(result < 0))
                    return (int) -1;
                if (unlikely(result == 1))
                    goto raise_neg_overflow;
            }
#endif
            if (sizeof(int) <= sizeof(unsigned long)) {
                __PYX_VERIFY_RETURN_INT_EXC(int, unsigned long, PyLong_AsUnsignedLong(x))
            } else if (sizeof(int) <= sizeof(unsigned PY_LONG_LONG)) {
                __PYX_VERIFY_RETURN_INT_EXC(int, unsigned PY_LONG_LONG, PyLong_AsUnsignedLongLong(x))
            }
        } else {
#if CYTHON_USE_PYLONG_INTERNALS
            const digit* digits = ((PyLongObject*)x)->ob_digit;
            switch (Py_SIZE(x)) {
                case  0: return (int) 0;
                case -1: __PYX_VERIFY_RETURN_INT(int, sdigit, -(sdigit) digits[0])
                case  1: __PYX_VERIFY_RETURN_INT(int,  digit, +digits[0])
                case -2:
                    if (8 * sizeof(int) - 1 > 1 * PyLong_SHIFT) {
                        if (8 * sizeof(unsigned long) > 2 * PyLong_SHIFT) {
                            __PYX_VERIFY_RETURN_INT(int, long, -(long) (((((unsigned long)digits[1]) << PyLong_SHIFT) | (unsigned long)digits[0])))
                        } else if (8 * sizeof(int) - 1 > 2 * PyLong_SHIFT) {
                            return (int) (((int)-1)*(((((int)digits[1]) << PyLong_SHIFT) | (int)digits[0])));
                        }
                    }
                    break;
                case 2:
                    if (8 * sizeof(int) > 1 * PyLong_SHIFT) {
                        if (8 * sizeof(unsigned long) > 2 * PyLong_SHIFT) {
                            __PYX_VERIFY_RETURN_INT(int, unsigned long, (((((unsigned long)digits[1]) << PyLong_SHIFT) | (unsigned long)digits[0])))
                        } else if (8 * sizeof(int) - 1 > 2 * PyLong_SHIFT) {
                            return (int) ((((((int)digits[1]) << PyLong_SHIFT) | (int)digits[0])));
                        }
                    }
                    break;
                case -3:
                    if (8 * sizeof(int) - 1 > 2 * PyLong_SHIFT) {
                        if (8 * sizeof(unsigned long) > 3 * PyLong_SHIFT) {
                            __PYX_VERIFY_RETURN_INT(int, long, -(long) (((((((unsigned long)digits[2]) << PyLong_SHIFT) | (unsigned long)digits[1]) << PyLong_SHIFT) | (unsigned long)digits[0])))
                        } else if (8 * sizeof(int) - 1 > 3 * PyLong_SHIFT) {
                            return (int) (((int)-1)*(((((((int)digits[2]) << PyLong_SHIFT) | (int)digits[1]) << PyLong_SHIFT) | (int)digits[0])));
                        }
                    }
                    break;
                case 3:
                    if (8 * sizeof(int) > 2 * PyLong_SHIFT) {
                        if (8 * sizeof(unsigned long) > 3 * PyLong_SHIFT) {
                            __PYX_VERIFY_RETURN_INT(int, unsigned long, (((((((unsigned long)digits[2]) << PyLong_SHIFT) | (unsigned long)digits[1]) << PyLong_SHIFT) | (unsigned long)digits[0])))
                        } else if (8 * sizeof(int) - 1 > 3 * PyLong_SHIFT) {
                            return (int) ((((((((int)digits[2]) << PyLong_SHIFT) | (int)digits[1]) << PyLong_SHIFT) | (int)digits[0])));
                        }
                    }
                    break;
                case -4:
                    if (8 * sizeof(int) - 1 > 3 * PyLong_SHIFT) {
                        if (8 * sizeof(unsigned long) > 4 * PyLong_SHIFT) {
                            __PYX_VERIFY_RETURN_INT(int, long, -(long) (((((((((unsigned long)digits[3]) << PyLong_SHIFT) | (unsigned long)digits[2]) << PyLong_SHIFT) | (unsigned long)digits[1]) << PyLong_SHIFT) | (unsigned long)digits[0])))
                        } else if (8 * sizeof(int) - 1 > 4 * PyLong_SHIFT) {
                            return (int) (((int)-1)*(((((((((int)digits[3]) << PyLong_SHIFT) | (int)digits[2]) << PyLong_SHIFT) | (int)digits[1]) << PyLong_SHIFT) | (int)digits[0])));
                        }
                    }
                    break;
                case 4:
                    if (8 * sizeof(int) > 3 * PyLong_SHIFT) {
                        if (8 * sizeof(unsigned long) > 4 * PyLong_SHIFT) {
                            __PYX_VERIFY_RETURN_INT(int, unsigned long, (((((((((unsigned long)digits[3]) << PyLong_SHIFT) | (unsigned long)digits[2]) << PyLong_SHIFT) | (unsigned long)digits[1]) << PyLong_SHIFT) | (unsigned long)digits[0])))
                        } else if (8 * sizeof(int) - 1 > 4 * PyLong_SHIFT) {
                            return (int) ((((((((((int)digits[3]) << PyLong_SHIFT) | (int)digits[2]) << PyLong_SHIFT) | (int)digits[1]) << PyLong_SHIFT) | (int)digits[0])));
                        }
                    }
                    break;
            }
#endif
            if (sizeof(int) <= sizeof(long)) {
                __PYX_VERIFY_RETURN_INT_EXC(int, long, PyLong_AsLong(x))
            } else if (sizeof(int) <= sizeof(PY_LONG_LONG)) {
                __PYX_VERIFY_RETURN_INT_EXC(int, PY_LONG_LONG, PyLong_AsLongLong(x))
            }
        }
        {
#if CYTHON_COMPILING_IN_PYPY && !defined(_PyLong_AsByteArray)
            PyErr_SetString(PyExc_RuntimeError,
                            "_PyLong_AsByteArray() not available in PyPy, cannot convert large numbers");
#else
            int val;
            PyObject *v = __Pyx_PyNumber_Int(x);
 #if PY_MAJOR_VERSION < 3
            if (likely(v) && !PyLong_Check(v)) {
                PyObject *tmp = v;
                v = PyNumber_Long(tmp);
                Py_DECREF(tmp);
            }
 #endif
            if (likely(v)) {
                int one = 1; int is_little = (int)*(unsigned char *)&one;
                unsigned char *bytes = (unsigned char *)&val;
                int ret = _PyLong_AsByteArray((PyLongObject *)v,
                                              bytes, sizeof(val),
                                              is_little, !is_unsigned);
                Py_DECREF(v);
                if (likely(!ret))
                    return val;
            }
#endif
            return (int) -1;
        }
    } else {
        int val;
        PyObject *tmp = __Pyx_PyNumber_Int(x);
        if (!tmp) return (int) -1;
        val = __Pyx_PyInt_As_int(tmp);
        Py_DECREF(tmp);
        return val;
    }
raise_overflow:
    PyErr_SetString(PyExc_OverflowError,
        "value too large to convert to int");
    return (int) -1;
raise_neg_overflow:
    PyErr_SetString(PyExc_OverflowError,
        "can't convert negative value to int");
    return (int) -1;
}

static int __Pyx_check_binary_version(void) {
    char ctversion[4], rtversion[4];
    PyOS_snprintf(ctversion, 4, "%d.%d", PY_MAJOR_VERSION, PY_MINOR_VERSION);
    PyOS_snprintf(rtversion, 4, "%s", Py_GetVersion());
    if (ctversion[0] != rtversion[0] || ctversion[2] != rtversion[2]) {
        char message[200];
        PyOS_snprintf(message, sizeof(message),
                      "compiletime version %s of module '%.100s' "
                      "does not match runtime version %s",
                      ctversion, __Pyx_MODULE_NAME, rtversion);
        return PyErr_WarnEx(NULL, message, 1);
    }
    return 0;
}

#ifndef __PYX_HAVE_RT_ImportModule
#define __PYX_HAVE_RT_ImportModule
static PyObject *__Pyx_ImportModule(const char *name) {
    PyObject *py_name = 0;
    PyObject *py_module = 0;
    py_name = __Pyx_PyIdentifier_FromString(name);
    if (!py_name)
        goto bad;
    py_module = PyImport_Import(py_name);
    Py_DECREF(py_name);
    return py_module;
bad:
    Py_XDECREF(py_name);
    return 0;
}
#endif

#ifndef __PYX_HAVE_RT_ImportType
#define __PYX_HAVE_RT_ImportType
static PyTypeObject *__Pyx_ImportType(const char *module_name, const char *class_name,
    size_t size, int strict)
{
    PyObject *py_module = 0;
    PyObject *result = 0;
    PyObject *py_name = 0;
    char warning[200];
    Py_ssize_t basicsize;
#ifdef Py_LIMITED_API
    PyObject *py_basicsize;
#endif
    py_module = __Pyx_ImportModule(module_name);
    if (!py_module)
        goto bad;
    py_name = __Pyx_PyIdentifier_FromString(class_name);
    if (!py_name)
        goto bad;
    result = PyObject_GetAttr(py_module, py_name);
    Py_DECREF(py_name);
    py_name = 0;
    Py_DECREF(py_module);
    py_module = 0;
    if (!result)
        goto bad;
    if (!PyType_Check(result)) {
        PyErr_Format(PyExc_TypeError,
            "%.200s.%.200s is not a type object",
            module_name, class_name);
        goto bad;
    }
#ifndef Py_LIMITED_API
    basicsize = ((PyTypeObject *)result)->tp_basicsize;
#else
    py_basicsize = PyObject_GetAttrString(result, "__basicsize__");
    if (!py_basicsize)
        goto bad;
    basicsize = PyLong_AsSsize_t(py_basicsize);
    Py_DECREF(py_basicsize);
    py_basicsize = 0;
    if (basicsize == (Py_ssize_t)-1 && PyErr_Occurred())
        goto bad;
#endif
    if (!strict && (size_t)basicsize > size) {
        PyOS_snprintf(warning, sizeof(warning),
            "%s.%s size changed, may indicate binary incompatibility",
            module_name, class_name);
        if (PyErr_WarnEx(NULL, warning, 0) < 0) goto bad;
    }
    else if ((size_t)basicsize != size) {
        PyErr_Format(PyExc_ValueError,
            "%.200s.%.200s has the wrong size, try recompiling",
            module_name, class_name);
        goto bad;
    }
    return (PyTypeObject *)result;
bad:
    Py_XDECREF(py_module);
    Py_XDECREF(result);
    return NULL;
}
#endif

static int __Pyx_InitStrings(__Pyx_StringTabEntry *t) {
    while (t->p) {
        #if PY_MAJOR_VERSION < 3
        if (t->is_unicode) {
            *t->p = PyUnicode_DecodeUTF8(t->s, t->n - 1, NULL);
        } else if (t->intern) {
            *t->p = PyString_InternFromString(t->s);
        } else {
            *t->p = PyString_FromStringAndSize(t->s, t->n - 1);
        }
        #else
        if (t->is_unicode | t->is_str) {
            if (t->intern) {
                *t->p = PyUnicode_InternFromString(t->s);
            } else if (t->encoding) {
                *t->p = PyUnicode_Decode(t->s, t->n - 1, t->encoding, NULL);
            } else {
                *t->p = PyUnicode_FromStringAndSize(t->s, t->n - 1);
            }
        } else {
            *t->p = PyBytes_FromStringAndSize(t->s, t->n - 1);
        }
        #endif
        if (!*t->p)
            return -1;
        ++t;
    }
    return 0;
}

static CYTHON_INLINE PyObject* __Pyx_PyUnicode_FromString(const char* c_str) {
    return __Pyx_PyUnicode_FromStringAndSize(c_str, (Py_ssize_t)strlen(c_str));
}
static CYTHON_INLINE char* __Pyx_PyObject_AsString(PyObject* o) {
    Py_ssize_t ignore;
    return __Pyx_PyObject_AsStringAndSize(o, &ignore);
}
static CYTHON_INLINE char* __Pyx_PyObject_AsStringAndSize(PyObject* o, Py_ssize_t *length) {
#if CYTHON_COMPILING_IN_CPYTHON && (__PYX_DEFAULT_STRING_ENCODING_IS_ASCII || __PYX_DEFAULT_STRING_ENCODING_IS_DEFAULT)
    if (
#if PY_MAJOR_VERSION < 3 && __PYX_DEFAULT_STRING_ENCODING_IS_ASCII
            __Pyx_sys_getdefaultencoding_not_ascii &&
#endif
            PyUnicode_Check(o)) {
#if PY_VERSION_HEX < 0x03030000
        char* defenc_c;
        PyObject* defenc = _PyUnicode_AsDefaultEncodedString(o, NULL);
        if (!defenc) return NULL;
        defenc_c = PyBytes_AS_STRING(defenc);
#if __PYX_DEFAULT_STRING_ENCODING_IS_ASCII
        {
            char* end = defenc_c + PyBytes_GET_SIZE(defenc);
            char* c;
            for (c = defenc_c; c < end; c++) {
                if ((unsigned char) (*c) >= 128) {
                    PyUnicode_AsASCIIString(o);
                    return NULL;
                }
            }
        }
#endif
        *length = PyBytes_GET_SIZE(defenc);
        return defenc_c;
#else
        if (__Pyx_PyUnicode_READY(o) == -1) return NULL;
#if __PYX_DEFAULT_STRING_ENCODING_IS_ASCII
        if (PyUnicode_IS_ASCII(o)) {
            *length = PyUnicode_GET_LENGTH(o);
            return PyUnicode_AsUTF8(o);
        } else {
            PyUnicode_AsASCIIString(o);
            return NULL;
        }
#else
        return PyUnicode_AsUTF8AndSize(o, length);
#endif
#endif
    } else
#endif
#if (!CYTHON_COMPILING_IN_PYPY) || (defined(PyByteArray_AS_STRING) && defined(PyByteArray_GET_SIZE))
    if (PyByteArray_Check(o)) {
        *length = PyByteArray_GET_SIZE(o);
        return PyByteArray_AS_STRING(o);
    } else
#endif
    {
        char* result;
        int r = PyBytes_AsStringAndSize(o, &result, length);
        if (unlikely(r < 0)) {
            return NULL;
        } else {
            return result;
        }
    }
}
static CYTHON_INLINE int __Pyx_PyObject_IsTrue(PyObject* x) {
   int is_true = x == Py_True;
   if (is_true | (x == Py_False) | (x == Py_None)) return is_true;
   else return PyObject_IsTrue(x);
}
static CYTHON_INLINE PyObject* __Pyx_PyNumber_Int(PyObject* x) {
  PyNumberMethods *m;
  const char *name = NULL;
  PyObject *res = NULL;
#if PY_MAJOR_VERSION < 3
  if (PyInt_Check(x) || PyLong_Check(x))
#else
  if (PyLong_Check(x))
#endif
    return __Pyx_NewRef(x);
  m = Py_TYPE(x)->tp_as_number;
#if PY_MAJOR_VERSION < 3
  if (m && m->nb_int) {
    name = "int";
    res = PyNumber_Int(x);
  }
  else if (m && m->nb_long) {
    name = "long";
    res = PyNumber_Long(x);
  }
#else
  if (m && m->nb_int) {
    name = "int";
    res = PyNumber_Long(x);
  }
#endif
  if (res) {
#if PY_MAJOR_VERSION < 3
    if (!PyInt_Check(res) && !PyLong_Check(res)) {
#else
    if (!PyLong_Check(res)) {
#endif
      PyErr_Format(PyExc_TypeError,
                   "__%.4s__ returned non-%.4s (type %.200s)",
                   name, name, Py_TYPE(res)->tp_name);
      Py_DECREF(res);
      return NULL;
    }
  }
  else if (!PyErr_Occurred()) {
    PyErr_SetString(PyExc_TypeError,
                    "an integer is required");
  }
  return res;
}
static CYTHON_INLINE Py_ssize_t __Pyx_PyIndex_AsSsize_t(PyObject* b) {
  Py_ssize_t ival;
  PyObject *x;
#if PY_MAJOR_VERSION < 3
  if (likely(PyInt_CheckExact(b))) {
    if (sizeof(Py_ssize_t) >= sizeof(long))
        return PyInt_AS_LONG(b);
    else
        return PyInt_AsSsize_t(x);
  }
#endif
  if (likely(PyLong_CheckExact(b))) {
    #if CYTHON_USE_PYLONG_INTERNALS
    const digit* digits = ((PyLongObject*)b)->ob_digit;
    const Py_ssize_t size = Py_SIZE(b);
    if (likely(__Pyx_sst_abs(size) <= 1)) {
        ival = likely(size) ? digits[0] : 0;
        if (size == -1) ival = -ival;
        return ival;
    } else {
      switch (size) {
         case 2:
           if (8 * sizeof(Py_ssize_t) > 2 * PyLong_SHIFT) {
             return (Py_ssize_t) (((((size_t)digits[1]) << PyLong_SHIFT) | (size_t)digits[0]));
           }
           break;
         case -2:
           if (8 * sizeof(Py_ssize_t) > 2 * PyLong_SHIFT) {
             return -(Py_ssize_t) (((((size_t)digits[1]) << PyLong_SHIFT) | (size_t)digits[0]));
           }
           break;
         case 3:
           if (8 * sizeof(Py_ssize_t) > 3 * PyLong_SHIFT) {
             return (Py_ssize_t) (((((((size_t)digits[2]) << PyLong_SHIFT) | (size_t)digits[1]) << PyLong_SHIFT) | (size_t)digits[0]));
           }
           break;
         case -3:
           if (8 * sizeof(Py_ssize_t) > 3 * PyLong_SHIFT) {
             return -(Py_ssize_t) (((((((size_t)digits[2]) << PyLong_SHIFT) | (size_t)digits[1]) << PyLong_SHIFT) | (size_t)digits[0]));
           }
           break;
         case 4:
           if (8 * sizeof(Py_ssize_t) > 4 * PyLong_SHIFT) {
             return (Py_ssize_t) (((((((((size_t)digits[3]) << PyLong_SHIFT) | (size_t)digits[2]) << PyLong_SHIFT) | (size_t)digits[1]) << PyLong_SHIFT) | (size_t)digits[0]));
           }
           break;
         case -4:
           if (8 * sizeof(Py_ssize_t) > 4 * PyLong_SHIFT) {
             return -(Py_ssize_t) (((((((((size_t)digits[3]) << PyLong_SHIFT) | (size_t)digits[2]) << PyLong_SHIFT) | (size_t)digits[1]) << PyLong_SHIFT) | (size_t)digits[0]));
           }
           break;
      }
    }
    #endif
    return PyLong_AsSsize_t(b);
  }
  x = PyNumber_Index(b);
  if (!x) return -1;
  ival = PyInt_AsSsize_t(x);
  Py_DECREF(x);
  return ival;
}
static CYTHON_INLINE PyObject * __Pyx_PyInt_FromSize_t(size_t ival) {
    return PyInt_FromSize_t(ival);
}


#endif /* Py_PYTHON_H */
