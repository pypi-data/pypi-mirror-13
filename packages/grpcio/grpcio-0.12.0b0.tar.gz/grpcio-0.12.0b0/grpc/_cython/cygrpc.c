/* Generated by Cython 0.23.4 */

/* BEGIN: Cython Metadata
{
    "distutils": {
        "depends": [], 
        "include_dirs": [
            "."
        ], 
        "libraries": [
            "grpc", 
            "gpr", 
            "rt"
        ]
    }
}
END: Cython Metadata */

#define PY_SSIZE_T_CLEAN
#include "Python.h"
#ifndef Py_PYTHON_H
    #error Python headers needed to compile C extensions, please install development version of Python.
#elif PY_VERSION_HEX < 0x02060000 || (0x03000000 <= PY_VERSION_HEX && PY_VERSION_HEX < 0x03020000)
    #error Cython requires Python 2.6+ or Python 3.2+.
#else
#define CYTHON_ABI "0_23_4"
#include <stddef.h>
#ifndef offsetof
#define offsetof(type, member) ( (size_t) & ((type*)0) -> member )
#endif
#if !defined(WIN32) && !defined(MS_WINDOWS)
  #ifndef __stdcall
    #define __stdcall
  #endif
  #ifndef __cdecl
    #define __cdecl
  #endif
  #ifndef __fastcall
    #define __fastcall
  #endif
#endif
#ifndef DL_IMPORT
  #define DL_IMPORT(t) t
#endif
#ifndef DL_EXPORT
  #define DL_EXPORT(t) t
#endif
#ifndef PY_LONG_LONG
  #define PY_LONG_LONG LONG_LONG
#endif
#ifndef Py_HUGE_VAL
  #define Py_HUGE_VAL HUGE_VAL
#endif
#ifdef PYPY_VERSION
#define CYTHON_COMPILING_IN_PYPY 1
#define CYTHON_COMPILING_IN_CPYTHON 0
#else
#define CYTHON_COMPILING_IN_PYPY 0
#define CYTHON_COMPILING_IN_CPYTHON 1
#endif
#if !defined(CYTHON_USE_PYLONG_INTERNALS) && CYTHON_COMPILING_IN_CPYTHON && PY_VERSION_HEX >= 0x02070000
#define CYTHON_USE_PYLONG_INTERNALS 1
#endif
#if CYTHON_COMPILING_IN_PYPY && PY_VERSION_HEX < 0x02070600 && !defined(Py_OptimizeFlag)
#define Py_OptimizeFlag 0
#endif
#define __PYX_BUILD_PY_SSIZE_T "n"
#define CYTHON_FORMAT_SSIZE_T "z"
#if PY_MAJOR_VERSION < 3
  #define __Pyx_BUILTIN_MODULE_NAME "__builtin__"
  #define __Pyx_PyCode_New(a, k, l, s, f, code, c, n, v, fv, cell, fn, name, fline, lnos)\
          PyCode_New(a+k, l, s, f, code, c, n, v, fv, cell, fn, name, fline, lnos)
  #define __Pyx_DefaultClassType PyClass_Type
#else
  #define __Pyx_BUILTIN_MODULE_NAME "builtins"
  #define __Pyx_PyCode_New(a, k, l, s, f, code, c, n, v, fv, cell, fn, name, fline, lnos)\
          PyCode_New(a, k, l, s, f, code, c, n, v, fv, cell, fn, name, fline, lnos)
  #define __Pyx_DefaultClassType PyType_Type
#endif
#ifndef Py_TPFLAGS_CHECKTYPES
  #define Py_TPFLAGS_CHECKTYPES 0
#endif
#ifndef Py_TPFLAGS_HAVE_INDEX
  #define Py_TPFLAGS_HAVE_INDEX 0
#endif
#ifndef Py_TPFLAGS_HAVE_NEWBUFFER
  #define Py_TPFLAGS_HAVE_NEWBUFFER 0
#endif
#ifndef Py_TPFLAGS_HAVE_FINALIZE
  #define Py_TPFLAGS_HAVE_FINALIZE 0
#endif
#if PY_VERSION_HEX > 0x03030000 && defined(PyUnicode_KIND)
  #define CYTHON_PEP393_ENABLED 1
  #define __Pyx_PyUnicode_READY(op)       (likely(PyUnicode_IS_READY(op)) ?\
                                              0 : _PyUnicode_Ready((PyObject *)(op)))
  #define __Pyx_PyUnicode_GET_LENGTH(u)   PyUnicode_GET_LENGTH(u)
  #define __Pyx_PyUnicode_READ_CHAR(u, i) PyUnicode_READ_CHAR(u, i)
  #define __Pyx_PyUnicode_KIND(u)         PyUnicode_KIND(u)
  #define __Pyx_PyUnicode_DATA(u)         PyUnicode_DATA(u)
  #define __Pyx_PyUnicode_READ(k, d, i)   PyUnicode_READ(k, d, i)
#else
  #define CYTHON_PEP393_ENABLED 0
  #define __Pyx_PyUnicode_READY(op)       (0)
  #define __Pyx_PyUnicode_GET_LENGTH(u)   PyUnicode_GET_SIZE(u)
  #define __Pyx_PyUnicode_READ_CHAR(u, i) ((Py_UCS4)(PyUnicode_AS_UNICODE(u)[i]))
  #define __Pyx_PyUnicode_KIND(u)         (sizeof(Py_UNICODE))
  #define __Pyx_PyUnicode_DATA(u)         ((void*)PyUnicode_AS_UNICODE(u))
  #define __Pyx_PyUnicode_READ(k, d, i)   ((void)(k), (Py_UCS4)(((Py_UNICODE*)d)[i]))
#endif
#if CYTHON_COMPILING_IN_PYPY
  #define __Pyx_PyUnicode_Concat(a, b)      PyNumber_Add(a, b)
  #define __Pyx_PyUnicode_ConcatSafe(a, b)  PyNumber_Add(a, b)
#else
  #define __Pyx_PyUnicode_Concat(a, b)      PyUnicode_Concat(a, b)
  #define __Pyx_PyUnicode_ConcatSafe(a, b)  ((unlikely((a) == Py_None) || unlikely((b) == Py_None)) ?\
      PyNumber_Add(a, b) : __Pyx_PyUnicode_Concat(a, b))
#endif
#if CYTHON_COMPILING_IN_PYPY && !defined(PyUnicode_Contains)
  #define PyUnicode_Contains(u, s)  PySequence_Contains(u, s)
#endif
#define __Pyx_PyString_FormatSafe(a, b)   ((unlikely((a) == Py_None)) ? PyNumber_Remainder(a, b) : __Pyx_PyString_Format(a, b))
#define __Pyx_PyUnicode_FormatSafe(a, b)  ((unlikely((a) == Py_None)) ? PyNumber_Remainder(a, b) : PyUnicode_Format(a, b))
#if PY_MAJOR_VERSION >= 3
  #define __Pyx_PyString_Format(a, b)  PyUnicode_Format(a, b)
#else
  #define __Pyx_PyString_Format(a, b)  PyString_Format(a, b)
#endif
#if PY_MAJOR_VERSION >= 3
  #define PyBaseString_Type            PyUnicode_Type
  #define PyStringObject               PyUnicodeObject
  #define PyString_Type                PyUnicode_Type
  #define PyString_Check               PyUnicode_Check
  #define PyString_CheckExact          PyUnicode_CheckExact
#endif
#if PY_MAJOR_VERSION >= 3
  #define __Pyx_PyBaseString_Check(obj) PyUnicode_Check(obj)
  #define __Pyx_PyBaseString_CheckExact(obj) PyUnicode_CheckExact(obj)
#else
  #define __Pyx_PyBaseString_Check(obj) (PyString_Check(obj) || PyUnicode_Check(obj))
  #define __Pyx_PyBaseString_CheckExact(obj) (PyString_CheckExact(obj) || PyUnicode_CheckExact(obj))
#endif
#ifndef PySet_CheckExact
  #define PySet_CheckExact(obj)        (Py_TYPE(obj) == &PySet_Type)
#endif
#define __Pyx_TypeCheck(obj, type) PyObject_TypeCheck(obj, (PyTypeObject *)type)
#if PY_MAJOR_VERSION >= 3
  #define PyIntObject                  PyLongObject
  #define PyInt_Type                   PyLong_Type
  #define PyInt_Check(op)              PyLong_Check(op)
  #define PyInt_CheckExact(op)         PyLong_CheckExact(op)
  #define PyInt_FromString             PyLong_FromString
  #define PyInt_FromUnicode            PyLong_FromUnicode
  #define PyInt_FromLong               PyLong_FromLong
  #define PyInt_FromSize_t             PyLong_FromSize_t
  #define PyInt_FromSsize_t            PyLong_FromSsize_t
  #define PyInt_AsLong                 PyLong_AsLong
  #define PyInt_AS_LONG                PyLong_AS_LONG
  #define PyInt_AsSsize_t              PyLong_AsSsize_t
  #define PyInt_AsUnsignedLongMask     PyLong_AsUnsignedLongMask
  #define PyInt_AsUnsignedLongLongMask PyLong_AsUnsignedLongLongMask
  #define PyNumber_Int                 PyNumber_Long
#endif
#if PY_MAJOR_VERSION >= 3
  #define PyBoolObject                 PyLongObject
#endif
#if PY_MAJOR_VERSION >= 3 && CYTHON_COMPILING_IN_PYPY
  #ifndef PyUnicode_InternFromString
    #define PyUnicode_InternFromString(s) PyUnicode_FromString(s)
  #endif
#endif
#if PY_VERSION_HEX < 0x030200A4
  typedef long Py_hash_t;
  #define __Pyx_PyInt_FromHash_t PyInt_FromLong
  #define __Pyx_PyInt_AsHash_t   PyInt_AsLong
#else
  #define __Pyx_PyInt_FromHash_t PyInt_FromSsize_t
  #define __Pyx_PyInt_AsHash_t   PyInt_AsSsize_t
#endif
#if PY_MAJOR_VERSION >= 3
  #define __Pyx_PyMethod_New(func, self, klass) ((self) ? PyMethod_New(func, self) : PyInstanceMethod_New(func))
#else
  #define __Pyx_PyMethod_New(func, self, klass) PyMethod_New(func, self, klass)
#endif
#if PY_VERSION_HEX >= 0x030500B1
#define __Pyx_PyAsyncMethodsStruct PyAsyncMethods
#define __Pyx_PyType_AsAsync(obj) (Py_TYPE(obj)->tp_as_async)
#elif CYTHON_COMPILING_IN_CPYTHON && PY_MAJOR_VERSION >= 3
typedef struct {
    unaryfunc am_await;
    unaryfunc am_aiter;
    unaryfunc am_anext;
} __Pyx_PyAsyncMethodsStruct;
#define __Pyx_PyType_AsAsync(obj) ((__Pyx_PyAsyncMethodsStruct*) (Py_TYPE(obj)->tp_reserved))
#else
#define __Pyx_PyType_AsAsync(obj) NULL
#endif
#ifndef CYTHON_RESTRICT
  #if defined(__GNUC__)
    #define CYTHON_RESTRICT __restrict__
  #elif defined(_MSC_VER) && _MSC_VER >= 1400
    #define CYTHON_RESTRICT __restrict
  #elif defined (__STDC_VERSION__) && __STDC_VERSION__ >= 199901L
    #define CYTHON_RESTRICT restrict
  #else
    #define CYTHON_RESTRICT
  #endif
#endif
#define __Pyx_void_to_None(void_result) ((void)(void_result), Py_INCREF(Py_None), Py_None)

#ifndef CYTHON_INLINE
  #if defined(__GNUC__)
    #define CYTHON_INLINE __inline__
  #elif defined(_MSC_VER)
    #define CYTHON_INLINE __inline
  #elif defined (__STDC_VERSION__) && __STDC_VERSION__ >= 199901L
    #define CYTHON_INLINE inline
  #else
    #define CYTHON_INLINE
  #endif
#endif

#if defined(WIN32) || defined(MS_WINDOWS)
  #define _USE_MATH_DEFINES
#endif
#include <math.h>
#ifdef NAN
#define __PYX_NAN() ((float) NAN)
#else
static CYTHON_INLINE float __PYX_NAN() {
  float value;
  memset(&value, 0xFF, sizeof(value));
  return value;
}
#endif


#if PY_MAJOR_VERSION >= 3
  #define __Pyx_PyNumber_Divide(x,y)         PyNumber_TrueDivide(x,y)
  #define __Pyx_PyNumber_InPlaceDivide(x,y)  PyNumber_InPlaceTrueDivide(x,y)
#else
  #define __Pyx_PyNumber_Divide(x,y)         PyNumber_Divide(x,y)
  #define __Pyx_PyNumber_InPlaceDivide(x,y)  PyNumber_InPlaceDivide(x,y)
#endif

#ifndef __PYX_EXTERN_C
  #ifdef __cplusplus
    #define __PYX_EXTERN_C extern "C"
  #else
    #define __PYX_EXTERN_C extern
  #endif
#endif

#define __PYX_HAVE__grpc___cython__cygrpc
#define __PYX_HAVE_API__grpc___cython__cygrpc
#include "string.h"
#include "stdio.h"
#include "pythread.h"
#include "stddef.h"
#include "time.h"
#include "grpc/support/alloc.h"
#include "grpc/support/slice.h"
#include "grpc/support/port_platform.h"
#include "grpc/support/time.h"
#include "grpc/status.h"
#include "grpc/byte_buffer_reader.h"
#include "grpc/byte_buffer.h"
#include "grpc/grpc.h"
#include "grpc/grpc_security.h"
#ifdef _OPENMP
#include <omp.h>
#endif /* _OPENMP */

#ifdef PYREX_WITHOUT_ASSERTIONS
#define CYTHON_WITHOUT_ASSERTIONS
#endif

#ifndef CYTHON_UNUSED
# if defined(__GNUC__)
#   if !(defined(__cplusplus)) || (__GNUC__ > 3 || (__GNUC__ == 3 && __GNUC_MINOR__ >= 4))
#     define CYTHON_UNUSED __attribute__ ((__unused__))
#   else
#     define CYTHON_UNUSED
#   endif
# elif defined(__ICC) || (defined(__INTEL_COMPILER) && !defined(_MSC_VER))
#   define CYTHON_UNUSED __attribute__ ((__unused__))
# else
#   define CYTHON_UNUSED
# endif
#endif
#ifndef CYTHON_NCP_UNUSED
# if CYTHON_COMPILING_IN_CPYTHON
#  define CYTHON_NCP_UNUSED
# else
#  define CYTHON_NCP_UNUSED CYTHON_UNUSED
# endif
#endif
typedef struct {PyObject **p; char *s; const Py_ssize_t n; const char* encoding;
                const char is_unicode; const char is_str; const char intern; } __Pyx_StringTabEntry;

#define __PYX_DEFAULT_STRING_ENCODING_IS_ASCII 0
#define __PYX_DEFAULT_STRING_ENCODING_IS_DEFAULT 0
#define __PYX_DEFAULT_STRING_ENCODING ""
#define __Pyx_PyObject_FromString __Pyx_PyBytes_FromString
#define __Pyx_PyObject_FromStringAndSize __Pyx_PyBytes_FromStringAndSize
#define __Pyx_uchar_cast(c) ((unsigned char)c)
#define __Pyx_long_cast(x) ((long)x)
#define __Pyx_fits_Py_ssize_t(v, type, is_signed)  (\
    (sizeof(type) < sizeof(Py_ssize_t))  ||\
    (sizeof(type) > sizeof(Py_ssize_t) &&\
          likely(v < (type)PY_SSIZE_T_MAX ||\
                 v == (type)PY_SSIZE_T_MAX)  &&\
          (!is_signed || likely(v > (type)PY_SSIZE_T_MIN ||\
                                v == (type)PY_SSIZE_T_MIN)))  ||\
    (sizeof(type) == sizeof(Py_ssize_t) &&\
          (is_signed || likely(v < (type)PY_SSIZE_T_MAX ||\
                               v == (type)PY_SSIZE_T_MAX)))  )
#if defined (__cplusplus) && __cplusplus >= 201103L
    #include <cstdlib>
    #define __Pyx_sst_abs(value) std::abs(value)
#elif SIZEOF_INT >= SIZEOF_SIZE_T
    #define __Pyx_sst_abs(value) abs(value)
#elif SIZEOF_LONG >= SIZEOF_SIZE_T
    #define __Pyx_sst_abs(value) labs(value)
#elif defined (_MSC_VER) && defined (_M_X64)
    #define __Pyx_sst_abs(value) _abs64(value)
#elif defined (__STDC_VERSION__) && __STDC_VERSION__ >= 199901L
    #define __Pyx_sst_abs(value) llabs(value)
#elif defined (__GNUC__)
    #define __Pyx_sst_abs(value) __builtin_llabs(value)
#else
    #define __Pyx_sst_abs(value) ((value<0) ? -value : value)
#endif
static CYTHON_INLINE char* __Pyx_PyObject_AsString(PyObject*);
static CYTHON_INLINE char* __Pyx_PyObject_AsStringAndSize(PyObject*, Py_ssize_t* length);
#define __Pyx_PyByteArray_FromString(s) PyByteArray_FromStringAndSize((const char*)s, strlen((const char*)s))
#define __Pyx_PyByteArray_FromStringAndSize(s, l) PyByteArray_FromStringAndSize((const char*)s, l)
#define __Pyx_PyBytes_FromString        PyBytes_FromString
#define __Pyx_PyBytes_FromStringAndSize PyBytes_FromStringAndSize
static CYTHON_INLINE PyObject* __Pyx_PyUnicode_FromString(const char*);
#if PY_MAJOR_VERSION < 3
    #define __Pyx_PyStr_FromString        __Pyx_PyBytes_FromString
    #define __Pyx_PyStr_FromStringAndSize __Pyx_PyBytes_FromStringAndSize
#else
    #define __Pyx_PyStr_FromString        __Pyx_PyUnicode_FromString
    #define __Pyx_PyStr_FromStringAndSize __Pyx_PyUnicode_FromStringAndSize
#endif
#define __Pyx_PyObject_AsSString(s)    ((signed char*) __Pyx_PyObject_AsString(s))
#define __Pyx_PyObject_AsUString(s)    ((unsigned char*) __Pyx_PyObject_AsString(s))
#define __Pyx_PyObject_FromCString(s)  __Pyx_PyObject_FromString((const char*)s)
#define __Pyx_PyBytes_FromCString(s)   __Pyx_PyBytes_FromString((const char*)s)
#define __Pyx_PyByteArray_FromCString(s)   __Pyx_PyByteArray_FromString((const char*)s)
#define __Pyx_PyStr_FromCString(s)     __Pyx_PyStr_FromString((const char*)s)
#define __Pyx_PyUnicode_FromCString(s) __Pyx_PyUnicode_FromString((const char*)s)
#if PY_MAJOR_VERSION < 3
static CYTHON_INLINE size_t __Pyx_Py_UNICODE_strlen(const Py_UNICODE *u)
{
    const Py_UNICODE *u_end = u;
    while (*u_end++) ;
    return (size_t)(u_end - u - 1);
}
#else
#define __Pyx_Py_UNICODE_strlen Py_UNICODE_strlen
#endif
#define __Pyx_PyUnicode_FromUnicode(u)       PyUnicode_FromUnicode(u, __Pyx_Py_UNICODE_strlen(u))
#define __Pyx_PyUnicode_FromUnicodeAndLength PyUnicode_FromUnicode
#define __Pyx_PyUnicode_AsUnicode            PyUnicode_AsUnicode
#define __Pyx_NewRef(obj) (Py_INCREF(obj), obj)
#define __Pyx_Owned_Py_None(b) __Pyx_NewRef(Py_None)
#define __Pyx_PyBool_FromLong(b) ((b) ? __Pyx_NewRef(Py_True) : __Pyx_NewRef(Py_False))
static CYTHON_INLINE int __Pyx_PyObject_IsTrue(PyObject*);
static CYTHON_INLINE PyObject* __Pyx_PyNumber_Int(PyObject* x);
static CYTHON_INLINE Py_ssize_t __Pyx_PyIndex_AsSsize_t(PyObject*);
static CYTHON_INLINE PyObject * __Pyx_PyInt_FromSize_t(size_t);
#if CYTHON_COMPILING_IN_CPYTHON
#define __pyx_PyFloat_AsDouble(x) (PyFloat_CheckExact(x) ? PyFloat_AS_DOUBLE(x) : PyFloat_AsDouble(x))
#else
#define __pyx_PyFloat_AsDouble(x) PyFloat_AsDouble(x)
#endif
#define __pyx_PyFloat_AsFloat(x) ((float) __pyx_PyFloat_AsDouble(x))
#if PY_MAJOR_VERSION < 3 && __PYX_DEFAULT_STRING_ENCODING_IS_ASCII
static int __Pyx_sys_getdefaultencoding_not_ascii;
static int __Pyx_init_sys_getdefaultencoding_params(void) {
    PyObject* sys;
    PyObject* default_encoding = NULL;
    PyObject* ascii_chars_u = NULL;
    PyObject* ascii_chars_b = NULL;
    const char* default_encoding_c;
    sys = PyImport_ImportModule("sys");
    if (!sys) goto bad;
    default_encoding = PyObject_CallMethod(sys, (char*) "getdefaultencoding", NULL);
    Py_DECREF(sys);
    if (!default_encoding) goto bad;
    default_encoding_c = PyBytes_AsString(default_encoding);
    if (!default_encoding_c) goto bad;
    if (strcmp(default_encoding_c, "ascii") == 0) {
        __Pyx_sys_getdefaultencoding_not_ascii = 0;
    } else {
        char ascii_chars[128];
        int c;
        for (c = 0; c < 128; c++) {
            ascii_chars[c] = c;
        }
        __Pyx_sys_getdefaultencoding_not_ascii = 1;
        ascii_chars_u = PyUnicode_DecodeASCII(ascii_chars, 128, NULL);
        if (!ascii_chars_u) goto bad;
        ascii_chars_b = PyUnicode_AsEncodedString(ascii_chars_u, default_encoding_c, NULL);
        if (!ascii_chars_b || !PyBytes_Check(ascii_chars_b) || memcmp(ascii_chars, PyBytes_AS_STRING(ascii_chars_b), 128) != 0) {
            PyErr_Format(
                PyExc_ValueError,
                "This module compiled with c_string_encoding=ascii, but default encoding '%.200s' is not a superset of ascii.",
                default_encoding_c);
            goto bad;
        }
        Py_DECREF(ascii_chars_u);
        Py_DECREF(ascii_chars_b);
    }
    Py_DECREF(default_encoding);
    return 0;
bad:
    Py_XDECREF(default_encoding);
    Py_XDECREF(ascii_chars_u);
    Py_XDECREF(ascii_chars_b);
    return -1;
}
#endif
#if __PYX_DEFAULT_STRING_ENCODING_IS_DEFAULT && PY_MAJOR_VERSION >= 3
#define __Pyx_PyUnicode_FromStringAndSize(c_str, size) PyUnicode_DecodeUTF8(c_str, size, NULL)
#else
#define __Pyx_PyUnicode_FromStringAndSize(c_str, size) PyUnicode_Decode(c_str, size, __PYX_DEFAULT_STRING_ENCODING, NULL)
#if __PYX_DEFAULT_STRING_ENCODING_IS_DEFAULT
static char* __PYX_DEFAULT_STRING_ENCODING;
static int __Pyx_init_sys_getdefaultencoding_params(void) {
    PyObject* sys;
    PyObject* default_encoding = NULL;
    char* default_encoding_c;
    sys = PyImport_ImportModule("sys");
    if (!sys) goto bad;
    default_encoding = PyObject_CallMethod(sys, (char*) (const char*) "getdefaultencoding", NULL);
    Py_DECREF(sys);
    if (!default_encoding) goto bad;
    default_encoding_c = PyBytes_AsString(default_encoding);
    if (!default_encoding_c) goto bad;
    __PYX_DEFAULT_STRING_ENCODING = (char*) malloc(strlen(default_encoding_c));
    if (!__PYX_DEFAULT_STRING_ENCODING) goto bad;
    strcpy(__PYX_DEFAULT_STRING_ENCODING, default_encoding_c);
    Py_DECREF(default_encoding);
    return 0;
bad:
    Py_XDECREF(default_encoding);
    return -1;
}
#endif
#endif


/* Test for GCC > 2.95 */
#if defined(__GNUC__)     && (__GNUC__ > 2 || (__GNUC__ == 2 && (__GNUC_MINOR__ > 95)))
  #define likely(x)   __builtin_expect(!!(x), 1)
  #define unlikely(x) __builtin_expect(!!(x), 0)
#else /* !__GNUC__ or GCC < 2.95 */
  #define likely(x)   (x)
  #define unlikely(x) (x)
#endif /* __GNUC__ */

static PyObject *__pyx_m;
static PyObject *__pyx_d;
static PyObject *__pyx_b;
static PyObject *__pyx_empty_tuple;
static PyObject *__pyx_empty_bytes;
static int __pyx_lineno;
static int __pyx_clineno = 0;
static const char * __pyx_cfilenm= __FILE__;
static const char *__pyx_filename;


static const char *__pyx_f[] = {
  "grpc/_cython/cygrpc.pyx",
  "type.pxd",
  "bool.pxd",
  "complex.pxd",
  "grpc/_cython/_cygrpc/call.pxd",
  "grpc/_cython/_cygrpc/channel.pxd",
  "grpc/_cython/_cygrpc/completion_queue.pxd",
  "grpc/_cython/_cygrpc/server.pxd",
  "grpc/_cython/_cygrpc/records.pxd",
  "grpc/_cython/_cygrpc/credentials.pxd",
};

/*--- Type declarations ---*/
struct __pyx_obj_4grpc_7_cython_7_cygrpc_4call_Call;
struct __pyx_obj_4grpc_7_cython_7_cygrpc_7channel_Channel;
struct __pyx_obj_4grpc_7_cython_7_cygrpc_16completion_queue_CompletionQueue;
struct __pyx_obj_4grpc_7_cython_7_cygrpc_6server_Server;
struct __pyx_obj_4grpc_7_cython_7_cygrpc_7records_Timespec;
struct __pyx_obj_4grpc_7_cython_7_cygrpc_7records_CallDetails;
struct __pyx_obj_4grpc_7_cython_7_cygrpc_7records_OperationTag;
struct __pyx_obj_4grpc_7_cython_7_cygrpc_7records_Event;
struct __pyx_obj_4grpc_7_cython_7_cygrpc_7records_ByteBuffer;
struct __pyx_obj_4grpc_7_cython_7_cygrpc_7records_SslPemKeyCertPair;
struct __pyx_obj_4grpc_7_cython_7_cygrpc_7records_ChannelArg;
struct __pyx_obj_4grpc_7_cython_7_cygrpc_7records_ChannelArgs;
struct __pyx_obj_4grpc_7_cython_7_cygrpc_7records_Metadatum;
struct __pyx_obj_4grpc_7_cython_7_cygrpc_7records_Metadata;
struct __pyx_obj_4grpc_7_cython_7_cygrpc_7records_Operation;
struct __pyx_obj_4grpc_7_cython_7_cygrpc_7records_Operations;
struct __pyx_obj_4grpc_7_cython_7_cygrpc_11credentials_ChannelCredentials;
struct __pyx_obj_4grpc_7_cython_7_cygrpc_11credentials_CallCredentials;
struct __pyx_obj_4grpc_7_cython_7_cygrpc_11credentials_ServerCredentials;
struct __pyx_obj_4grpc_7_cython_7_cygrpc_11credentials_CredentialsMetadataPlugin;
struct __pyx_obj_4grpc_7_cython_7_cygrpc_11credentials_AuthMetadataContext;
struct __pyx_obj_4grpc_7_cython_6cygrpc__ModuleState;

/* "call.pxd":33
 * 
 * 
 * cdef class Call:             # <<<<<<<<<<<<<<
 * 
 *   cdef grpc.grpc_call *c_call
 */
struct __pyx_obj_4grpc_7_cython_7_cygrpc_4call_Call {
  PyObject_HEAD
  grpc_call *c_call;
  PyObject *references;
};


/* "channel.pxd":33
 * 
 * 
 * cdef class Channel:             # <<<<<<<<<<<<<<
 * 
 *   cdef grpc.grpc_channel *c_channel
 */
struct __pyx_obj_4grpc_7_cython_7_cygrpc_7channel_Channel {
  PyObject_HEAD
  grpc_channel *c_channel;
  PyObject *references;
};


/* "completion_queue.pxd":33
 * 
 * 
 * cdef class CompletionQueue:             # <<<<<<<<<<<<<<
 * 
 *   cdef grpc.grpc_completion_queue *c_completion_queue
 */
struct __pyx_obj_4grpc_7_cython_7_cygrpc_16completion_queue_CompletionQueue {
  PyObject_HEAD
  grpc_completion_queue *c_completion_queue;
  PyObject *poll_condition;
  int is_polling;
  int is_shutting_down;
  int is_shutdown;
};


/* "server.pxd":34
 * 
 * 
 * cdef class Server:             # <<<<<<<<<<<<<<
 * 
 *   cdef grpc.grpc_server *c_server
 */
struct __pyx_obj_4grpc_7_cython_7_cygrpc_6server_Server {
  PyObject_HEAD
  struct __pyx_vtabstruct_4grpc_7_cython_7_cygrpc_6server_Server *__pyx_vtab;
  grpc_server *c_server;
  int is_started;
  int is_shutting_down;
  int is_shutdown;
  struct __pyx_obj_4grpc_7_cython_7_cygrpc_16completion_queue_CompletionQueue *backup_shutdown_queue;
  PyObject *references;
  PyObject *registered_completion_queues;
};


/* "records.pxd":35
 * 
 * 
 * cdef class Timespec:             # <<<<<<<<<<<<<<
 * 
 *   cdef grpc.gpr_timespec c_time
 */
struct __pyx_obj_4grpc_7_cython_7_cygrpc_7records_Timespec {
  PyObject_HEAD
  gpr_timespec c_time;
};


/* "records.pxd":40
 * 
 * 
 * cdef class CallDetails:             # <<<<<<<<<<<<<<
 * 
 *   cdef grpc.grpc_call_details c_details
 */
struct __pyx_obj_4grpc_7_cython_7_cygrpc_7records_CallDetails {
  PyObject_HEAD
  grpc_call_details c_details;
};


/* "records.pxd":45
 * 
 * 
 * cdef class OperationTag:             # <<<<<<<<<<<<<<
 * 
 *   cdef object user_tag
 */
struct __pyx_obj_4grpc_7_cython_7_cygrpc_7records_OperationTag {
  PyObject_HEAD
  PyObject *user_tag;
  PyObject *references;
  struct __pyx_obj_4grpc_7_cython_7_cygrpc_6server_Server *shutting_down_server;
  struct __pyx_obj_4grpc_7_cython_7_cygrpc_4call_Call *operation_call;
  struct __pyx_obj_4grpc_7_cython_7_cygrpc_7records_CallDetails *request_call_details;
  struct __pyx_obj_4grpc_7_cython_7_cygrpc_7records_Metadata *request_metadata;
  struct __pyx_obj_4grpc_7_cython_7_cygrpc_7records_Operations *batch_operations;
  int is_new_request;
};


/* "records.pxd":59
 * 
 * 
 * cdef class Event:             # <<<<<<<<<<<<<<
 * 
 *   cdef readonly grpc.grpc_completion_type type
 */
struct __pyx_obj_4grpc_7_cython_7_cygrpc_7records_Event {
  PyObject_HEAD
  grpc_completion_type type;
  int success;
  PyObject *tag;
  struct __pyx_obj_4grpc_7_cython_7_cygrpc_4call_Call *operation_call;
  int is_new_request;
  struct __pyx_obj_4grpc_7_cython_7_cygrpc_7records_CallDetails *request_call_details;
  struct __pyx_obj_4grpc_7_cython_7_cygrpc_7records_Metadata *request_metadata;
  struct __pyx_obj_4grpc_7_cython_7_cygrpc_7records_Operations *batch_operations;
};


/* "records.pxd":77
 * 
 * 
 * cdef class ByteBuffer:             # <<<<<<<<<<<<<<
 * 
 *   cdef grpc.grpc_byte_buffer *c_byte_buffer
 */
struct __pyx_obj_4grpc_7_cython_7_cygrpc_7records_ByteBuffer {
  PyObject_HEAD
  grpc_byte_buffer *c_byte_buffer;
};


/* "records.pxd":82
 * 
 * 
 * cdef class SslPemKeyCertPair:             # <<<<<<<<<<<<<<
 * 
 *   cdef grpc.grpc_ssl_pem_key_cert_pair c_pair
 */
struct __pyx_obj_4grpc_7_cython_7_cygrpc_7records_SslPemKeyCertPair {
  PyObject_HEAD
  grpc_ssl_pem_key_cert_pair c_pair;
  PyObject *private_key;
  PyObject *certificate_chain;
};


/* "records.pxd":88
 * 
 * 
 * cdef class ChannelArg:             # <<<<<<<<<<<<<<
 * 
 *   cdef grpc.grpc_arg c_arg
 */
struct __pyx_obj_4grpc_7_cython_7_cygrpc_7records_ChannelArg {
  PyObject_HEAD
  grpc_arg c_arg;
  PyObject *key;
  PyObject *value;
};


/* "records.pxd":94
 * 
 * 
 * cdef class ChannelArgs:             # <<<<<<<<<<<<<<
 * 
 *   cdef grpc.grpc_channel_args c_args
 */
struct __pyx_obj_4grpc_7_cython_7_cygrpc_7records_ChannelArgs {
  PyObject_HEAD
  grpc_channel_args c_args;
  PyObject *args;
};


/* "records.pxd":100
 * 
 * 
 * cdef class Metadatum:             # <<<<<<<<<<<<<<
 * 
 *   cdef grpc.grpc_metadata c_metadata
 */
struct __pyx_obj_4grpc_7_cython_7_cygrpc_7records_Metadatum {
  PyObject_HEAD
  grpc_metadata c_metadata;
  PyObject *_key;
  PyObject *_value;
};


/* "records.pxd":106
 * 
 * 
 * cdef class Metadata:             # <<<<<<<<<<<<<<
 * 
 *   cdef grpc.grpc_metadata_array c_metadata_array
 */
struct __pyx_obj_4grpc_7_cython_7_cygrpc_7records_Metadata {
  PyObject_HEAD
  grpc_metadata_array c_metadata_array;
  PyObject *metadata;
};


/* "records.pxd":112
 * 
 * 
 * cdef class Operation:             # <<<<<<<<<<<<<<
 * 
 *   cdef grpc.grpc_op c_op
 */
struct __pyx_obj_4grpc_7_cython_7_cygrpc_7records_Operation {
  PyObject_HEAD
  grpc_op c_op;
  struct __pyx_obj_4grpc_7_cython_7_cygrpc_7records_ByteBuffer *_received_message;
  struct __pyx_obj_4grpc_7_cython_7_cygrpc_7records_Metadata *_received_metadata;
  grpc_status_code _received_status_code;
  char *_received_status_details;
  size_t _received_status_details_capacity;
  int _received_cancelled;
  int is_valid;
  PyObject *references;
};


/* "records.pxd":125
 * 
 * 
 * cdef class Operations:             # <<<<<<<<<<<<<<
 * 
 *   cdef grpc.grpc_op *c_ops
 */
struct __pyx_obj_4grpc_7_cython_7_cygrpc_7records_Operations {
  PyObject_HEAD
  grpc_op *c_ops;
  size_t c_nops;
  PyObject *operations;
};


/* "credentials.pxd":36
 * 
 * 
 * cdef class ChannelCredentials:             # <<<<<<<<<<<<<<
 * 
 *   cdef grpc.grpc_channel_credentials *c_credentials
 */
struct __pyx_obj_4grpc_7_cython_7_cygrpc_11credentials_ChannelCredentials {
  PyObject_HEAD
  grpc_channel_credentials *c_credentials;
  grpc_ssl_pem_key_cert_pair c_ssl_pem_key_cert_pair;
  PyObject *references;
};


/* "credentials.pxd":43
 * 
 * 
 * cdef class CallCredentials:             # <<<<<<<<<<<<<<
 * 
 *   cdef grpc.grpc_call_credentials *c_credentials
 */
struct __pyx_obj_4grpc_7_cython_7_cygrpc_11credentials_CallCredentials {
  PyObject_HEAD
  grpc_call_credentials *c_credentials;
  PyObject *references;
};


/* "credentials.pxd":49
 * 
 * 
 * cdef class ServerCredentials:             # <<<<<<<<<<<<<<
 * 
 *   cdef grpc.grpc_server_credentials *c_credentials
 */
struct __pyx_obj_4grpc_7_cython_7_cygrpc_11credentials_ServerCredentials {
  PyObject_HEAD
  grpc_server_credentials *c_credentials;
  grpc_ssl_pem_key_cert_pair *c_ssl_pem_key_cert_pairs;
  size_t c_ssl_pem_key_cert_pairs_count;
  PyObject *references;
};


/* "credentials.pxd":57
 * 
 * 
 * cdef class CredentialsMetadataPlugin:             # <<<<<<<<<<<<<<
 * 
 *   cdef object plugin_callback
 */
struct __pyx_obj_4grpc_7_cython_7_cygrpc_11credentials_CredentialsMetadataPlugin {
  PyObject_HEAD
  struct __pyx_vtabstruct_4grpc_7_cython_7_cygrpc_11credentials_CredentialsMetadataPlugin *__pyx_vtab;
  PyObject *plugin_callback;
  PyObject *plugin_name;
};


/* "credentials.pxd":65
 * 
 * 
 * cdef class AuthMetadataContext:             # <<<<<<<<<<<<<<
 * 
 *   cdef grpc.grpc_auth_metadata_context context
 */
struct __pyx_obj_4grpc_7_cython_7_cygrpc_11credentials_AuthMetadataContext {
  PyObject_HEAD
  grpc_auth_metadata_context context;
};


/* "grpc/_cython/cygrpc.pyx":109
 * #
 * 
 * cdef class _ModuleState:             # <<<<<<<<<<<<<<
 * 
 *   def __cinit__(self):
 */
struct __pyx_obj_4grpc_7_cython_6cygrpc__ModuleState {
  PyObject_HEAD
};



/* "server.pxd":34
 * 
 * 
 * cdef class Server:             # <<<<<<<<<<<<<<
 * 
 *   cdef grpc.grpc_server *c_server
 */

struct __pyx_vtabstruct_4grpc_7_cython_7_cygrpc_6server_Server {
  PyObject *(*notify_shutdown_complete)(struct __pyx_obj_4grpc_7_cython_7_cygrpc_6server_Server *);
};
static struct __pyx_vtabstruct_4grpc_7_cython_7_cygrpc_6server_Server *__pyx_vtabptr_4grpc_7_cython_7_cygrpc_6server_Server;


/* "credentials.pxd":57
 * 
 * 
 * cdef class CredentialsMetadataPlugin:             # <<<<<<<<<<<<<<
 * 
 *   cdef object plugin_callback
 */

struct __pyx_vtabstruct_4grpc_7_cython_7_cygrpc_11credentials_CredentialsMetadataPlugin {
  grpc_metadata_credentials_plugin (*make_c_plugin)(struct __pyx_obj_4grpc_7_cython_7_cygrpc_11credentials_CredentialsMetadataPlugin *);
};
static struct __pyx_vtabstruct_4grpc_7_cython_7_cygrpc_11credentials_CredentialsMetadataPlugin *__pyx_vtabptr_4grpc_7_cython_7_cygrpc_11credentials_CredentialsMetadataPlugin;

/* --- Runtime support code (head) --- */
#ifndef CYTHON_REFNANNY
  #define CYTHON_REFNANNY 0
#endif
#if CYTHON_REFNANNY
  typedef struct {
    void (*INCREF)(void*, PyObject*, int);
    void (*DECREF)(void*, PyObject*, int);
    void (*GOTREF)(void*, PyObject*, int);
    void (*GIVEREF)(void*, PyObject*, int);
    void* (*SetupContext)(const char*, int, const char*);
    void (*FinishContext)(void**);
  } __Pyx_RefNannyAPIStruct;
  static __Pyx_RefNannyAPIStruct *__Pyx_RefNanny = NULL;
  static __Pyx_RefNannyAPIStruct *__Pyx_RefNannyImportAPI(const char *modname);
  #define __Pyx_RefNannyDeclarations void *__pyx_refnanny = NULL;
#ifdef WITH_THREAD
  #define __Pyx_RefNannySetupContext(name, acquire_gil)\
          if (acquire_gil) {\
              PyGILState_STATE __pyx_gilstate_save = PyGILState_Ensure();\
              __pyx_refnanny = __Pyx_RefNanny->SetupContext((name), __LINE__, __FILE__);\
              PyGILState_Release(__pyx_gilstate_save);\
          } else {\
              __pyx_refnanny = __Pyx_RefNanny->SetupContext((name), __LINE__, __FILE__);\
          }
#else
  #define __Pyx_RefNannySetupContext(name, acquire_gil)\
          __pyx_refnanny = __Pyx_RefNanny->SetupContext((name), __LINE__, __FILE__)
#endif
  #define __Pyx_RefNannyFinishContext()\
          __Pyx_RefNanny->FinishContext(&__pyx_refnanny)
  #define __Pyx_INCREF(r)  __Pyx_RefNanny->INCREF(__pyx_refnanny, (PyObject *)(r), __LINE__)
  #define __Pyx_DECREF(r)  __Pyx_RefNanny->DECREF(__pyx_refnanny, (PyObject *)(r), __LINE__)
  #define __Pyx_GOTREF(r)  __Pyx_RefNanny->GOTREF(__pyx_refnanny, (PyObject *)(r), __LINE__)
  #define __Pyx_GIVEREF(r) __Pyx_RefNanny->GIVEREF(__pyx_refnanny, (PyObject *)(r), __LINE__)
  #define __Pyx_XINCREF(r)  do { if((r) != NULL) {__Pyx_INCREF(r); }} while(0)
  #define __Pyx_XDECREF(r)  do { if((r) != NULL) {__Pyx_DECREF(r); }} while(0)
  #define __Pyx_XGOTREF(r)  do { if((r) != NULL) {__Pyx_GOTREF(r); }} while(0)
  #define __Pyx_XGIVEREF(r) do { if((r) != NULL) {__Pyx_GIVEREF(r);}} while(0)
#else
  #define __Pyx_RefNannyDeclarations
  #define __Pyx_RefNannySetupContext(name, acquire_gil)
  #define __Pyx_RefNannyFinishContext()
  #define __Pyx_INCREF(r) Py_INCREF(r)
  #define __Pyx_DECREF(r) Py_DECREF(r)
  #define __Pyx_GOTREF(r)
  #define __Pyx_GIVEREF(r)
  #define __Pyx_XINCREF(r) Py_XINCREF(r)
  #define __Pyx_XDECREF(r) Py_XDECREF(r)
  #define __Pyx_XGOTREF(r)
  #define __Pyx_XGIVEREF(r)
#endif
#define __Pyx_XDECREF_SET(r, v) do {\
        PyObject *tmp = (PyObject *) r;\
        r = v; __Pyx_XDECREF(tmp);\
    } while (0)
#define __Pyx_DECREF_SET(r, v) do {\
        PyObject *tmp = (PyObject *) r;\
        r = v; __Pyx_DECREF(tmp);\
    } while (0)
#define __Pyx_CLEAR(r)    do { PyObject* tmp = ((PyObject*)(r)); r = NULL; __Pyx_DECREF(tmp);} while(0)
#define __Pyx_XCLEAR(r)   do { if((r) != NULL) {PyObject* tmp = ((PyObject*)(r)); r = NULL; __Pyx_DECREF(tmp);}} while(0)

static void __Pyx_RaiseArgtupleInvalid(const char* func_name, int exact,
    Py_ssize_t num_min, Py_ssize_t num_max, Py_ssize_t num_found);

static CYTHON_INLINE int __Pyx_CheckKeywordStrings(PyObject *kwdict, const char* function_name, int kw_allowed);

static void* __Pyx_GetVtable(PyObject *dict);

#if CYTHON_COMPILING_IN_CPYTHON
static CYTHON_INLINE PyObject* __Pyx_PyObject_GetAttrStr(PyObject* obj, PyObject* attr_name) {
    PyTypeObject* tp = Py_TYPE(obj);
    if (likely(tp->tp_getattro))
        return tp->tp_getattro(obj, attr_name);
#if PY_MAJOR_VERSION < 3
    if (likely(tp->tp_getattr))
        return tp->tp_getattr(obj, PyString_AS_STRING(attr_name));
#endif
    return PyObject_GetAttr(obj, attr_name);
}
#else
#define __Pyx_PyObject_GetAttrStr(o,n) PyObject_GetAttr(o,n)
#endif

static PyObject *__Pyx_Import(PyObject *name, PyObject *from_list, int level);

static PyObject* __Pyx_ImportFrom(PyObject* module, PyObject* name);

static PyObject *__Pyx_GetBuiltinName(PyObject *name);

static CYTHON_INLINE PyObject *__Pyx_GetModuleGlobalName(PyObject *name);

#if CYTHON_COMPILING_IN_CPYTHON
static CYTHON_INLINE PyObject* __Pyx_PyObject_Call(PyObject *func, PyObject *arg, PyObject *kw);
#else
#define __Pyx_PyObject_Call(func, arg, kw) PyObject_Call(func, arg, kw)
#endif

typedef struct {
    int code_line;
    PyCodeObject* code_object;
} __Pyx_CodeObjectCacheEntry;
struct __Pyx_CodeObjectCache {
    int count;
    int max_count;
    __Pyx_CodeObjectCacheEntry* entries;
};
static struct __Pyx_CodeObjectCache __pyx_code_cache = {0,0,NULL};
static int __pyx_bisect_code_objects(__Pyx_CodeObjectCacheEntry* entries, int count, int code_line);
static PyCodeObject *__pyx_find_code_object(int code_line);
static void __pyx_insert_code_object(int code_line, PyCodeObject* code_object);

static void __Pyx_AddTraceback(const char *funcname, int c_line,
                               int py_line, const char *filename);

static CYTHON_INLINE PyObject* __Pyx_PyInt_From_grpc_completion_type(grpc_completion_type value);

static CYTHON_INLINE PyObject* __Pyx_PyInt_From_long(long value);

static CYTHON_INLINE long __Pyx_PyInt_As_long(PyObject *);

static CYTHON_INLINE int __Pyx_PyInt_As_int(PyObject *);

static int __Pyx_check_binary_version(void);

#if !defined(__Pyx_PyIdentifier_FromString)
#if PY_MAJOR_VERSION < 3
  #define __Pyx_PyIdentifier_FromString(s) PyString_FromString(s)
#else
  #define __Pyx_PyIdentifier_FromString(s) PyUnicode_FromString(s)
#endif
#endif

static PyObject *__Pyx_ImportModule(const char *name);

static PyTypeObject *__Pyx_ImportType(const char *module_name, const char *class_name, size_t size, int strict);

static int __Pyx_InitStrings(__Pyx_StringTabEntry *t);


/* Module declarations from 'cpython.version' */

/* Module declarations from '__builtin__' */

/* Module declarations from 'cpython.type' */
static PyTypeObject *__pyx_ptype_7cpython_4type_type = 0;

/* Module declarations from 'libc.string' */

/* Module declarations from 'libc.stdio' */

/* Module declarations from 'cpython.object' */

/* Module declarations from 'cpython.ref' */

/* Module declarations from 'cpython.exc' */

/* Module declarations from 'cpython.module' */

/* Module declarations from 'cpython.mem' */

/* Module declarations from 'cpython.tuple' */

/* Module declarations from 'cpython.list' */

/* Module declarations from 'cpython.sequence' */

/* Module declarations from 'cpython.mapping' */

/* Module declarations from 'cpython.iterator' */

/* Module declarations from 'cpython.number' */

/* Module declarations from 'cpython.int' */

/* Module declarations from '__builtin__' */

/* Module declarations from 'cpython.bool' */
static PyTypeObject *__pyx_ptype_7cpython_4bool_bool = 0;

/* Module declarations from 'cpython.long' */

/* Module declarations from 'cpython.float' */

/* Module declarations from '__builtin__' */

/* Module declarations from 'cpython.complex' */
static PyTypeObject *__pyx_ptype_7cpython_7complex_complex = 0;

/* Module declarations from 'cpython.string' */

/* Module declarations from 'cpython.unicode' */

/* Module declarations from 'cpython.dict' */

/* Module declarations from 'cpython.instance' */

/* Module declarations from 'cpython.function' */

/* Module declarations from 'cpython.method' */

/* Module declarations from 'cpython.weakref' */

/* Module declarations from 'cpython.getargs' */

/* Module declarations from 'cpython.pythread' */

/* Module declarations from 'cpython.pystate' */

/* Module declarations from 'cpython.cobject' */

/* Module declarations from 'cpython.oldbuffer' */

/* Module declarations from 'cpython.set' */

/* Module declarations from 'cpython.buffer' */

/* Module declarations from 'cpython.bytes' */

/* Module declarations from 'cpython.pycapsule' */

/* Module declarations from 'cpython' */

/* Module declarations from 'grpc._cython._cygrpc' */

/* Module declarations from 'libc.stddef' */

/* Module declarations from 'libc.time' */

/* Module declarations from 'libc' */

/* Module declarations from 'grpc._cython._cygrpc.grpc' */

/* Module declarations from 'grpc._cython._cygrpc.call' */
static PyTypeObject *__pyx_ptype_4grpc_7_cython_7_cygrpc_4call_Call = 0;

/* Module declarations from 'grpc._cython._cygrpc.channel' */
static PyTypeObject *__pyx_ptype_4grpc_7_cython_7_cygrpc_7channel_Channel = 0;

/* Module declarations from 'grpc._cython._cygrpc.completion_queue' */
static PyTypeObject *__pyx_ptype_4grpc_7_cython_7_cygrpc_16completion_queue_CompletionQueue = 0;

/* Module declarations from 'grpc._cython._cygrpc.server' */
static PyTypeObject *__pyx_ptype_4grpc_7_cython_7_cygrpc_6server_Server = 0;

/* Module declarations from 'grpc._cython._cygrpc.records' */
static PyTypeObject *__pyx_ptype_4grpc_7_cython_7_cygrpc_7records_Timespec = 0;
static PyTypeObject *__pyx_ptype_4grpc_7_cython_7_cygrpc_7records_CallDetails = 0;
static PyTypeObject *__pyx_ptype_4grpc_7_cython_7_cygrpc_7records_OperationTag = 0;
static PyTypeObject *__pyx_ptype_4grpc_7_cython_7_cygrpc_7records_Event = 0;
static PyTypeObject *__pyx_ptype_4grpc_7_cython_7_cygrpc_7records_ByteBuffer = 0;
static PyTypeObject *__pyx_ptype_4grpc_7_cython_7_cygrpc_7records_SslPemKeyCertPair = 0;
static PyTypeObject *__pyx_ptype_4grpc_7_cython_7_cygrpc_7records_ChannelArg = 0;
static PyTypeObject *__pyx_ptype_4grpc_7_cython_7_cygrpc_7records_ChannelArgs = 0;
static PyTypeObject *__pyx_ptype_4grpc_7_cython_7_cygrpc_7records_Metadatum = 0;
static PyTypeObject *__pyx_ptype_4grpc_7_cython_7_cygrpc_7records_Metadata = 0;
static PyTypeObject *__pyx_ptype_4grpc_7_cython_7_cygrpc_7records_Operation = 0;
static PyTypeObject *__pyx_ptype_4grpc_7_cython_7_cygrpc_7records_Operations = 0;

/* Module declarations from 'grpc._cython._cygrpc.credentials' */
static PyTypeObject *__pyx_ptype_4grpc_7_cython_7_cygrpc_11credentials_ChannelCredentials = 0;
static PyTypeObject *__pyx_ptype_4grpc_7_cython_7_cygrpc_11credentials_CallCredentials = 0;
static PyTypeObject *__pyx_ptype_4grpc_7_cython_7_cygrpc_11credentials_ServerCredentials = 0;
static PyTypeObject *__pyx_ptype_4grpc_7_cython_7_cygrpc_11credentials_CredentialsMetadataPlugin = 0;
static PyTypeObject *__pyx_ptype_4grpc_7_cython_7_cygrpc_11credentials_AuthMetadataContext = 0;

/* Module declarations from 'grpc._cython.cygrpc' */
static PyTypeObject *__pyx_ptype_4grpc_7_cython_6cygrpc__ModuleState = 0;
#define __Pyx_MODULE_NAME "grpc._cython.cygrpc"
int __pyx_module_is_main_grpc___cython__cygrpc = 0;

/* Implementation of 'grpc._cython.cygrpc' */
static char __pyx_k_Call[] = "Call";
static char __pyx_k_call[] = "call";
static char __pyx_k_main[] = "__main__";
static char __pyx_k_test[] = "__test__";
static char __pyx_k_Event[] = "Event";
static char __pyx_k_Server[] = "Server";
static char __pyx_k_import[] = "__import__";
static char __pyx_k_server[] = "server";
static char __pyx_k_Channel[] = "Channel";
static char __pyx_k_channel[] = "channel";
static char __pyx_k_records[] = "records";
static char __pyx_k_Metadata[] = "Metadata";
static char __pyx_k_Timespec[] = "Timespec";
static char __pyx_k_CallError[] = "CallError";
static char __pyx_k_Metadatum[] = "Metadatum";
static char __pyx_k_Operation[] = "Operation";
static char __pyx_k_WriteFlag[] = "WriteFlag";
static char __pyx_k_ByteBuffer[] = "ByteBuffer";
static char __pyx_k_ChannelArg[] = "ChannelArg";
static char __pyx_k_Operations[] = "Operations";
static char __pyx_k_StatusCode[] = "StatusCode";
static char __pyx_k_pyx_vtable[] = "__pyx_vtable__";
static char __pyx_k_CallDetails[] = "CallDetails";
static char __pyx_k_ChannelArgs[] = "ChannelArgs";
static char __pyx_k_credentials[] = "credentials";
static char __pyx_k_module_state[] = "_module_state";
static char __pyx_k_ChannelArgKey[] = "ChannelArgKey";
static char __pyx_k_OperationType[] = "OperationType";
static char __pyx_k_CompletionType[] = "CompletionType";
static char __pyx_k_CallCredentials[] = "CallCredentials";
static char __pyx_k_CompletionQueue[] = "CompletionQueue";
static char __pyx_k_completion_queue[] = "completion_queue";
static char __pyx_k_ConnectivityState[] = "ConnectivityState";
static char __pyx_k_ServerCredentials[] = "ServerCredentials";
static char __pyx_k_SslPemKeyCertPair[] = "SslPemKeyCertPair";
static char __pyx_k_ChannelCredentials[] = "ChannelCredentials";
static char __pyx_k_AuthMetadataContext[] = "AuthMetadataContext";
static char __pyx_k_grpc__cython__cygrpc[] = "grpc._cython._cygrpc";
static char __pyx_k_operation_send_message[] = "operation_send_message";
static char __pyx_k_server_credentials_ssl[] = "server_credentials_ssl";
static char __pyx_k_channel_credentials_ssl[] = "channel_credentials_ssl";
static char __pyx_k_CredentialsMetadataPlugin[] = "CredentialsMetadataPlugin";
static char __pyx_k_operation_receive_message[] = "operation_receive_message";
static char __pyx_k_call_credentials_composite[] = "call_credentials_composite";
static char __pyx_k_call_credentials_google_iam[] = "call_credentials_google_iam";
static char __pyx_k_call_credentials_jwt_access[] = "call_credentials_jwt_access";
static char __pyx_k_channel_credentials_composite[] = "channel_credentials_composite";
static char __pyx_k_call_credentials_refresh_token[] = "call_credentials_refresh_token";
static char __pyx_k_call_credentials_google_compute[] = "call_credentials_google_compute_engine";
static char __pyx_k_call_credentials_google_refresh[] = "call_credentials_google_refresh_token";
static char __pyx_k_operation_send_initial_metadata[] = "operation_send_initial_metadata";
static char __pyx_k_call_credentials_metadata_plugin[] = "call_credentials_metadata_plugin";
static char __pyx_k_call_credentials_service_account[] = "call_credentials_service_account_jwt_access";
static char __pyx_k_channel_credentials_google_defau[] = "channel_credentials_google_default";
static char __pyx_k_operation_receive_close_on_serve[] = "operation_receive_close_on_server";
static char __pyx_k_operation_receive_initial_metada[] = "operation_receive_initial_metadata";
static char __pyx_k_operation_receive_status_on_clie[] = "operation_receive_status_on_client";
static char __pyx_k_operation_send_close_from_client[] = "operation_send_close_from_client";
static char __pyx_k_operation_send_status_from_serve[] = "operation_send_status_from_server";
static PyObject *__pyx_n_s_AuthMetadataContext;
static PyObject *__pyx_n_s_ByteBuffer;
static PyObject *__pyx_n_s_Call;
static PyObject *__pyx_n_s_CallCredentials;
static PyObject *__pyx_n_s_CallDetails;
static PyObject *__pyx_n_s_CallError;
static PyObject *__pyx_n_s_Channel;
static PyObject *__pyx_n_s_ChannelArg;
static PyObject *__pyx_n_s_ChannelArgKey;
static PyObject *__pyx_n_s_ChannelArgs;
static PyObject *__pyx_n_s_ChannelCredentials;
static PyObject *__pyx_n_s_CompletionQueue;
static PyObject *__pyx_n_s_CompletionType;
static PyObject *__pyx_n_s_ConnectivityState;
static PyObject *__pyx_n_s_CredentialsMetadataPlugin;
static PyObject *__pyx_n_s_Event;
static PyObject *__pyx_n_s_Metadata;
static PyObject *__pyx_n_s_Metadatum;
static PyObject *__pyx_n_s_Operation;
static PyObject *__pyx_n_s_OperationType;
static PyObject *__pyx_n_s_Operations;
static PyObject *__pyx_n_s_Server;
static PyObject *__pyx_n_s_ServerCredentials;
static PyObject *__pyx_n_s_SslPemKeyCertPair;
static PyObject *__pyx_n_s_StatusCode;
static PyObject *__pyx_n_s_Timespec;
static PyObject *__pyx_n_s_WriteFlag;
static PyObject *__pyx_n_s_call;
static PyObject *__pyx_n_s_call_credentials_composite;
static PyObject *__pyx_n_s_call_credentials_google_compute;
static PyObject *__pyx_n_s_call_credentials_google_iam;
static PyObject *__pyx_n_s_call_credentials_google_refresh;
static PyObject *__pyx_n_s_call_credentials_jwt_access;
static PyObject *__pyx_n_s_call_credentials_metadata_plugin;
static PyObject *__pyx_n_s_call_credentials_refresh_token;
static PyObject *__pyx_n_s_call_credentials_service_account;
static PyObject *__pyx_n_s_channel;
static PyObject *__pyx_n_s_channel_credentials_composite;
static PyObject *__pyx_n_s_channel_credentials_google_defau;
static PyObject *__pyx_n_s_channel_credentials_ssl;
static PyObject *__pyx_n_s_completion_queue;
static PyObject *__pyx_n_s_credentials;
static PyObject *__pyx_n_s_grpc__cython__cygrpc;
static PyObject *__pyx_n_s_import;
static PyObject *__pyx_n_s_main;
static PyObject *__pyx_n_s_module_state;
static PyObject *__pyx_n_s_operation_receive_close_on_serve;
static PyObject *__pyx_n_s_operation_receive_initial_metada;
static PyObject *__pyx_n_s_operation_receive_message;
static PyObject *__pyx_n_s_operation_receive_status_on_clie;
static PyObject *__pyx_n_s_operation_send_close_from_client;
static PyObject *__pyx_n_s_operation_send_initial_metadata;
static PyObject *__pyx_n_s_operation_send_message;
static PyObject *__pyx_n_s_operation_send_status_from_serve;
static PyObject *__pyx_n_s_pyx_vtable;
static PyObject *__pyx_n_s_records;
static PyObject *__pyx_n_s_server;
static PyObject *__pyx_n_s_server_credentials_ssl;
static PyObject *__pyx_n_s_test;
static int __pyx_pf_4grpc_7_cython_6cygrpc_12_ModuleState___cinit__(CYTHON_UNUSED struct __pyx_obj_4grpc_7_cython_6cygrpc__ModuleState *__pyx_v_self); /* proto */
static void __pyx_pf_4grpc_7_cython_6cygrpc_12_ModuleState_2__dealloc__(CYTHON_UNUSED struct __pyx_obj_4grpc_7_cython_6cygrpc__ModuleState *__pyx_v_self); /* proto */
static PyObject *__pyx_tp_new_4grpc_7_cython_6cygrpc__ModuleState(PyTypeObject *t, PyObject *a, PyObject *k); /*proto*/

/* "grpc/_cython/cygrpc.pyx":111
 * cdef class _ModuleState:
 * 
 *   def __cinit__(self):             # <<<<<<<<<<<<<<
 *     grpc.grpc_init()
 * 
 */

/* Python wrapper */
static int __pyx_pw_4grpc_7_cython_6cygrpc_12_ModuleState_1__cinit__(PyObject *__pyx_v_self, PyObject *__pyx_args, PyObject *__pyx_kwds); /*proto*/
static int __pyx_pw_4grpc_7_cython_6cygrpc_12_ModuleState_1__cinit__(PyObject *__pyx_v_self, PyObject *__pyx_args, PyObject *__pyx_kwds) {
  int __pyx_r;
  __Pyx_RefNannyDeclarations
  __Pyx_RefNannySetupContext("__cinit__ (wrapper)", 0);
  if (unlikely(PyTuple_GET_SIZE(__pyx_args) > 0)) {
    __Pyx_RaiseArgtupleInvalid("__cinit__", 1, 0, 0, PyTuple_GET_SIZE(__pyx_args)); return -1;}
  if (unlikely(__pyx_kwds) && unlikely(PyDict_Size(__pyx_kwds) > 0) && unlikely(!__Pyx_CheckKeywordStrings(__pyx_kwds, "__cinit__", 0))) return -1;
  __pyx_r = __pyx_pf_4grpc_7_cython_6cygrpc_12_ModuleState___cinit__(((struct __pyx_obj_4grpc_7_cython_6cygrpc__ModuleState *)__pyx_v_self));

  /* function exit code */
  __Pyx_RefNannyFinishContext();
  return __pyx_r;
}

static int __pyx_pf_4grpc_7_cython_6cygrpc_12_ModuleState___cinit__(CYTHON_UNUSED struct __pyx_obj_4grpc_7_cython_6cygrpc__ModuleState *__pyx_v_self) {
  int __pyx_r;
  __Pyx_RefNannyDeclarations
  __Pyx_RefNannySetupContext("__cinit__", 0);

  /* "grpc/_cython/cygrpc.pyx":112
 * 
 *   def __cinit__(self):
 *     grpc.grpc_init()             # <<<<<<<<<<<<<<
 * 
 *   def __dealloc__(self):
 */
  grpc_init();

  /* "grpc/_cython/cygrpc.pyx":111
 * cdef class _ModuleState:
 * 
 *   def __cinit__(self):             # <<<<<<<<<<<<<<
 *     grpc.grpc_init()
 * 
 */

  /* function exit code */
  __pyx_r = 0;
  __Pyx_RefNannyFinishContext();
  return __pyx_r;
}

/* "grpc/_cython/cygrpc.pyx":114
 *     grpc.grpc_init()
 * 
 *   def __dealloc__(self):             # <<<<<<<<<<<<<<
 *     grpc.grpc_shutdown()
 * 
 */

/* Python wrapper */
static void __pyx_pw_4grpc_7_cython_6cygrpc_12_ModuleState_3__dealloc__(PyObject *__pyx_v_self); /*proto*/
static void __pyx_pw_4grpc_7_cython_6cygrpc_12_ModuleState_3__dealloc__(PyObject *__pyx_v_self) {
  __Pyx_RefNannyDeclarations
  __Pyx_RefNannySetupContext("__dealloc__ (wrapper)", 0);
  __pyx_pf_4grpc_7_cython_6cygrpc_12_ModuleState_2__dealloc__(((struct __pyx_obj_4grpc_7_cython_6cygrpc__ModuleState *)__pyx_v_self));

  /* function exit code */
  __Pyx_RefNannyFinishContext();
}

static void __pyx_pf_4grpc_7_cython_6cygrpc_12_ModuleState_2__dealloc__(CYTHON_UNUSED struct __pyx_obj_4grpc_7_cython_6cygrpc__ModuleState *__pyx_v_self) {
  __Pyx_RefNannyDeclarations
  __Pyx_RefNannySetupContext("__dealloc__", 0);

  /* "grpc/_cython/cygrpc.pyx":115
 * 
 *   def __dealloc__(self):
 *     grpc.grpc_shutdown()             # <<<<<<<<<<<<<<
 * 
 * _module_state = _ModuleState()
 */
  grpc_shutdown();

  /* "grpc/_cython/cygrpc.pyx":114
 *     grpc.grpc_init()
 * 
 *   def __dealloc__(self):             # <<<<<<<<<<<<<<
 *     grpc.grpc_shutdown()
 * 
 */

  /* function exit code */
  __Pyx_RefNannyFinishContext();
}

static PyObject *__pyx_tp_new_4grpc_7_cython_6cygrpc__ModuleState(PyTypeObject *t, CYTHON_UNUSED PyObject *a, CYTHON_UNUSED PyObject *k) {
  PyObject *o;
  if (likely((t->tp_flags & Py_TPFLAGS_IS_ABSTRACT) == 0)) {
    o = (*t->tp_alloc)(t, 0);
  } else {
    o = (PyObject *) PyBaseObject_Type.tp_new(t, __pyx_empty_tuple, 0);
  }
  if (unlikely(!o)) return 0;
  if (unlikely(__pyx_pw_4grpc_7_cython_6cygrpc_12_ModuleState_1__cinit__(o, __pyx_empty_tuple, NULL) < 0)) {
    Py_DECREF(o); o = 0;
  }
  return o;
}

static void __pyx_tp_dealloc_4grpc_7_cython_6cygrpc__ModuleState(PyObject *o) {
  #if PY_VERSION_HEX >= 0x030400a1
  if (unlikely(Py_TYPE(o)->tp_finalize) && (!PyType_IS_GC(Py_TYPE(o)) || !_PyGC_FINALIZED(o))) {
    if (PyObject_CallFinalizerFromDealloc(o)) return;
  }
  #endif
  {
    PyObject *etype, *eval, *etb;
    PyErr_Fetch(&etype, &eval, &etb);
    ++Py_REFCNT(o);
    __pyx_pw_4grpc_7_cython_6cygrpc_12_ModuleState_3__dealloc__(o);
    --Py_REFCNT(o);
    PyErr_Restore(etype, eval, etb);
  }
  (*Py_TYPE(o)->tp_free)(o);
}

static PyMethodDef __pyx_methods_4grpc_7_cython_6cygrpc__ModuleState[] = {
  {0, 0, 0, 0}
};

static PyTypeObject __pyx_type_4grpc_7_cython_6cygrpc__ModuleState = {
  PyVarObject_HEAD_INIT(0, 0)
  "grpc._cython.cygrpc._ModuleState", /*tp_name*/
  sizeof(struct __pyx_obj_4grpc_7_cython_6cygrpc__ModuleState), /*tp_basicsize*/
  0, /*tp_itemsize*/
  __pyx_tp_dealloc_4grpc_7_cython_6cygrpc__ModuleState, /*tp_dealloc*/
  0, /*tp_print*/
  0, /*tp_getattr*/
  0, /*tp_setattr*/
  #if PY_MAJOR_VERSION < 3
  0, /*tp_compare*/
  #endif
  #if PY_MAJOR_VERSION >= 3
  0, /*tp_as_async*/
  #endif
  0, /*tp_repr*/
  0, /*tp_as_number*/
  0, /*tp_as_sequence*/
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  0, /*tp_as_buffer*/
  Py_TPFLAGS_DEFAULT|Py_TPFLAGS_HAVE_VERSION_TAG|Py_TPFLAGS_CHECKTYPES|Py_TPFLAGS_HAVE_NEWBUFFER|Py_TPFLAGS_BASETYPE, /*tp_flags*/
  0, /*tp_doc*/
  0, /*tp_traverse*/
  0, /*tp_clear*/
  0, /*tp_richcompare*/
  0, /*tp_weaklistoffset*/
  0, /*tp_iter*/
  0, /*tp_iternext*/
  __pyx_methods_4grpc_7_cython_6cygrpc__ModuleState, /*tp_methods*/
  0, /*tp_members*/
  0, /*tp_getset*/
  0, /*tp_base*/
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  0, /*tp_alloc*/
  __pyx_tp_new_4grpc_7_cython_6cygrpc__ModuleState, /*tp_new*/
  0, /*tp_free*/
  0, /*tp_is_gc*/
  0, /*tp_bases*/
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  0, /*tp_version_tag*/
  #if PY_VERSION_HEX >= 0x030400a1
  0, /*tp_finalize*/
  #endif
};

static PyMethodDef __pyx_methods[] = {
  {0, 0, 0, 0}
};

#if PY_MAJOR_VERSION >= 3
static struct PyModuleDef __pyx_moduledef = {
  #if PY_VERSION_HEX < 0x03020000
    { PyObject_HEAD_INIT(NULL) NULL, 0, NULL },
  #else
    PyModuleDef_HEAD_INIT,
  #endif
    "cygrpc",
    0, /* m_doc */
    -1, /* m_size */
    __pyx_methods /* m_methods */,
    NULL, /* m_reload */
    NULL, /* m_traverse */
    NULL, /* m_clear */
    NULL /* m_free */
};
#endif

static __Pyx_StringTabEntry __pyx_string_tab[] = {
  {&__pyx_n_s_AuthMetadataContext, __pyx_k_AuthMetadataContext, sizeof(__pyx_k_AuthMetadataContext), 0, 0, 1, 1},
  {&__pyx_n_s_ByteBuffer, __pyx_k_ByteBuffer, sizeof(__pyx_k_ByteBuffer), 0, 0, 1, 1},
  {&__pyx_n_s_Call, __pyx_k_Call, sizeof(__pyx_k_Call), 0, 0, 1, 1},
  {&__pyx_n_s_CallCredentials, __pyx_k_CallCredentials, sizeof(__pyx_k_CallCredentials), 0, 0, 1, 1},
  {&__pyx_n_s_CallDetails, __pyx_k_CallDetails, sizeof(__pyx_k_CallDetails), 0, 0, 1, 1},
  {&__pyx_n_s_CallError, __pyx_k_CallError, sizeof(__pyx_k_CallError), 0, 0, 1, 1},
  {&__pyx_n_s_Channel, __pyx_k_Channel, sizeof(__pyx_k_Channel), 0, 0, 1, 1},
  {&__pyx_n_s_ChannelArg, __pyx_k_ChannelArg, sizeof(__pyx_k_ChannelArg), 0, 0, 1, 1},
  {&__pyx_n_s_ChannelArgKey, __pyx_k_ChannelArgKey, sizeof(__pyx_k_ChannelArgKey), 0, 0, 1, 1},
  {&__pyx_n_s_ChannelArgs, __pyx_k_ChannelArgs, sizeof(__pyx_k_ChannelArgs), 0, 0, 1, 1},
  {&__pyx_n_s_ChannelCredentials, __pyx_k_ChannelCredentials, sizeof(__pyx_k_ChannelCredentials), 0, 0, 1, 1},
  {&__pyx_n_s_CompletionQueue, __pyx_k_CompletionQueue, sizeof(__pyx_k_CompletionQueue), 0, 0, 1, 1},
  {&__pyx_n_s_CompletionType, __pyx_k_CompletionType, sizeof(__pyx_k_CompletionType), 0, 0, 1, 1},
  {&__pyx_n_s_ConnectivityState, __pyx_k_ConnectivityState, sizeof(__pyx_k_ConnectivityState), 0, 0, 1, 1},
  {&__pyx_n_s_CredentialsMetadataPlugin, __pyx_k_CredentialsMetadataPlugin, sizeof(__pyx_k_CredentialsMetadataPlugin), 0, 0, 1, 1},
  {&__pyx_n_s_Event, __pyx_k_Event, sizeof(__pyx_k_Event), 0, 0, 1, 1},
  {&__pyx_n_s_Metadata, __pyx_k_Metadata, sizeof(__pyx_k_Metadata), 0, 0, 1, 1},
  {&__pyx_n_s_Metadatum, __pyx_k_Metadatum, sizeof(__pyx_k_Metadatum), 0, 0, 1, 1},
  {&__pyx_n_s_Operation, __pyx_k_Operation, sizeof(__pyx_k_Operation), 0, 0, 1, 1},
  {&__pyx_n_s_OperationType, __pyx_k_OperationType, sizeof(__pyx_k_OperationType), 0, 0, 1, 1},
  {&__pyx_n_s_Operations, __pyx_k_Operations, sizeof(__pyx_k_Operations), 0, 0, 1, 1},
  {&__pyx_n_s_Server, __pyx_k_Server, sizeof(__pyx_k_Server), 0, 0, 1, 1},
  {&__pyx_n_s_ServerCredentials, __pyx_k_ServerCredentials, sizeof(__pyx_k_ServerCredentials), 0, 0, 1, 1},
  {&__pyx_n_s_SslPemKeyCertPair, __pyx_k_SslPemKeyCertPair, sizeof(__pyx_k_SslPemKeyCertPair), 0, 0, 1, 1},
  {&__pyx_n_s_StatusCode, __pyx_k_StatusCode, sizeof(__pyx_k_StatusCode), 0, 0, 1, 1},
  {&__pyx_n_s_Timespec, __pyx_k_Timespec, sizeof(__pyx_k_Timespec), 0, 0, 1, 1},
  {&__pyx_n_s_WriteFlag, __pyx_k_WriteFlag, sizeof(__pyx_k_WriteFlag), 0, 0, 1, 1},
  {&__pyx_n_s_call, __pyx_k_call, sizeof(__pyx_k_call), 0, 0, 1, 1},
  {&__pyx_n_s_call_credentials_composite, __pyx_k_call_credentials_composite, sizeof(__pyx_k_call_credentials_composite), 0, 0, 1, 1},
  {&__pyx_n_s_call_credentials_google_compute, __pyx_k_call_credentials_google_compute, sizeof(__pyx_k_call_credentials_google_compute), 0, 0, 1, 1},
  {&__pyx_n_s_call_credentials_google_iam, __pyx_k_call_credentials_google_iam, sizeof(__pyx_k_call_credentials_google_iam), 0, 0, 1, 1},
  {&__pyx_n_s_call_credentials_google_refresh, __pyx_k_call_credentials_google_refresh, sizeof(__pyx_k_call_credentials_google_refresh), 0, 0, 1, 1},
  {&__pyx_n_s_call_credentials_jwt_access, __pyx_k_call_credentials_jwt_access, sizeof(__pyx_k_call_credentials_jwt_access), 0, 0, 1, 1},
  {&__pyx_n_s_call_credentials_metadata_plugin, __pyx_k_call_credentials_metadata_plugin, sizeof(__pyx_k_call_credentials_metadata_plugin), 0, 0, 1, 1},
  {&__pyx_n_s_call_credentials_refresh_token, __pyx_k_call_credentials_refresh_token, sizeof(__pyx_k_call_credentials_refresh_token), 0, 0, 1, 1},
  {&__pyx_n_s_call_credentials_service_account, __pyx_k_call_credentials_service_account, sizeof(__pyx_k_call_credentials_service_account), 0, 0, 1, 1},
  {&__pyx_n_s_channel, __pyx_k_channel, sizeof(__pyx_k_channel), 0, 0, 1, 1},
  {&__pyx_n_s_channel_credentials_composite, __pyx_k_channel_credentials_composite, sizeof(__pyx_k_channel_credentials_composite), 0, 0, 1, 1},
  {&__pyx_n_s_channel_credentials_google_defau, __pyx_k_channel_credentials_google_defau, sizeof(__pyx_k_channel_credentials_google_defau), 0, 0, 1, 1},
  {&__pyx_n_s_channel_credentials_ssl, __pyx_k_channel_credentials_ssl, sizeof(__pyx_k_channel_credentials_ssl), 0, 0, 1, 1},
  {&__pyx_n_s_completion_queue, __pyx_k_completion_queue, sizeof(__pyx_k_completion_queue), 0, 0, 1, 1},
  {&__pyx_n_s_credentials, __pyx_k_credentials, sizeof(__pyx_k_credentials), 0, 0, 1, 1},
  {&__pyx_n_s_grpc__cython__cygrpc, __pyx_k_grpc__cython__cygrpc, sizeof(__pyx_k_grpc__cython__cygrpc), 0, 0, 1, 1},
  {&__pyx_n_s_import, __pyx_k_import, sizeof(__pyx_k_import), 0, 0, 1, 1},
  {&__pyx_n_s_main, __pyx_k_main, sizeof(__pyx_k_main), 0, 0, 1, 1},
  {&__pyx_n_s_module_state, __pyx_k_module_state, sizeof(__pyx_k_module_state), 0, 0, 1, 1},
  {&__pyx_n_s_operation_receive_close_on_serve, __pyx_k_operation_receive_close_on_serve, sizeof(__pyx_k_operation_receive_close_on_serve), 0, 0, 1, 1},
  {&__pyx_n_s_operation_receive_initial_metada, __pyx_k_operation_receive_initial_metada, sizeof(__pyx_k_operation_receive_initial_metada), 0, 0, 1, 1},
  {&__pyx_n_s_operation_receive_message, __pyx_k_operation_receive_message, sizeof(__pyx_k_operation_receive_message), 0, 0, 1, 1},
  {&__pyx_n_s_operation_receive_status_on_clie, __pyx_k_operation_receive_status_on_clie, sizeof(__pyx_k_operation_receive_status_on_clie), 0, 0, 1, 1},
  {&__pyx_n_s_operation_send_close_from_client, __pyx_k_operation_send_close_from_client, sizeof(__pyx_k_operation_send_close_from_client), 0, 0, 1, 1},
  {&__pyx_n_s_operation_send_initial_metadata, __pyx_k_operation_send_initial_metadata, sizeof(__pyx_k_operation_send_initial_metadata), 0, 0, 1, 1},
  {&__pyx_n_s_operation_send_message, __pyx_k_operation_send_message, sizeof(__pyx_k_operation_send_message), 0, 0, 1, 1},
  {&__pyx_n_s_operation_send_status_from_serve, __pyx_k_operation_send_status_from_serve, sizeof(__pyx_k_operation_send_status_from_serve), 0, 0, 1, 1},
  {&__pyx_n_s_pyx_vtable, __pyx_k_pyx_vtable, sizeof(__pyx_k_pyx_vtable), 0, 0, 1, 1},
  {&__pyx_n_s_records, __pyx_k_records, sizeof(__pyx_k_records), 0, 0, 1, 1},
  {&__pyx_n_s_server, __pyx_k_server, sizeof(__pyx_k_server), 0, 0, 1, 1},
  {&__pyx_n_s_server_credentials_ssl, __pyx_k_server_credentials_ssl, sizeof(__pyx_k_server_credentials_ssl), 0, 0, 1, 1},
  {&__pyx_n_s_test, __pyx_k_test, sizeof(__pyx_k_test), 0, 0, 1, 1},
  {0, 0, 0, 0, 0, 0, 0}
};
static int __Pyx_InitCachedBuiltins(void) {
  return 0;
}

static int __Pyx_InitCachedConstants(void) {
  __Pyx_RefNannyDeclarations
  __Pyx_RefNannySetupContext("__Pyx_InitCachedConstants", 0);
  __Pyx_RefNannyFinishContext();
  return 0;
}

static int __Pyx_InitGlobals(void) {
  if (__Pyx_InitStrings(__pyx_string_tab) < 0) {__pyx_filename = __pyx_f[0]; __pyx_lineno = 1; __pyx_clineno = __LINE__; goto __pyx_L1_error;};
  return 0;
  __pyx_L1_error:;
  return -1;
}

#if PY_MAJOR_VERSION < 3
PyMODINIT_FUNC initcygrpc(void); /*proto*/
PyMODINIT_FUNC initcygrpc(void)
#else
PyMODINIT_FUNC PyInit_cygrpc(void); /*proto*/
PyMODINIT_FUNC PyInit_cygrpc(void)
#endif
{
  PyObject *__pyx_t_1 = NULL;
  PyObject *__pyx_t_2 = NULL;
  int __pyx_lineno = 0;
  const char *__pyx_filename = NULL;
  int __pyx_clineno = 0;
  __Pyx_RefNannyDeclarations
  #if CYTHON_REFNANNY
  __Pyx_RefNanny = __Pyx_RefNannyImportAPI("refnanny");
  if (!__Pyx_RefNanny) {
      PyErr_Clear();
      __Pyx_RefNanny = __Pyx_RefNannyImportAPI("Cython.Runtime.refnanny");
      if (!__Pyx_RefNanny)
          Py_FatalError("failed to import 'refnanny' module");
  }
  #endif
  __Pyx_RefNannySetupContext("PyMODINIT_FUNC PyInit_cygrpc(void)", 0);
  if (__Pyx_check_binary_version() < 0) {__pyx_filename = __pyx_f[0]; __pyx_lineno = 1; __pyx_clineno = __LINE__; goto __pyx_L1_error;}
  __pyx_empty_tuple = PyTuple_New(0); if (unlikely(!__pyx_empty_tuple)) {__pyx_filename = __pyx_f[0]; __pyx_lineno = 1; __pyx_clineno = __LINE__; goto __pyx_L1_error;}
  __pyx_empty_bytes = PyBytes_FromStringAndSize("", 0); if (unlikely(!__pyx_empty_bytes)) {__pyx_filename = __pyx_f[0]; __pyx_lineno = 1; __pyx_clineno = __LINE__; goto __pyx_L1_error;}
  #ifdef __Pyx_CyFunction_USED
  if (__pyx_CyFunction_init() < 0) {__pyx_filename = __pyx_f[0]; __pyx_lineno = 1; __pyx_clineno = __LINE__; goto __pyx_L1_error;}
  #endif
  #ifdef __Pyx_FusedFunction_USED
  if (__pyx_FusedFunction_init() < 0) {__pyx_filename = __pyx_f[0]; __pyx_lineno = 1; __pyx_clineno = __LINE__; goto __pyx_L1_error;}
  #endif
  #ifdef __Pyx_Coroutine_USED
  if (__pyx_Coroutine_init() < 0) {__pyx_filename = __pyx_f[0]; __pyx_lineno = 1; __pyx_clineno = __LINE__; goto __pyx_L1_error;}
  #endif
  #ifdef __Pyx_Generator_USED
  if (__pyx_Generator_init() < 0) {__pyx_filename = __pyx_f[0]; __pyx_lineno = 1; __pyx_clineno = __LINE__; goto __pyx_L1_error;}
  #endif
  #ifdef __Pyx_StopAsyncIteration_USED
  if (__pyx_StopAsyncIteration_init() < 0) {__pyx_filename = __pyx_f[0]; __pyx_lineno = 1; __pyx_clineno = __LINE__; goto __pyx_L1_error;}
  #endif
  /*--- Library function declarations ---*/
  /*--- Threads initialization code ---*/
  #if defined(__PYX_FORCE_INIT_THREADS) && __PYX_FORCE_INIT_THREADS
  #ifdef WITH_THREAD /* Python build with threading support? */
  PyEval_InitThreads();
  #endif
  #endif
  /*--- Module creation code ---*/
  #if PY_MAJOR_VERSION < 3
  __pyx_m = Py_InitModule4("cygrpc", __pyx_methods, 0, 0, PYTHON_API_VERSION); Py_XINCREF(__pyx_m);
  #else
  __pyx_m = PyModule_Create(&__pyx_moduledef);
  #endif
  if (unlikely(!__pyx_m)) {__pyx_filename = __pyx_f[0]; __pyx_lineno = 1; __pyx_clineno = __LINE__; goto __pyx_L1_error;}
  __pyx_d = PyModule_GetDict(__pyx_m); if (unlikely(!__pyx_d)) {__pyx_filename = __pyx_f[0]; __pyx_lineno = 1; __pyx_clineno = __LINE__; goto __pyx_L1_error;}
  Py_INCREF(__pyx_d);
  __pyx_b = PyImport_AddModule(__Pyx_BUILTIN_MODULE_NAME); if (unlikely(!__pyx_b)) {__pyx_filename = __pyx_f[0]; __pyx_lineno = 1; __pyx_clineno = __LINE__; goto __pyx_L1_error;}
  #if CYTHON_COMPILING_IN_PYPY
  Py_INCREF(__pyx_b);
  #endif
  if (PyObject_SetAttrString(__pyx_m, "__builtins__", __pyx_b) < 0) {__pyx_filename = __pyx_f[0]; __pyx_lineno = 1; __pyx_clineno = __LINE__; goto __pyx_L1_error;};
  /*--- Initialize various global constants etc. ---*/
  if (__Pyx_InitGlobals() < 0) {__pyx_filename = __pyx_f[0]; __pyx_lineno = 1; __pyx_clineno = __LINE__; goto __pyx_L1_error;}
  #if PY_MAJOR_VERSION < 3 && (__PYX_DEFAULT_STRING_ENCODING_IS_ASCII || __PYX_DEFAULT_STRING_ENCODING_IS_DEFAULT)
  if (__Pyx_init_sys_getdefaultencoding_params() < 0) {__pyx_filename = __pyx_f[0]; __pyx_lineno = 1; __pyx_clineno = __LINE__; goto __pyx_L1_error;}
  #endif
  if (__pyx_module_is_main_grpc___cython__cygrpc) {
    if (PyObject_SetAttrString(__pyx_m, "__name__", __pyx_n_s_main) < 0) {__pyx_filename = __pyx_f[0]; __pyx_lineno = 1; __pyx_clineno = __LINE__; goto __pyx_L1_error;}
  }
  #if PY_MAJOR_VERSION >= 3
  {
    PyObject *modules = PyImport_GetModuleDict(); if (unlikely(!modules)) {__pyx_filename = __pyx_f[0]; __pyx_lineno = 1; __pyx_clineno = __LINE__; goto __pyx_L1_error;}
    if (!PyDict_GetItemString(modules, "grpc._cython.cygrpc")) {
      if (unlikely(PyDict_SetItemString(modules, "grpc._cython.cygrpc", __pyx_m) < 0)) {__pyx_filename = __pyx_f[0]; __pyx_lineno = 1; __pyx_clineno = __LINE__; goto __pyx_L1_error;}
    }
  }
  #endif
  /*--- Builtin init code ---*/
  if (__Pyx_InitCachedBuiltins() < 0) {__pyx_filename = __pyx_f[0]; __pyx_lineno = 1; __pyx_clineno = __LINE__; goto __pyx_L1_error;}
  /*--- Constants init code ---*/
  if (__Pyx_InitCachedConstants() < 0) {__pyx_filename = __pyx_f[0]; __pyx_lineno = 1; __pyx_clineno = __LINE__; goto __pyx_L1_error;}
  /*--- Global init code ---*/
  /*--- Variable export code ---*/
  /*--- Function export code ---*/
  /*--- Type init code ---*/
  if (PyType_Ready(&__pyx_type_4grpc_7_cython_6cygrpc__ModuleState) < 0) {__pyx_filename = __pyx_f[0]; __pyx_lineno = 109; __pyx_clineno = __LINE__; goto __pyx_L1_error;}
  __pyx_type_4grpc_7_cython_6cygrpc__ModuleState.tp_print = 0;
  if (PyObject_SetAttrString(__pyx_m, "_ModuleState", (PyObject *)&__pyx_type_4grpc_7_cython_6cygrpc__ModuleState) < 0) {__pyx_filename = __pyx_f[0]; __pyx_lineno = 109; __pyx_clineno = __LINE__; goto __pyx_L1_error;}
  __pyx_ptype_4grpc_7_cython_6cygrpc__ModuleState = &__pyx_type_4grpc_7_cython_6cygrpc__ModuleState;
  /*--- Type import code ---*/
  __pyx_ptype_7cpython_4type_type = __Pyx_ImportType(__Pyx_BUILTIN_MODULE_NAME, "type", 
  #if CYTHON_COMPILING_IN_PYPY
  sizeof(PyTypeObject),
  #else
  sizeof(PyHeapTypeObject),
  #endif
  0); if (unlikely(!__pyx_ptype_7cpython_4type_type)) {__pyx_filename = __pyx_f[1]; __pyx_lineno = 9; __pyx_clineno = __LINE__; goto __pyx_L1_error;}
  __pyx_ptype_7cpython_4bool_bool = __Pyx_ImportType(__Pyx_BUILTIN_MODULE_NAME, "bool", sizeof(PyBoolObject), 0); if (unlikely(!__pyx_ptype_7cpython_4bool_bool)) {__pyx_filename = __pyx_f[2]; __pyx_lineno = 8; __pyx_clineno = __LINE__; goto __pyx_L1_error;}
  __pyx_ptype_7cpython_7complex_complex = __Pyx_ImportType(__Pyx_BUILTIN_MODULE_NAME, "complex", sizeof(PyComplexObject), 0); if (unlikely(!__pyx_ptype_7cpython_7complex_complex)) {__pyx_filename = __pyx_f[3]; __pyx_lineno = 15; __pyx_clineno = __LINE__; goto __pyx_L1_error;}
  __pyx_ptype_4grpc_7_cython_7_cygrpc_4call_Call = __Pyx_ImportType("grpc._cython._cygrpc.call", "Call", sizeof(struct __pyx_obj_4grpc_7_cython_7_cygrpc_4call_Call), 1); if (unlikely(!__pyx_ptype_4grpc_7_cython_7_cygrpc_4call_Call)) {__pyx_filename = __pyx_f[4]; __pyx_lineno = 33; __pyx_clineno = __LINE__; goto __pyx_L1_error;}
  __pyx_ptype_4grpc_7_cython_7_cygrpc_7channel_Channel = __Pyx_ImportType("grpc._cython._cygrpc.channel", "Channel", sizeof(struct __pyx_obj_4grpc_7_cython_7_cygrpc_7channel_Channel), 1); if (unlikely(!__pyx_ptype_4grpc_7_cython_7_cygrpc_7channel_Channel)) {__pyx_filename = __pyx_f[5]; __pyx_lineno = 33; __pyx_clineno = __LINE__; goto __pyx_L1_error;}
  __pyx_ptype_4grpc_7_cython_7_cygrpc_16completion_queue_CompletionQueue = __Pyx_ImportType("grpc._cython._cygrpc.completion_queue", "CompletionQueue", sizeof(struct __pyx_obj_4grpc_7_cython_7_cygrpc_16completion_queue_CompletionQueue), 1); if (unlikely(!__pyx_ptype_4grpc_7_cython_7_cygrpc_16completion_queue_CompletionQueue)) {__pyx_filename = __pyx_f[6]; __pyx_lineno = 33; __pyx_clineno = __LINE__; goto __pyx_L1_error;}
  __pyx_ptype_4grpc_7_cython_7_cygrpc_6server_Server = __Pyx_ImportType("grpc._cython._cygrpc.server", "Server", sizeof(struct __pyx_obj_4grpc_7_cython_7_cygrpc_6server_Server), 1); if (unlikely(!__pyx_ptype_4grpc_7_cython_7_cygrpc_6server_Server)) {__pyx_filename = __pyx_f[7]; __pyx_lineno = 34; __pyx_clineno = __LINE__; goto __pyx_L1_error;}
  __pyx_vtabptr_4grpc_7_cython_7_cygrpc_6server_Server = (struct __pyx_vtabstruct_4grpc_7_cython_7_cygrpc_6server_Server*)__Pyx_GetVtable(__pyx_ptype_4grpc_7_cython_7_cygrpc_6server_Server->tp_dict); if (unlikely(!__pyx_vtabptr_4grpc_7_cython_7_cygrpc_6server_Server)) {__pyx_filename = __pyx_f[7]; __pyx_lineno = 34; __pyx_clineno = __LINE__; goto __pyx_L1_error;}
  __pyx_ptype_4grpc_7_cython_7_cygrpc_7records_Timespec = __Pyx_ImportType("grpc._cython._cygrpc.records", "Timespec", sizeof(struct __pyx_obj_4grpc_7_cython_7_cygrpc_7records_Timespec), 1); if (unlikely(!__pyx_ptype_4grpc_7_cython_7_cygrpc_7records_Timespec)) {__pyx_filename = __pyx_f[8]; __pyx_lineno = 35; __pyx_clineno = __LINE__; goto __pyx_L1_error;}
  __pyx_ptype_4grpc_7_cython_7_cygrpc_7records_CallDetails = __Pyx_ImportType("grpc._cython._cygrpc.records", "CallDetails", sizeof(struct __pyx_obj_4grpc_7_cython_7_cygrpc_7records_CallDetails), 1); if (unlikely(!__pyx_ptype_4grpc_7_cython_7_cygrpc_7records_CallDetails)) {__pyx_filename = __pyx_f[8]; __pyx_lineno = 40; __pyx_clineno = __LINE__; goto __pyx_L1_error;}
  __pyx_ptype_4grpc_7_cython_7_cygrpc_7records_OperationTag = __Pyx_ImportType("grpc._cython._cygrpc.records", "OperationTag", sizeof(struct __pyx_obj_4grpc_7_cython_7_cygrpc_7records_OperationTag), 1); if (unlikely(!__pyx_ptype_4grpc_7_cython_7_cygrpc_7records_OperationTag)) {__pyx_filename = __pyx_f[8]; __pyx_lineno = 45; __pyx_clineno = __LINE__; goto __pyx_L1_error;}
  __pyx_ptype_4grpc_7_cython_7_cygrpc_7records_Event = __Pyx_ImportType("grpc._cython._cygrpc.records", "Event", sizeof(struct __pyx_obj_4grpc_7_cython_7_cygrpc_7records_Event), 1); if (unlikely(!__pyx_ptype_4grpc_7_cython_7_cygrpc_7records_Event)) {__pyx_filename = __pyx_f[8]; __pyx_lineno = 59; __pyx_clineno = __LINE__; goto __pyx_L1_error;}
  __pyx_ptype_4grpc_7_cython_7_cygrpc_7records_ByteBuffer = __Pyx_ImportType("grpc._cython._cygrpc.records", "ByteBuffer", sizeof(struct __pyx_obj_4grpc_7_cython_7_cygrpc_7records_ByteBuffer), 1); if (unlikely(!__pyx_ptype_4grpc_7_cython_7_cygrpc_7records_ByteBuffer)) {__pyx_filename = __pyx_f[8]; __pyx_lineno = 77; __pyx_clineno = __LINE__; goto __pyx_L1_error;}
  __pyx_ptype_4grpc_7_cython_7_cygrpc_7records_SslPemKeyCertPair = __Pyx_ImportType("grpc._cython._cygrpc.records", "SslPemKeyCertPair", sizeof(struct __pyx_obj_4grpc_7_cython_7_cygrpc_7records_SslPemKeyCertPair), 1); if (unlikely(!__pyx_ptype_4grpc_7_cython_7_cygrpc_7records_SslPemKeyCertPair)) {__pyx_filename = __pyx_f[8]; __pyx_lineno = 82; __pyx_clineno = __LINE__; goto __pyx_L1_error;}
  __pyx_ptype_4grpc_7_cython_7_cygrpc_7records_ChannelArg = __Pyx_ImportType("grpc._cython._cygrpc.records", "ChannelArg", sizeof(struct __pyx_obj_4grpc_7_cython_7_cygrpc_7records_ChannelArg), 1); if (unlikely(!__pyx_ptype_4grpc_7_cython_7_cygrpc_7records_ChannelArg)) {__pyx_filename = __pyx_f[8]; __pyx_lineno = 88; __pyx_clineno = __LINE__; goto __pyx_L1_error;}
  __pyx_ptype_4grpc_7_cython_7_cygrpc_7records_ChannelArgs = __Pyx_ImportType("grpc._cython._cygrpc.records", "ChannelArgs", sizeof(struct __pyx_obj_4grpc_7_cython_7_cygrpc_7records_ChannelArgs), 1); if (unlikely(!__pyx_ptype_4grpc_7_cython_7_cygrpc_7records_ChannelArgs)) {__pyx_filename = __pyx_f[8]; __pyx_lineno = 94; __pyx_clineno = __LINE__; goto __pyx_L1_error;}
  __pyx_ptype_4grpc_7_cython_7_cygrpc_7records_Metadatum = __Pyx_ImportType("grpc._cython._cygrpc.records", "Metadatum", sizeof(struct __pyx_obj_4grpc_7_cython_7_cygrpc_7records_Metadatum), 1); if (unlikely(!__pyx_ptype_4grpc_7_cython_7_cygrpc_7records_Metadatum)) {__pyx_filename = __pyx_f[8]; __pyx_lineno = 100; __pyx_clineno = __LINE__; goto __pyx_L1_error;}
  __pyx_ptype_4grpc_7_cython_7_cygrpc_7records_Metadata = __Pyx_ImportType("grpc._cython._cygrpc.records", "Metadata", sizeof(struct __pyx_obj_4grpc_7_cython_7_cygrpc_7records_Metadata), 1); if (unlikely(!__pyx_ptype_4grpc_7_cython_7_cygrpc_7records_Metadata)) {__pyx_filename = __pyx_f[8]; __pyx_lineno = 106; __pyx_clineno = __LINE__; goto __pyx_L1_error;}
  __pyx_ptype_4grpc_7_cython_7_cygrpc_7records_Operation = __Pyx_ImportType("grpc._cython._cygrpc.records", "Operation", sizeof(struct __pyx_obj_4grpc_7_cython_7_cygrpc_7records_Operation), 1); if (unlikely(!__pyx_ptype_4grpc_7_cython_7_cygrpc_7records_Operation)) {__pyx_filename = __pyx_f[8]; __pyx_lineno = 112; __pyx_clineno = __LINE__; goto __pyx_L1_error;}
  __pyx_ptype_4grpc_7_cython_7_cygrpc_7records_Operations = __Pyx_ImportType("grpc._cython._cygrpc.records", "Operations", sizeof(struct __pyx_obj_4grpc_7_cython_7_cygrpc_7records_Operations), 1); if (unlikely(!__pyx_ptype_4grpc_7_cython_7_cygrpc_7records_Operations)) {__pyx_filename = __pyx_f[8]; __pyx_lineno = 125; __pyx_clineno = __LINE__; goto __pyx_L1_error;}
  __pyx_ptype_4grpc_7_cython_7_cygrpc_11credentials_ChannelCredentials = __Pyx_ImportType("grpc._cython._cygrpc.credentials", "ChannelCredentials", sizeof(struct __pyx_obj_4grpc_7_cython_7_cygrpc_11credentials_ChannelCredentials), 1); if (unlikely(!__pyx_ptype_4grpc_7_cython_7_cygrpc_11credentials_ChannelCredentials)) {__pyx_filename = __pyx_f[9]; __pyx_lineno = 36; __pyx_clineno = __LINE__; goto __pyx_L1_error;}
  __pyx_ptype_4grpc_7_cython_7_cygrpc_11credentials_CallCredentials = __Pyx_ImportType("grpc._cython._cygrpc.credentials", "CallCredentials", sizeof(struct __pyx_obj_4grpc_7_cython_7_cygrpc_11credentials_CallCredentials), 1); if (unlikely(!__pyx_ptype_4grpc_7_cython_7_cygrpc_11credentials_CallCredentials)) {__pyx_filename = __pyx_f[9]; __pyx_lineno = 43; __pyx_clineno = __LINE__; goto __pyx_L1_error;}
  __pyx_ptype_4grpc_7_cython_7_cygrpc_11credentials_ServerCredentials = __Pyx_ImportType("grpc._cython._cygrpc.credentials", "ServerCredentials", sizeof(struct __pyx_obj_4grpc_7_cython_7_cygrpc_11credentials_ServerCredentials), 1); if (unlikely(!__pyx_ptype_4grpc_7_cython_7_cygrpc_11credentials_ServerCredentials)) {__pyx_filename = __pyx_f[9]; __pyx_lineno = 49; __pyx_clineno = __LINE__; goto __pyx_L1_error;}
  __pyx_ptype_4grpc_7_cython_7_cygrpc_11credentials_CredentialsMetadataPlugin = __Pyx_ImportType("grpc._cython._cygrpc.credentials", "CredentialsMetadataPlugin", sizeof(struct __pyx_obj_4grpc_7_cython_7_cygrpc_11credentials_CredentialsMetadataPlugin), 1); if (unlikely(!__pyx_ptype_4grpc_7_cython_7_cygrpc_11credentials_CredentialsMetadataPlugin)) {__pyx_filename = __pyx_f[9]; __pyx_lineno = 57; __pyx_clineno = __LINE__; goto __pyx_L1_error;}
  __pyx_vtabptr_4grpc_7_cython_7_cygrpc_11credentials_CredentialsMetadataPlugin = (struct __pyx_vtabstruct_4grpc_7_cython_7_cygrpc_11credentials_CredentialsMetadataPlugin*)__Pyx_GetVtable(__pyx_ptype_4grpc_7_cython_7_cygrpc_11credentials_CredentialsMetadataPlugin->tp_dict); if (unlikely(!__pyx_vtabptr_4grpc_7_cython_7_cygrpc_11credentials_CredentialsMetadataPlugin)) {__pyx_filename = __pyx_f[9]; __pyx_lineno = 57; __pyx_clineno = __LINE__; goto __pyx_L1_error;}
  __pyx_ptype_4grpc_7_cython_7_cygrpc_11credentials_AuthMetadataContext = __Pyx_ImportType("grpc._cython._cygrpc.credentials", "AuthMetadataContext", sizeof(struct __pyx_obj_4grpc_7_cython_7_cygrpc_11credentials_AuthMetadataContext), 1); if (unlikely(!__pyx_ptype_4grpc_7_cython_7_cygrpc_11credentials_AuthMetadataContext)) {__pyx_filename = __pyx_f[9]; __pyx_lineno = 65; __pyx_clineno = __LINE__; goto __pyx_L1_error;}
  /*--- Variable import code ---*/
  /*--- Function import code ---*/
  /*--- Execution code ---*/
  #if defined(__Pyx_Generator_USED) || defined(__Pyx_Coroutine_USED)
  if (__Pyx_patch_abc() < 0) {__pyx_filename = __pyx_f[0]; __pyx_lineno = 1; __pyx_clineno = __LINE__; goto __pyx_L1_error;}
  #endif

  /* "grpc/_cython/cygrpc.pyx":40
 * from grpc._cython._cygrpc cimport server
 * 
 * from grpc._cython._cygrpc import call             # <<<<<<<<<<<<<<
 * from grpc._cython._cygrpc import channel
 * from grpc._cython._cygrpc import credentials
 */
  __pyx_t_1 = PyList_New(1); if (unlikely(!__pyx_t_1)) {__pyx_filename = __pyx_f[0]; __pyx_lineno = 40; __pyx_clineno = __LINE__; goto __pyx_L1_error;}
  __Pyx_GOTREF(__pyx_t_1);
  __Pyx_INCREF(__pyx_n_s_call);
  __Pyx_GIVEREF(__pyx_n_s_call);
  PyList_SET_ITEM(__pyx_t_1, 0, __pyx_n_s_call);
  __pyx_t_2 = __Pyx_Import(__pyx_n_s_grpc__cython__cygrpc, __pyx_t_1, -1); if (unlikely(!__pyx_t_2)) {__pyx_filename = __pyx_f[0]; __pyx_lineno = 40; __pyx_clineno = __LINE__; goto __pyx_L1_error;}
  __Pyx_GOTREF(__pyx_t_2);
  __Pyx_DECREF(__pyx_t_1); __pyx_t_1 = 0;
  __pyx_t_1 = __Pyx_ImportFrom(__pyx_t_2, __pyx_n_s_call); if (unlikely(!__pyx_t_1)) {__pyx_filename = __pyx_f[0]; __pyx_lineno = 40; __pyx_clineno = __LINE__; goto __pyx_L1_error;}
  __Pyx_GOTREF(__pyx_t_1);
  if (PyDict_SetItem(__pyx_d, __pyx_n_s_call, __pyx_t_1) < 0) {__pyx_filename = __pyx_f[0]; __pyx_lineno = 40; __pyx_clineno = __LINE__; goto __pyx_L1_error;}
  __Pyx_DECREF(__pyx_t_1); __pyx_t_1 = 0;
  __Pyx_DECREF(__pyx_t_2); __pyx_t_2 = 0;

  /* "grpc/_cython/cygrpc.pyx":41
 * 
 * from grpc._cython._cygrpc import call
 * from grpc._cython._cygrpc import channel             # <<<<<<<<<<<<<<
 * from grpc._cython._cygrpc import credentials
 * from grpc._cython._cygrpc import completion_queue
 */
  __pyx_t_2 = PyList_New(1); if (unlikely(!__pyx_t_2)) {__pyx_filename = __pyx_f[0]; __pyx_lineno = 41; __pyx_clineno = __LINE__; goto __pyx_L1_error;}
  __Pyx_GOTREF(__pyx_t_2);
  __Pyx_INCREF(__pyx_n_s_channel);
  __Pyx_GIVEREF(__pyx_n_s_channel);
  PyList_SET_ITEM(__pyx_t_2, 0, __pyx_n_s_channel);
  __pyx_t_1 = __Pyx_Import(__pyx_n_s_grpc__cython__cygrpc, __pyx_t_2, -1); if (unlikely(!__pyx_t_1)) {__pyx_filename = __pyx_f[0]; __pyx_lineno = 41; __pyx_clineno = __LINE__; goto __pyx_L1_error;}
  __Pyx_GOTREF(__pyx_t_1);
  __Pyx_DECREF(__pyx_t_2); __pyx_t_2 = 0;
  __pyx_t_2 = __Pyx_ImportFrom(__pyx_t_1, __pyx_n_s_channel); if (unlikely(!__pyx_t_2)) {__pyx_filename = __pyx_f[0]; __pyx_lineno = 41; __pyx_clineno = __LINE__; goto __pyx_L1_error;}
  __Pyx_GOTREF(__pyx_t_2);
  if (PyDict_SetItem(__pyx_d, __pyx_n_s_channel, __pyx_t_2) < 0) {__pyx_filename = __pyx_f[0]; __pyx_lineno = 41; __pyx_clineno = __LINE__; goto __pyx_L1_error;}
  __Pyx_DECREF(__pyx_t_2); __pyx_t_2 = 0;
  __Pyx_DECREF(__pyx_t_1); __pyx_t_1 = 0;

  /* "grpc/_cython/cygrpc.pyx":42
 * from grpc._cython._cygrpc import call
 * from grpc._cython._cygrpc import channel
 * from grpc._cython._cygrpc import credentials             # <<<<<<<<<<<<<<
 * from grpc._cython._cygrpc import completion_queue
 * from grpc._cython._cygrpc import records
 */
  __pyx_t_1 = PyList_New(1); if (unlikely(!__pyx_t_1)) {__pyx_filename = __pyx_f[0]; __pyx_lineno = 42; __pyx_clineno = __LINE__; goto __pyx_L1_error;}
  __Pyx_GOTREF(__pyx_t_1);
  __Pyx_INCREF(__pyx_n_s_credentials);
  __Pyx_GIVEREF(__pyx_n_s_credentials);
  PyList_SET_ITEM(__pyx_t_1, 0, __pyx_n_s_credentials);
  __pyx_t_2 = __Pyx_Import(__pyx_n_s_grpc__cython__cygrpc, __pyx_t_1, -1); if (unlikely(!__pyx_t_2)) {__pyx_filename = __pyx_f[0]; __pyx_lineno = 42; __pyx_clineno = __LINE__; goto __pyx_L1_error;}
  __Pyx_GOTREF(__pyx_t_2);
  __Pyx_DECREF(__pyx_t_1); __pyx_t_1 = 0;
  __pyx_t_1 = __Pyx_ImportFrom(__pyx_t_2, __pyx_n_s_credentials); if (unlikely(!__pyx_t_1)) {__pyx_filename = __pyx_f[0]; __pyx_lineno = 42; __pyx_clineno = __LINE__; goto __pyx_L1_error;}
  __Pyx_GOTREF(__pyx_t_1);
  if (PyDict_SetItem(__pyx_d, __pyx_n_s_credentials, __pyx_t_1) < 0) {__pyx_filename = __pyx_f[0]; __pyx_lineno = 42; __pyx_clineno = __LINE__; goto __pyx_L1_error;}
  __Pyx_DECREF(__pyx_t_1); __pyx_t_1 = 0;
  __Pyx_DECREF(__pyx_t_2); __pyx_t_2 = 0;

  /* "grpc/_cython/cygrpc.pyx":43
 * from grpc._cython._cygrpc import channel
 * from grpc._cython._cygrpc import credentials
 * from grpc._cython._cygrpc import completion_queue             # <<<<<<<<<<<<<<
 * from grpc._cython._cygrpc import records
 * from grpc._cython._cygrpc import server
 */
  __pyx_t_2 = PyList_New(1); if (unlikely(!__pyx_t_2)) {__pyx_filename = __pyx_f[0]; __pyx_lineno = 43; __pyx_clineno = __LINE__; goto __pyx_L1_error;}
  __Pyx_GOTREF(__pyx_t_2);
  __Pyx_INCREF(__pyx_n_s_completion_queue);
  __Pyx_GIVEREF(__pyx_n_s_completion_queue);
  PyList_SET_ITEM(__pyx_t_2, 0, __pyx_n_s_completion_queue);
  __pyx_t_1 = __Pyx_Import(__pyx_n_s_grpc__cython__cygrpc, __pyx_t_2, -1); if (unlikely(!__pyx_t_1)) {__pyx_filename = __pyx_f[0]; __pyx_lineno = 43; __pyx_clineno = __LINE__; goto __pyx_L1_error;}
  __Pyx_GOTREF(__pyx_t_1);
  __Pyx_DECREF(__pyx_t_2); __pyx_t_2 = 0;
  __pyx_t_2 = __Pyx_ImportFrom(__pyx_t_1, __pyx_n_s_completion_queue); if (unlikely(!__pyx_t_2)) {__pyx_filename = __pyx_f[0]; __pyx_lineno = 43; __pyx_clineno = __LINE__; goto __pyx_L1_error;}
  __Pyx_GOTREF(__pyx_t_2);
  if (PyDict_SetItem(__pyx_d, __pyx_n_s_completion_queue, __pyx_t_2) < 0) {__pyx_filename = __pyx_f[0]; __pyx_lineno = 43; __pyx_clineno = __LINE__; goto __pyx_L1_error;}
  __Pyx_DECREF(__pyx_t_2); __pyx_t_2 = 0;
  __Pyx_DECREF(__pyx_t_1); __pyx_t_1 = 0;

  /* "grpc/_cython/cygrpc.pyx":44
 * from grpc._cython._cygrpc import credentials
 * from grpc._cython._cygrpc import completion_queue
 * from grpc._cython._cygrpc import records             # <<<<<<<<<<<<<<
 * from grpc._cython._cygrpc import server
 * 
 */
  __pyx_t_1 = PyList_New(1); if (unlikely(!__pyx_t_1)) {__pyx_filename = __pyx_f[0]; __pyx_lineno = 44; __pyx_clineno = __LINE__; goto __pyx_L1_error;}
  __Pyx_GOTREF(__pyx_t_1);
  __Pyx_INCREF(__pyx_n_s_records);
  __Pyx_GIVEREF(__pyx_n_s_records);
  PyList_SET_ITEM(__pyx_t_1, 0, __pyx_n_s_records);
  __pyx_t_2 = __Pyx_Import(__pyx_n_s_grpc__cython__cygrpc, __pyx_t_1, -1); if (unlikely(!__pyx_t_2)) {__pyx_filename = __pyx_f[0]; __pyx_lineno = 44; __pyx_clineno = __LINE__; goto __pyx_L1_error;}
  __Pyx_GOTREF(__pyx_t_2);
  __Pyx_DECREF(__pyx_t_1); __pyx_t_1 = 0;
  __pyx_t_1 = __Pyx_ImportFrom(__pyx_t_2, __pyx_n_s_records); if (unlikely(!__pyx_t_1)) {__pyx_filename = __pyx_f[0]; __pyx_lineno = 44; __pyx_clineno = __LINE__; goto __pyx_L1_error;}
  __Pyx_GOTREF(__pyx_t_1);
  if (PyDict_SetItem(__pyx_d, __pyx_n_s_records, __pyx_t_1) < 0) {__pyx_filename = __pyx_f[0]; __pyx_lineno = 44; __pyx_clineno = __LINE__; goto __pyx_L1_error;}
  __Pyx_DECREF(__pyx_t_1); __pyx_t_1 = 0;
  __Pyx_DECREF(__pyx_t_2); __pyx_t_2 = 0;

  /* "grpc/_cython/cygrpc.pyx":45
 * from grpc._cython._cygrpc import completion_queue
 * from grpc._cython._cygrpc import records
 * from grpc._cython._cygrpc import server             # <<<<<<<<<<<<<<
 * 
 * ConnectivityState = records.ConnectivityState
 */
  __pyx_t_2 = PyList_New(1); if (unlikely(!__pyx_t_2)) {__pyx_filename = __pyx_f[0]; __pyx_lineno = 45; __pyx_clineno = __LINE__; goto __pyx_L1_error;}
  __Pyx_GOTREF(__pyx_t_2);
  __Pyx_INCREF(__pyx_n_s_server);
  __Pyx_GIVEREF(__pyx_n_s_server);
  PyList_SET_ITEM(__pyx_t_2, 0, __pyx_n_s_server);
  __pyx_t_1 = __Pyx_Import(__pyx_n_s_grpc__cython__cygrpc, __pyx_t_2, -1); if (unlikely(!__pyx_t_1)) {__pyx_filename = __pyx_f[0]; __pyx_lineno = 45; __pyx_clineno = __LINE__; goto __pyx_L1_error;}
  __Pyx_GOTREF(__pyx_t_1);
  __Pyx_DECREF(__pyx_t_2); __pyx_t_2 = 0;
  __pyx_t_2 = __Pyx_ImportFrom(__pyx_t_1, __pyx_n_s_server); if (unlikely(!__pyx_t_2)) {__pyx_filename = __pyx_f[0]; __pyx_lineno = 45; __pyx_clineno = __LINE__; goto __pyx_L1_error;}
  __Pyx_GOTREF(__pyx_t_2);
  if (PyDict_SetItem(__pyx_d, __pyx_n_s_server, __pyx_t_2) < 0) {__pyx_filename = __pyx_f[0]; __pyx_lineno = 45; __pyx_clineno = __LINE__; goto __pyx_L1_error;}
  __Pyx_DECREF(__pyx_t_2); __pyx_t_2 = 0;
  __Pyx_DECREF(__pyx_t_1); __pyx_t_1 = 0;

  /* "grpc/_cython/cygrpc.pyx":47
 * from grpc._cython._cygrpc import server
 * 
 * ConnectivityState = records.ConnectivityState             # <<<<<<<<<<<<<<
 * ChannelArgKey = records.ChannelArgKey
 * WriteFlag = records.WriteFlag
 */
  __pyx_t_1 = __Pyx_GetModuleGlobalName(__pyx_n_s_records); if (unlikely(!__pyx_t_1)) {__pyx_filename = __pyx_f[0]; __pyx_lineno = 47; __pyx_clineno = __LINE__; goto __pyx_L1_error;}
  __Pyx_GOTREF(__pyx_t_1);
  __pyx_t_2 = __Pyx_PyObject_GetAttrStr(__pyx_t_1, __pyx_n_s_ConnectivityState); if (unlikely(!__pyx_t_2)) {__pyx_filename = __pyx_f[0]; __pyx_lineno = 47; __pyx_clineno = __LINE__; goto __pyx_L1_error;}
  __Pyx_GOTREF(__pyx_t_2);
  __Pyx_DECREF(__pyx_t_1); __pyx_t_1 = 0;
  if (PyDict_SetItem(__pyx_d, __pyx_n_s_ConnectivityState, __pyx_t_2) < 0) {__pyx_filename = __pyx_f[0]; __pyx_lineno = 47; __pyx_clineno = __LINE__; goto __pyx_L1_error;}
  __Pyx_DECREF(__pyx_t_2); __pyx_t_2 = 0;

  /* "grpc/_cython/cygrpc.pyx":48
 * 
 * ConnectivityState = records.ConnectivityState
 * ChannelArgKey = records.ChannelArgKey             # <<<<<<<<<<<<<<
 * WriteFlag = records.WriteFlag
 * StatusCode = records.StatusCode
 */
  __pyx_t_2 = __Pyx_GetModuleGlobalName(__pyx_n_s_records); if (unlikely(!__pyx_t_2)) {__pyx_filename = __pyx_f[0]; __pyx_lineno = 48; __pyx_clineno = __LINE__; goto __pyx_L1_error;}
  __Pyx_GOTREF(__pyx_t_2);
  __pyx_t_1 = __Pyx_PyObject_GetAttrStr(__pyx_t_2, __pyx_n_s_ChannelArgKey); if (unlikely(!__pyx_t_1)) {__pyx_filename = __pyx_f[0]; __pyx_lineno = 48; __pyx_clineno = __LINE__; goto __pyx_L1_error;}
  __Pyx_GOTREF(__pyx_t_1);
  __Pyx_DECREF(__pyx_t_2); __pyx_t_2 = 0;
  if (PyDict_SetItem(__pyx_d, __pyx_n_s_ChannelArgKey, __pyx_t_1) < 0) {__pyx_filename = __pyx_f[0]; __pyx_lineno = 48; __pyx_clineno = __LINE__; goto __pyx_L1_error;}
  __Pyx_DECREF(__pyx_t_1); __pyx_t_1 = 0;

  /* "grpc/_cython/cygrpc.pyx":49
 * ConnectivityState = records.ConnectivityState
 * ChannelArgKey = records.ChannelArgKey
 * WriteFlag = records.WriteFlag             # <<<<<<<<<<<<<<
 * StatusCode = records.StatusCode
 * CallError = records.CallError
 */
  __pyx_t_1 = __Pyx_GetModuleGlobalName(__pyx_n_s_records); if (unlikely(!__pyx_t_1)) {__pyx_filename = __pyx_f[0]; __pyx_lineno = 49; __pyx_clineno = __LINE__; goto __pyx_L1_error;}
  __Pyx_GOTREF(__pyx_t_1);
  __pyx_t_2 = __Pyx_PyObject_GetAttrStr(__pyx_t_1, __pyx_n_s_WriteFlag); if (unlikely(!__pyx_t_2)) {__pyx_filename = __pyx_f[0]; __pyx_lineno = 49; __pyx_clineno = __LINE__; goto __pyx_L1_error;}
  __Pyx_GOTREF(__pyx_t_2);
  __Pyx_DECREF(__pyx_t_1); __pyx_t_1 = 0;
  if (PyDict_SetItem(__pyx_d, __pyx_n_s_WriteFlag, __pyx_t_2) < 0) {__pyx_filename = __pyx_f[0]; __pyx_lineno = 49; __pyx_clineno = __LINE__; goto __pyx_L1_error;}
  __Pyx_DECREF(__pyx_t_2); __pyx_t_2 = 0;

  /* "grpc/_cython/cygrpc.pyx":50
 * ChannelArgKey = records.ChannelArgKey
 * WriteFlag = records.WriteFlag
 * StatusCode = records.StatusCode             # <<<<<<<<<<<<<<
 * CallError = records.CallError
 * CompletionType = records.CompletionType
 */
  __pyx_t_2 = __Pyx_GetModuleGlobalName(__pyx_n_s_records); if (unlikely(!__pyx_t_2)) {__pyx_filename = __pyx_f[0]; __pyx_lineno = 50; __pyx_clineno = __LINE__; goto __pyx_L1_error;}
  __Pyx_GOTREF(__pyx_t_2);
  __pyx_t_1 = __Pyx_PyObject_GetAttrStr(__pyx_t_2, __pyx_n_s_StatusCode); if (unlikely(!__pyx_t_1)) {__pyx_filename = __pyx_f[0]; __pyx_lineno = 50; __pyx_clineno = __LINE__; goto __pyx_L1_error;}
  __Pyx_GOTREF(__pyx_t_1);
  __Pyx_DECREF(__pyx_t_2); __pyx_t_2 = 0;
  if (PyDict_SetItem(__pyx_d, __pyx_n_s_StatusCode, __pyx_t_1) < 0) {__pyx_filename = __pyx_f[0]; __pyx_lineno = 50; __pyx_clineno = __LINE__; goto __pyx_L1_error;}
  __Pyx_DECREF(__pyx_t_1); __pyx_t_1 = 0;

  /* "grpc/_cython/cygrpc.pyx":51
 * WriteFlag = records.WriteFlag
 * StatusCode = records.StatusCode
 * CallError = records.CallError             # <<<<<<<<<<<<<<
 * CompletionType = records.CompletionType
 * OperationType = records.OperationType
 */
  __pyx_t_1 = __Pyx_GetModuleGlobalName(__pyx_n_s_records); if (unlikely(!__pyx_t_1)) {__pyx_filename = __pyx_f[0]; __pyx_lineno = 51; __pyx_clineno = __LINE__; goto __pyx_L1_error;}
  __Pyx_GOTREF(__pyx_t_1);
  __pyx_t_2 = __Pyx_PyObject_GetAttrStr(__pyx_t_1, __pyx_n_s_CallError); if (unlikely(!__pyx_t_2)) {__pyx_filename = __pyx_f[0]; __pyx_lineno = 51; __pyx_clineno = __LINE__; goto __pyx_L1_error;}
  __Pyx_GOTREF(__pyx_t_2);
  __Pyx_DECREF(__pyx_t_1); __pyx_t_1 = 0;
  if (PyDict_SetItem(__pyx_d, __pyx_n_s_CallError, __pyx_t_2) < 0) {__pyx_filename = __pyx_f[0]; __pyx_lineno = 51; __pyx_clineno = __LINE__; goto __pyx_L1_error;}
  __Pyx_DECREF(__pyx_t_2); __pyx_t_2 = 0;

  /* "grpc/_cython/cygrpc.pyx":52
 * StatusCode = records.StatusCode
 * CallError = records.CallError
 * CompletionType = records.CompletionType             # <<<<<<<<<<<<<<
 * OperationType = records.OperationType
 * Timespec = records.Timespec
 */
  __pyx_t_2 = __Pyx_GetModuleGlobalName(__pyx_n_s_records); if (unlikely(!__pyx_t_2)) {__pyx_filename = __pyx_f[0]; __pyx_lineno = 52; __pyx_clineno = __LINE__; goto __pyx_L1_error;}
  __Pyx_GOTREF(__pyx_t_2);
  __pyx_t_1 = __Pyx_PyObject_GetAttrStr(__pyx_t_2, __pyx_n_s_CompletionType); if (unlikely(!__pyx_t_1)) {__pyx_filename = __pyx_f[0]; __pyx_lineno = 52; __pyx_clineno = __LINE__; goto __pyx_L1_error;}
  __Pyx_GOTREF(__pyx_t_1);
  __Pyx_DECREF(__pyx_t_2); __pyx_t_2 = 0;
  if (PyDict_SetItem(__pyx_d, __pyx_n_s_CompletionType, __pyx_t_1) < 0) {__pyx_filename = __pyx_f[0]; __pyx_lineno = 52; __pyx_clineno = __LINE__; goto __pyx_L1_error;}
  __Pyx_DECREF(__pyx_t_1); __pyx_t_1 = 0;

  /* "grpc/_cython/cygrpc.pyx":53
 * CallError = records.CallError
 * CompletionType = records.CompletionType
 * OperationType = records.OperationType             # <<<<<<<<<<<<<<
 * Timespec = records.Timespec
 * CallDetails = records.CallDetails
 */
  __pyx_t_1 = __Pyx_GetModuleGlobalName(__pyx_n_s_records); if (unlikely(!__pyx_t_1)) {__pyx_filename = __pyx_f[0]; __pyx_lineno = 53; __pyx_clineno = __LINE__; goto __pyx_L1_error;}
  __Pyx_GOTREF(__pyx_t_1);
  __pyx_t_2 = __Pyx_PyObject_GetAttrStr(__pyx_t_1, __pyx_n_s_OperationType); if (unlikely(!__pyx_t_2)) {__pyx_filename = __pyx_f[0]; __pyx_lineno = 53; __pyx_clineno = __LINE__; goto __pyx_L1_error;}
  __Pyx_GOTREF(__pyx_t_2);
  __Pyx_DECREF(__pyx_t_1); __pyx_t_1 = 0;
  if (PyDict_SetItem(__pyx_d, __pyx_n_s_OperationType, __pyx_t_2) < 0) {__pyx_filename = __pyx_f[0]; __pyx_lineno = 53; __pyx_clineno = __LINE__; goto __pyx_L1_error;}
  __Pyx_DECREF(__pyx_t_2); __pyx_t_2 = 0;

  /* "grpc/_cython/cygrpc.pyx":54
 * CompletionType = records.CompletionType
 * OperationType = records.OperationType
 * Timespec = records.Timespec             # <<<<<<<<<<<<<<
 * CallDetails = records.CallDetails
 * Event = records.Event
 */
  if (PyDict_SetItem(__pyx_d, __pyx_n_s_Timespec, ((PyObject *)__pyx_ptype_4grpc_7_cython_7_cygrpc_7records_Timespec)) < 0) {__pyx_filename = __pyx_f[0]; __pyx_lineno = 54; __pyx_clineno = __LINE__; goto __pyx_L1_error;}

  /* "grpc/_cython/cygrpc.pyx":55
 * OperationType = records.OperationType
 * Timespec = records.Timespec
 * CallDetails = records.CallDetails             # <<<<<<<<<<<<<<
 * Event = records.Event
 * ByteBuffer = records.ByteBuffer
 */
  if (PyDict_SetItem(__pyx_d, __pyx_n_s_CallDetails, ((PyObject *)__pyx_ptype_4grpc_7_cython_7_cygrpc_7records_CallDetails)) < 0) {__pyx_filename = __pyx_f[0]; __pyx_lineno = 55; __pyx_clineno = __LINE__; goto __pyx_L1_error;}

  /* "grpc/_cython/cygrpc.pyx":56
 * Timespec = records.Timespec
 * CallDetails = records.CallDetails
 * Event = records.Event             # <<<<<<<<<<<<<<
 * ByteBuffer = records.ByteBuffer
 * SslPemKeyCertPair = records.SslPemKeyCertPair
 */
  if (PyDict_SetItem(__pyx_d, __pyx_n_s_Event, ((PyObject *)__pyx_ptype_4grpc_7_cython_7_cygrpc_7records_Event)) < 0) {__pyx_filename = __pyx_f[0]; __pyx_lineno = 56; __pyx_clineno = __LINE__; goto __pyx_L1_error;}

  /* "grpc/_cython/cygrpc.pyx":57
 * CallDetails = records.CallDetails
 * Event = records.Event
 * ByteBuffer = records.ByteBuffer             # <<<<<<<<<<<<<<
 * SslPemKeyCertPair = records.SslPemKeyCertPair
 * ChannelArg = records.ChannelArg
 */
  if (PyDict_SetItem(__pyx_d, __pyx_n_s_ByteBuffer, ((PyObject *)__pyx_ptype_4grpc_7_cython_7_cygrpc_7records_ByteBuffer)) < 0) {__pyx_filename = __pyx_f[0]; __pyx_lineno = 57; __pyx_clineno = __LINE__; goto __pyx_L1_error;}

  /* "grpc/_cython/cygrpc.pyx":58
 * Event = records.Event
 * ByteBuffer = records.ByteBuffer
 * SslPemKeyCertPair = records.SslPemKeyCertPair             # <<<<<<<<<<<<<<
 * ChannelArg = records.ChannelArg
 * ChannelArgs = records.ChannelArgs
 */
  if (PyDict_SetItem(__pyx_d, __pyx_n_s_SslPemKeyCertPair, ((PyObject *)__pyx_ptype_4grpc_7_cython_7_cygrpc_7records_SslPemKeyCertPair)) < 0) {__pyx_filename = __pyx_f[0]; __pyx_lineno = 58; __pyx_clineno = __LINE__; goto __pyx_L1_error;}

  /* "grpc/_cython/cygrpc.pyx":59
 * ByteBuffer = records.ByteBuffer
 * SslPemKeyCertPair = records.SslPemKeyCertPair
 * ChannelArg = records.ChannelArg             # <<<<<<<<<<<<<<
 * ChannelArgs = records.ChannelArgs
 * Metadatum = records.Metadatum
 */
  if (PyDict_SetItem(__pyx_d, __pyx_n_s_ChannelArg, ((PyObject *)__pyx_ptype_4grpc_7_cython_7_cygrpc_7records_ChannelArg)) < 0) {__pyx_filename = __pyx_f[0]; __pyx_lineno = 59; __pyx_clineno = __LINE__; goto __pyx_L1_error;}

  /* "grpc/_cython/cygrpc.pyx":60
 * SslPemKeyCertPair = records.SslPemKeyCertPair
 * ChannelArg = records.ChannelArg
 * ChannelArgs = records.ChannelArgs             # <<<<<<<<<<<<<<
 * Metadatum = records.Metadatum
 * Metadata = records.Metadata
 */
  if (PyDict_SetItem(__pyx_d, __pyx_n_s_ChannelArgs, ((PyObject *)__pyx_ptype_4grpc_7_cython_7_cygrpc_7records_ChannelArgs)) < 0) {__pyx_filename = __pyx_f[0]; __pyx_lineno = 60; __pyx_clineno = __LINE__; goto __pyx_L1_error;}

  /* "grpc/_cython/cygrpc.pyx":61
 * ChannelArg = records.ChannelArg
 * ChannelArgs = records.ChannelArgs
 * Metadatum = records.Metadatum             # <<<<<<<<<<<<<<
 * Metadata = records.Metadata
 * Operation = records.Operation
 */
  if (PyDict_SetItem(__pyx_d, __pyx_n_s_Metadatum, ((PyObject *)__pyx_ptype_4grpc_7_cython_7_cygrpc_7records_Metadatum)) < 0) {__pyx_filename = __pyx_f[0]; __pyx_lineno = 61; __pyx_clineno = __LINE__; goto __pyx_L1_error;}

  /* "grpc/_cython/cygrpc.pyx":62
 * ChannelArgs = records.ChannelArgs
 * Metadatum = records.Metadatum
 * Metadata = records.Metadata             # <<<<<<<<<<<<<<
 * Operation = records.Operation
 * 
 */
  if (PyDict_SetItem(__pyx_d, __pyx_n_s_Metadata, ((PyObject *)__pyx_ptype_4grpc_7_cython_7_cygrpc_7records_Metadata)) < 0) {__pyx_filename = __pyx_f[0]; __pyx_lineno = 62; __pyx_clineno = __LINE__; goto __pyx_L1_error;}

  /* "grpc/_cython/cygrpc.pyx":63
 * Metadatum = records.Metadatum
 * Metadata = records.Metadata
 * Operation = records.Operation             # <<<<<<<<<<<<<<
 * 
 * operation_send_initial_metadata = records.operation_send_initial_metadata
 */
  if (PyDict_SetItem(__pyx_d, __pyx_n_s_Operation, ((PyObject *)__pyx_ptype_4grpc_7_cython_7_cygrpc_7records_Operation)) < 0) {__pyx_filename = __pyx_f[0]; __pyx_lineno = 63; __pyx_clineno = __LINE__; goto __pyx_L1_error;}

  /* "grpc/_cython/cygrpc.pyx":65
 * Operation = records.Operation
 * 
 * operation_send_initial_metadata = records.operation_send_initial_metadata             # <<<<<<<<<<<<<<
 * operation_send_message = records.operation_send_message
 * operation_send_close_from_client = records.operation_send_close_from_client
 */
  __pyx_t_2 = __Pyx_GetModuleGlobalName(__pyx_n_s_records); if (unlikely(!__pyx_t_2)) {__pyx_filename = __pyx_f[0]; __pyx_lineno = 65; __pyx_clineno = __LINE__; goto __pyx_L1_error;}
  __Pyx_GOTREF(__pyx_t_2);
  __pyx_t_1 = __Pyx_PyObject_GetAttrStr(__pyx_t_2, __pyx_n_s_operation_send_initial_metadata); if (unlikely(!__pyx_t_1)) {__pyx_filename = __pyx_f[0]; __pyx_lineno = 65; __pyx_clineno = __LINE__; goto __pyx_L1_error;}
  __Pyx_GOTREF(__pyx_t_1);
  __Pyx_DECREF(__pyx_t_2); __pyx_t_2 = 0;
  if (PyDict_SetItem(__pyx_d, __pyx_n_s_operation_send_initial_metadata, __pyx_t_1) < 0) {__pyx_filename = __pyx_f[0]; __pyx_lineno = 65; __pyx_clineno = __LINE__; goto __pyx_L1_error;}
  __Pyx_DECREF(__pyx_t_1); __pyx_t_1 = 0;

  /* "grpc/_cython/cygrpc.pyx":66
 * 
 * operation_send_initial_metadata = records.operation_send_initial_metadata
 * operation_send_message = records.operation_send_message             # <<<<<<<<<<<<<<
 * operation_send_close_from_client = records.operation_send_close_from_client
 * operation_send_status_from_server = records.operation_send_status_from_server
 */
  __pyx_t_1 = __Pyx_GetModuleGlobalName(__pyx_n_s_records); if (unlikely(!__pyx_t_1)) {__pyx_filename = __pyx_f[0]; __pyx_lineno = 66; __pyx_clineno = __LINE__; goto __pyx_L1_error;}
  __Pyx_GOTREF(__pyx_t_1);
  __pyx_t_2 = __Pyx_PyObject_GetAttrStr(__pyx_t_1, __pyx_n_s_operation_send_message); if (unlikely(!__pyx_t_2)) {__pyx_filename = __pyx_f[0]; __pyx_lineno = 66; __pyx_clineno = __LINE__; goto __pyx_L1_error;}
  __Pyx_GOTREF(__pyx_t_2);
  __Pyx_DECREF(__pyx_t_1); __pyx_t_1 = 0;
  if (PyDict_SetItem(__pyx_d, __pyx_n_s_operation_send_message, __pyx_t_2) < 0) {__pyx_filename = __pyx_f[0]; __pyx_lineno = 66; __pyx_clineno = __LINE__; goto __pyx_L1_error;}
  __Pyx_DECREF(__pyx_t_2); __pyx_t_2 = 0;

  /* "grpc/_cython/cygrpc.pyx":67
 * operation_send_initial_metadata = records.operation_send_initial_metadata
 * operation_send_message = records.operation_send_message
 * operation_send_close_from_client = records.operation_send_close_from_client             # <<<<<<<<<<<<<<
 * operation_send_status_from_server = records.operation_send_status_from_server
 * operation_receive_initial_metadata = records.operation_receive_initial_metadata
 */
  __pyx_t_2 = __Pyx_GetModuleGlobalName(__pyx_n_s_records); if (unlikely(!__pyx_t_2)) {__pyx_filename = __pyx_f[0]; __pyx_lineno = 67; __pyx_clineno = __LINE__; goto __pyx_L1_error;}
  __Pyx_GOTREF(__pyx_t_2);
  __pyx_t_1 = __Pyx_PyObject_GetAttrStr(__pyx_t_2, __pyx_n_s_operation_send_close_from_client); if (unlikely(!__pyx_t_1)) {__pyx_filename = __pyx_f[0]; __pyx_lineno = 67; __pyx_clineno = __LINE__; goto __pyx_L1_error;}
  __Pyx_GOTREF(__pyx_t_1);
  __Pyx_DECREF(__pyx_t_2); __pyx_t_2 = 0;
  if (PyDict_SetItem(__pyx_d, __pyx_n_s_operation_send_close_from_client, __pyx_t_1) < 0) {__pyx_filename = __pyx_f[0]; __pyx_lineno = 67; __pyx_clineno = __LINE__; goto __pyx_L1_error;}
  __Pyx_DECREF(__pyx_t_1); __pyx_t_1 = 0;

  /* "grpc/_cython/cygrpc.pyx":68
 * operation_send_message = records.operation_send_message
 * operation_send_close_from_client = records.operation_send_close_from_client
 * operation_send_status_from_server = records.operation_send_status_from_server             # <<<<<<<<<<<<<<
 * operation_receive_initial_metadata = records.operation_receive_initial_metadata
 * operation_receive_message = records.operation_receive_message
 */
  __pyx_t_1 = __Pyx_GetModuleGlobalName(__pyx_n_s_records); if (unlikely(!__pyx_t_1)) {__pyx_filename = __pyx_f[0]; __pyx_lineno = 68; __pyx_clineno = __LINE__; goto __pyx_L1_error;}
  __Pyx_GOTREF(__pyx_t_1);
  __pyx_t_2 = __Pyx_PyObject_GetAttrStr(__pyx_t_1, __pyx_n_s_operation_send_status_from_serve); if (unlikely(!__pyx_t_2)) {__pyx_filename = __pyx_f[0]; __pyx_lineno = 68; __pyx_clineno = __LINE__; goto __pyx_L1_error;}
  __Pyx_GOTREF(__pyx_t_2);
  __Pyx_DECREF(__pyx_t_1); __pyx_t_1 = 0;
  if (PyDict_SetItem(__pyx_d, __pyx_n_s_operation_send_status_from_serve, __pyx_t_2) < 0) {__pyx_filename = __pyx_f[0]; __pyx_lineno = 68; __pyx_clineno = __LINE__; goto __pyx_L1_error;}
  __Pyx_DECREF(__pyx_t_2); __pyx_t_2 = 0;

  /* "grpc/_cython/cygrpc.pyx":69
 * operation_send_close_from_client = records.operation_send_close_from_client
 * operation_send_status_from_server = records.operation_send_status_from_server
 * operation_receive_initial_metadata = records.operation_receive_initial_metadata             # <<<<<<<<<<<<<<
 * operation_receive_message = records.operation_receive_message
 * operation_receive_status_on_client = records.operation_receive_status_on_client
 */
  __pyx_t_2 = __Pyx_GetModuleGlobalName(__pyx_n_s_records); if (unlikely(!__pyx_t_2)) {__pyx_filename = __pyx_f[0]; __pyx_lineno = 69; __pyx_clineno = __LINE__; goto __pyx_L1_error;}
  __Pyx_GOTREF(__pyx_t_2);
  __pyx_t_1 = __Pyx_PyObject_GetAttrStr(__pyx_t_2, __pyx_n_s_operation_receive_initial_metada); if (unlikely(!__pyx_t_1)) {__pyx_filename = __pyx_f[0]; __pyx_lineno = 69; __pyx_clineno = __LINE__; goto __pyx_L1_error;}
  __Pyx_GOTREF(__pyx_t_1);
  __Pyx_DECREF(__pyx_t_2); __pyx_t_2 = 0;
  if (PyDict_SetItem(__pyx_d, __pyx_n_s_operation_receive_initial_metada, __pyx_t_1) < 0) {__pyx_filename = __pyx_f[0]; __pyx_lineno = 69; __pyx_clineno = __LINE__; goto __pyx_L1_error;}
  __Pyx_DECREF(__pyx_t_1); __pyx_t_1 = 0;

  /* "grpc/_cython/cygrpc.pyx":70
 * operation_send_status_from_server = records.operation_send_status_from_server
 * operation_receive_initial_metadata = records.operation_receive_initial_metadata
 * operation_receive_message = records.operation_receive_message             # <<<<<<<<<<<<<<
 * operation_receive_status_on_client = records.operation_receive_status_on_client
 * operation_receive_close_on_server = records.operation_receive_close_on_server
 */
  __pyx_t_1 = __Pyx_GetModuleGlobalName(__pyx_n_s_records); if (unlikely(!__pyx_t_1)) {__pyx_filename = __pyx_f[0]; __pyx_lineno = 70; __pyx_clineno = __LINE__; goto __pyx_L1_error;}
  __Pyx_GOTREF(__pyx_t_1);
  __pyx_t_2 = __Pyx_PyObject_GetAttrStr(__pyx_t_1, __pyx_n_s_operation_receive_message); if (unlikely(!__pyx_t_2)) {__pyx_filename = __pyx_f[0]; __pyx_lineno = 70; __pyx_clineno = __LINE__; goto __pyx_L1_error;}
  __Pyx_GOTREF(__pyx_t_2);
  __Pyx_DECREF(__pyx_t_1); __pyx_t_1 = 0;
  if (PyDict_SetItem(__pyx_d, __pyx_n_s_operation_receive_message, __pyx_t_2) < 0) {__pyx_filename = __pyx_f[0]; __pyx_lineno = 70; __pyx_clineno = __LINE__; goto __pyx_L1_error;}
  __Pyx_DECREF(__pyx_t_2); __pyx_t_2 = 0;

  /* "grpc/_cython/cygrpc.pyx":71
 * operation_receive_initial_metadata = records.operation_receive_initial_metadata
 * operation_receive_message = records.operation_receive_message
 * operation_receive_status_on_client = records.operation_receive_status_on_client             # <<<<<<<<<<<<<<
 * operation_receive_close_on_server = records.operation_receive_close_on_server
 * 
 */
  __pyx_t_2 = __Pyx_GetModuleGlobalName(__pyx_n_s_records); if (unlikely(!__pyx_t_2)) {__pyx_filename = __pyx_f[0]; __pyx_lineno = 71; __pyx_clineno = __LINE__; goto __pyx_L1_error;}
  __Pyx_GOTREF(__pyx_t_2);
  __pyx_t_1 = __Pyx_PyObject_GetAttrStr(__pyx_t_2, __pyx_n_s_operation_receive_status_on_clie); if (unlikely(!__pyx_t_1)) {__pyx_filename = __pyx_f[0]; __pyx_lineno = 71; __pyx_clineno = __LINE__; goto __pyx_L1_error;}
  __Pyx_GOTREF(__pyx_t_1);
  __Pyx_DECREF(__pyx_t_2); __pyx_t_2 = 0;
  if (PyDict_SetItem(__pyx_d, __pyx_n_s_operation_receive_status_on_clie, __pyx_t_1) < 0) {__pyx_filename = __pyx_f[0]; __pyx_lineno = 71; __pyx_clineno = __LINE__; goto __pyx_L1_error;}
  __Pyx_DECREF(__pyx_t_1); __pyx_t_1 = 0;

  /* "grpc/_cython/cygrpc.pyx":72
 * operation_receive_message = records.operation_receive_message
 * operation_receive_status_on_client = records.operation_receive_status_on_client
 * operation_receive_close_on_server = records.operation_receive_close_on_server             # <<<<<<<<<<<<<<
 * 
 * Operations = records.Operations
 */
  __pyx_t_1 = __Pyx_GetModuleGlobalName(__pyx_n_s_records); if (unlikely(!__pyx_t_1)) {__pyx_filename = __pyx_f[0]; __pyx_lineno = 72; __pyx_clineno = __LINE__; goto __pyx_L1_error;}
  __Pyx_GOTREF(__pyx_t_1);
  __pyx_t_2 = __Pyx_PyObject_GetAttrStr(__pyx_t_1, __pyx_n_s_operation_receive_close_on_serve); if (unlikely(!__pyx_t_2)) {__pyx_filename = __pyx_f[0]; __pyx_lineno = 72; __pyx_clineno = __LINE__; goto __pyx_L1_error;}
  __Pyx_GOTREF(__pyx_t_2);
  __Pyx_DECREF(__pyx_t_1); __pyx_t_1 = 0;
  if (PyDict_SetItem(__pyx_d, __pyx_n_s_operation_receive_close_on_serve, __pyx_t_2) < 0) {__pyx_filename = __pyx_f[0]; __pyx_lineno = 72; __pyx_clineno = __LINE__; goto __pyx_L1_error;}
  __Pyx_DECREF(__pyx_t_2); __pyx_t_2 = 0;

  /* "grpc/_cython/cygrpc.pyx":74
 * operation_receive_close_on_server = records.operation_receive_close_on_server
 * 
 * Operations = records.Operations             # <<<<<<<<<<<<<<
 * 
 * CallCredentials = credentials.CallCredentials
 */
  if (PyDict_SetItem(__pyx_d, __pyx_n_s_Operations, ((PyObject *)__pyx_ptype_4grpc_7_cython_7_cygrpc_7records_Operations)) < 0) {__pyx_filename = __pyx_f[0]; __pyx_lineno = 74; __pyx_clineno = __LINE__; goto __pyx_L1_error;}

  /* "grpc/_cython/cygrpc.pyx":76
 * Operations = records.Operations
 * 
 * CallCredentials = credentials.CallCredentials             # <<<<<<<<<<<<<<
 * ChannelCredentials = credentials.ChannelCredentials
 * ServerCredentials = credentials.ServerCredentials
 */
  if (PyDict_SetItem(__pyx_d, __pyx_n_s_CallCredentials, ((PyObject *)__pyx_ptype_4grpc_7_cython_7_cygrpc_11credentials_CallCredentials)) < 0) {__pyx_filename = __pyx_f[0]; __pyx_lineno = 76; __pyx_clineno = __LINE__; goto __pyx_L1_error;}

  /* "grpc/_cython/cygrpc.pyx":77
 * 
 * CallCredentials = credentials.CallCredentials
 * ChannelCredentials = credentials.ChannelCredentials             # <<<<<<<<<<<<<<
 * ServerCredentials = credentials.ServerCredentials
 * CredentialsMetadataPlugin = credentials.CredentialsMetadataPlugin
 */
  if (PyDict_SetItem(__pyx_d, __pyx_n_s_ChannelCredentials, ((PyObject *)__pyx_ptype_4grpc_7_cython_7_cygrpc_11credentials_ChannelCredentials)) < 0) {__pyx_filename = __pyx_f[0]; __pyx_lineno = 77; __pyx_clineno = __LINE__; goto __pyx_L1_error;}

  /* "grpc/_cython/cygrpc.pyx":78
 * CallCredentials = credentials.CallCredentials
 * ChannelCredentials = credentials.ChannelCredentials
 * ServerCredentials = credentials.ServerCredentials             # <<<<<<<<<<<<<<
 * CredentialsMetadataPlugin = credentials.CredentialsMetadataPlugin
 * AuthMetadataContext = credentials.AuthMetadataContext
 */
  if (PyDict_SetItem(__pyx_d, __pyx_n_s_ServerCredentials, ((PyObject *)__pyx_ptype_4grpc_7_cython_7_cygrpc_11credentials_ServerCredentials)) < 0) {__pyx_filename = __pyx_f[0]; __pyx_lineno = 78; __pyx_clineno = __LINE__; goto __pyx_L1_error;}

  /* "grpc/_cython/cygrpc.pyx":79
 * ChannelCredentials = credentials.ChannelCredentials
 * ServerCredentials = credentials.ServerCredentials
 * CredentialsMetadataPlugin = credentials.CredentialsMetadataPlugin             # <<<<<<<<<<<<<<
 * AuthMetadataContext = credentials.AuthMetadataContext
 * 
 */
  if (PyDict_SetItem(__pyx_d, __pyx_n_s_CredentialsMetadataPlugin, ((PyObject *)__pyx_ptype_4grpc_7_cython_7_cygrpc_11credentials_CredentialsMetadataPlugin)) < 0) {__pyx_filename = __pyx_f[0]; __pyx_lineno = 79; __pyx_clineno = __LINE__; goto __pyx_L1_error;}

  /* "grpc/_cython/cygrpc.pyx":80
 * ServerCredentials = credentials.ServerCredentials
 * CredentialsMetadataPlugin = credentials.CredentialsMetadataPlugin
 * AuthMetadataContext = credentials.AuthMetadataContext             # <<<<<<<<<<<<<<
 * 
 * channel_credentials_google_default = (
 */
  if (PyDict_SetItem(__pyx_d, __pyx_n_s_AuthMetadataContext, ((PyObject *)__pyx_ptype_4grpc_7_cython_7_cygrpc_11credentials_AuthMetadataContext)) < 0) {__pyx_filename = __pyx_f[0]; __pyx_lineno = 80; __pyx_clineno = __LINE__; goto __pyx_L1_error;}

  /* "grpc/_cython/cygrpc.pyx":83
 * 
 * channel_credentials_google_default = (
 *     credentials.channel_credentials_google_default)             # <<<<<<<<<<<<<<
 * channel_credentials_ssl = credentials.channel_credentials_ssl
 * channel_credentials_composite = (
 */
  __pyx_t_2 = __Pyx_GetModuleGlobalName(__pyx_n_s_credentials); if (unlikely(!__pyx_t_2)) {__pyx_filename = __pyx_f[0]; __pyx_lineno = 83; __pyx_clineno = __LINE__; goto __pyx_L1_error;}
  __Pyx_GOTREF(__pyx_t_2);
  __pyx_t_1 = __Pyx_PyObject_GetAttrStr(__pyx_t_2, __pyx_n_s_channel_credentials_google_defau); if (unlikely(!__pyx_t_1)) {__pyx_filename = __pyx_f[0]; __pyx_lineno = 83; __pyx_clineno = __LINE__; goto __pyx_L1_error;}
  __Pyx_GOTREF(__pyx_t_1);
  __Pyx_DECREF(__pyx_t_2); __pyx_t_2 = 0;
  if (PyDict_SetItem(__pyx_d, __pyx_n_s_channel_credentials_google_defau, __pyx_t_1) < 0) {__pyx_filename = __pyx_f[0]; __pyx_lineno = 82; __pyx_clineno = __LINE__; goto __pyx_L1_error;}
  __Pyx_DECREF(__pyx_t_1); __pyx_t_1 = 0;

  /* "grpc/_cython/cygrpc.pyx":84
 * channel_credentials_google_default = (
 *     credentials.channel_credentials_google_default)
 * channel_credentials_ssl = credentials.channel_credentials_ssl             # <<<<<<<<<<<<<<
 * channel_credentials_composite = (
 *     credentials.channel_credentials_composite)
 */
  __pyx_t_1 = __Pyx_GetModuleGlobalName(__pyx_n_s_credentials); if (unlikely(!__pyx_t_1)) {__pyx_filename = __pyx_f[0]; __pyx_lineno = 84; __pyx_clineno = __LINE__; goto __pyx_L1_error;}
  __Pyx_GOTREF(__pyx_t_1);
  __pyx_t_2 = __Pyx_PyObject_GetAttrStr(__pyx_t_1, __pyx_n_s_channel_credentials_ssl); if (unlikely(!__pyx_t_2)) {__pyx_filename = __pyx_f[0]; __pyx_lineno = 84; __pyx_clineno = __LINE__; goto __pyx_L1_error;}
  __Pyx_GOTREF(__pyx_t_2);
  __Pyx_DECREF(__pyx_t_1); __pyx_t_1 = 0;
  if (PyDict_SetItem(__pyx_d, __pyx_n_s_channel_credentials_ssl, __pyx_t_2) < 0) {__pyx_filename = __pyx_f[0]; __pyx_lineno = 84; __pyx_clineno = __LINE__; goto __pyx_L1_error;}
  __Pyx_DECREF(__pyx_t_2); __pyx_t_2 = 0;

  /* "grpc/_cython/cygrpc.pyx":86
 * channel_credentials_ssl = credentials.channel_credentials_ssl
 * channel_credentials_composite = (
 *     credentials.channel_credentials_composite)             # <<<<<<<<<<<<<<
 * call_credentials_composite = (
 *     credentials.call_credentials_composite)
 */
  __pyx_t_2 = __Pyx_GetModuleGlobalName(__pyx_n_s_credentials); if (unlikely(!__pyx_t_2)) {__pyx_filename = __pyx_f[0]; __pyx_lineno = 86; __pyx_clineno = __LINE__; goto __pyx_L1_error;}
  __Pyx_GOTREF(__pyx_t_2);
  __pyx_t_1 = __Pyx_PyObject_GetAttrStr(__pyx_t_2, __pyx_n_s_channel_credentials_composite); if (unlikely(!__pyx_t_1)) {__pyx_filename = __pyx_f[0]; __pyx_lineno = 86; __pyx_clineno = __LINE__; goto __pyx_L1_error;}
  __Pyx_GOTREF(__pyx_t_1);
  __Pyx_DECREF(__pyx_t_2); __pyx_t_2 = 0;
  if (PyDict_SetItem(__pyx_d, __pyx_n_s_channel_credentials_composite, __pyx_t_1) < 0) {__pyx_filename = __pyx_f[0]; __pyx_lineno = 85; __pyx_clineno = __LINE__; goto __pyx_L1_error;}
  __Pyx_DECREF(__pyx_t_1); __pyx_t_1 = 0;

  /* "grpc/_cython/cygrpc.pyx":88
 *     credentials.channel_credentials_composite)
 * call_credentials_composite = (
 *     credentials.call_credentials_composite)             # <<<<<<<<<<<<<<
 * call_credentials_google_compute_engine = (
 *     credentials.call_credentials_google_compute_engine)
 */
  __pyx_t_1 = __Pyx_GetModuleGlobalName(__pyx_n_s_credentials); if (unlikely(!__pyx_t_1)) {__pyx_filename = __pyx_f[0]; __pyx_lineno = 88; __pyx_clineno = __LINE__; goto __pyx_L1_error;}
  __Pyx_GOTREF(__pyx_t_1);
  __pyx_t_2 = __Pyx_PyObject_GetAttrStr(__pyx_t_1, __pyx_n_s_call_credentials_composite); if (unlikely(!__pyx_t_2)) {__pyx_filename = __pyx_f[0]; __pyx_lineno = 88; __pyx_clineno = __LINE__; goto __pyx_L1_error;}
  __Pyx_GOTREF(__pyx_t_2);
  __Pyx_DECREF(__pyx_t_1); __pyx_t_1 = 0;
  if (PyDict_SetItem(__pyx_d, __pyx_n_s_call_credentials_composite, __pyx_t_2) < 0) {__pyx_filename = __pyx_f[0]; __pyx_lineno = 87; __pyx_clineno = __LINE__; goto __pyx_L1_error;}
  __Pyx_DECREF(__pyx_t_2); __pyx_t_2 = 0;

  /* "grpc/_cython/cygrpc.pyx":90
 *     credentials.call_credentials_composite)
 * call_credentials_google_compute_engine = (
 *     credentials.call_credentials_google_compute_engine)             # <<<<<<<<<<<<<<
 * call_credentials_jwt_access = (
 *     credentials.call_credentials_service_account_jwt_access)
 */
  __pyx_t_2 = __Pyx_GetModuleGlobalName(__pyx_n_s_credentials); if (unlikely(!__pyx_t_2)) {__pyx_filename = __pyx_f[0]; __pyx_lineno = 90; __pyx_clineno = __LINE__; goto __pyx_L1_error;}
  __Pyx_GOTREF(__pyx_t_2);
  __pyx_t_1 = __Pyx_PyObject_GetAttrStr(__pyx_t_2, __pyx_n_s_call_credentials_google_compute); if (unlikely(!__pyx_t_1)) {__pyx_filename = __pyx_f[0]; __pyx_lineno = 90; __pyx_clineno = __LINE__; goto __pyx_L1_error;}
  __Pyx_GOTREF(__pyx_t_1);
  __Pyx_DECREF(__pyx_t_2); __pyx_t_2 = 0;
  if (PyDict_SetItem(__pyx_d, __pyx_n_s_call_credentials_google_compute, __pyx_t_1) < 0) {__pyx_filename = __pyx_f[0]; __pyx_lineno = 89; __pyx_clineno = __LINE__; goto __pyx_L1_error;}
  __Pyx_DECREF(__pyx_t_1); __pyx_t_1 = 0;

  /* "grpc/_cython/cygrpc.pyx":92
 *     credentials.call_credentials_google_compute_engine)
 * call_credentials_jwt_access = (
 *     credentials.call_credentials_service_account_jwt_access)             # <<<<<<<<<<<<<<
 * call_credentials_refresh_token = (
 *     credentials.call_credentials_google_refresh_token)
 */
  __pyx_t_1 = __Pyx_GetModuleGlobalName(__pyx_n_s_credentials); if (unlikely(!__pyx_t_1)) {__pyx_filename = __pyx_f[0]; __pyx_lineno = 92; __pyx_clineno = __LINE__; goto __pyx_L1_error;}
  __Pyx_GOTREF(__pyx_t_1);
  __pyx_t_2 = __Pyx_PyObject_GetAttrStr(__pyx_t_1, __pyx_n_s_call_credentials_service_account); if (unlikely(!__pyx_t_2)) {__pyx_filename = __pyx_f[0]; __pyx_lineno = 92; __pyx_clineno = __LINE__; goto __pyx_L1_error;}
  __Pyx_GOTREF(__pyx_t_2);
  __Pyx_DECREF(__pyx_t_1); __pyx_t_1 = 0;
  if (PyDict_SetItem(__pyx_d, __pyx_n_s_call_credentials_jwt_access, __pyx_t_2) < 0) {__pyx_filename = __pyx_f[0]; __pyx_lineno = 91; __pyx_clineno = __LINE__; goto __pyx_L1_error;}
  __Pyx_DECREF(__pyx_t_2); __pyx_t_2 = 0;

  /* "grpc/_cython/cygrpc.pyx":94
 *     credentials.call_credentials_service_account_jwt_access)
 * call_credentials_refresh_token = (
 *     credentials.call_credentials_google_refresh_token)             # <<<<<<<<<<<<<<
 * call_credentials_google_iam = credentials.call_credentials_google_iam
 * call_credentials_metadata_plugin = credentials.call_credentials_metadata_plugin
 */
  __pyx_t_2 = __Pyx_GetModuleGlobalName(__pyx_n_s_credentials); if (unlikely(!__pyx_t_2)) {__pyx_filename = __pyx_f[0]; __pyx_lineno = 94; __pyx_clineno = __LINE__; goto __pyx_L1_error;}
  __Pyx_GOTREF(__pyx_t_2);
  __pyx_t_1 = __Pyx_PyObject_GetAttrStr(__pyx_t_2, __pyx_n_s_call_credentials_google_refresh); if (unlikely(!__pyx_t_1)) {__pyx_filename = __pyx_f[0]; __pyx_lineno = 94; __pyx_clineno = __LINE__; goto __pyx_L1_error;}
  __Pyx_GOTREF(__pyx_t_1);
  __Pyx_DECREF(__pyx_t_2); __pyx_t_2 = 0;
  if (PyDict_SetItem(__pyx_d, __pyx_n_s_call_credentials_refresh_token, __pyx_t_1) < 0) {__pyx_filename = __pyx_f[0]; __pyx_lineno = 93; __pyx_clineno = __LINE__; goto __pyx_L1_error;}
  __Pyx_DECREF(__pyx_t_1); __pyx_t_1 = 0;

  /* "grpc/_cython/cygrpc.pyx":95
 * call_credentials_refresh_token = (
 *     credentials.call_credentials_google_refresh_token)
 * call_credentials_google_iam = credentials.call_credentials_google_iam             # <<<<<<<<<<<<<<
 * call_credentials_metadata_plugin = credentials.call_credentials_metadata_plugin
 * server_credentials_ssl = credentials.server_credentials_ssl
 */
  __pyx_t_1 = __Pyx_GetModuleGlobalName(__pyx_n_s_credentials); if (unlikely(!__pyx_t_1)) {__pyx_filename = __pyx_f[0]; __pyx_lineno = 95; __pyx_clineno = __LINE__; goto __pyx_L1_error;}
  __Pyx_GOTREF(__pyx_t_1);
  __pyx_t_2 = __Pyx_PyObject_GetAttrStr(__pyx_t_1, __pyx_n_s_call_credentials_google_iam); if (unlikely(!__pyx_t_2)) {__pyx_filename = __pyx_f[0]; __pyx_lineno = 95; __pyx_clineno = __LINE__; goto __pyx_L1_error;}
  __Pyx_GOTREF(__pyx_t_2);
  __Pyx_DECREF(__pyx_t_1); __pyx_t_1 = 0;
  if (PyDict_SetItem(__pyx_d, __pyx_n_s_call_credentials_google_iam, __pyx_t_2) < 0) {__pyx_filename = __pyx_f[0]; __pyx_lineno = 95; __pyx_clineno = __LINE__; goto __pyx_L1_error;}
  __Pyx_DECREF(__pyx_t_2); __pyx_t_2 = 0;

  /* "grpc/_cython/cygrpc.pyx":96
 *     credentials.call_credentials_google_refresh_token)
 * call_credentials_google_iam = credentials.call_credentials_google_iam
 * call_credentials_metadata_plugin = credentials.call_credentials_metadata_plugin             # <<<<<<<<<<<<<<
 * server_credentials_ssl = credentials.server_credentials_ssl
 * 
 */
  __pyx_t_2 = __Pyx_GetModuleGlobalName(__pyx_n_s_credentials); if (unlikely(!__pyx_t_2)) {__pyx_filename = __pyx_f[0]; __pyx_lineno = 96; __pyx_clineno = __LINE__; goto __pyx_L1_error;}
  __Pyx_GOTREF(__pyx_t_2);
  __pyx_t_1 = __Pyx_PyObject_GetAttrStr(__pyx_t_2, __pyx_n_s_call_credentials_metadata_plugin); if (unlikely(!__pyx_t_1)) {__pyx_filename = __pyx_f[0]; __pyx_lineno = 96; __pyx_clineno = __LINE__; goto __pyx_L1_error;}
  __Pyx_GOTREF(__pyx_t_1);
  __Pyx_DECREF(__pyx_t_2); __pyx_t_2 = 0;
  if (PyDict_SetItem(__pyx_d, __pyx_n_s_call_credentials_metadata_plugin, __pyx_t_1) < 0) {__pyx_filename = __pyx_f[0]; __pyx_lineno = 96; __pyx_clineno = __LINE__; goto __pyx_L1_error;}
  __Pyx_DECREF(__pyx_t_1); __pyx_t_1 = 0;

  /* "grpc/_cython/cygrpc.pyx":97
 * call_credentials_google_iam = credentials.call_credentials_google_iam
 * call_credentials_metadata_plugin = credentials.call_credentials_metadata_plugin
 * server_credentials_ssl = credentials.server_credentials_ssl             # <<<<<<<<<<<<<<
 * 
 * CompletionQueue = completion_queue.CompletionQueue
 */
  __pyx_t_1 = __Pyx_GetModuleGlobalName(__pyx_n_s_credentials); if (unlikely(!__pyx_t_1)) {__pyx_filename = __pyx_f[0]; __pyx_lineno = 97; __pyx_clineno = __LINE__; goto __pyx_L1_error;}
  __Pyx_GOTREF(__pyx_t_1);
  __pyx_t_2 = __Pyx_PyObject_GetAttrStr(__pyx_t_1, __pyx_n_s_server_credentials_ssl); if (unlikely(!__pyx_t_2)) {__pyx_filename = __pyx_f[0]; __pyx_lineno = 97; __pyx_clineno = __LINE__; goto __pyx_L1_error;}
  __Pyx_GOTREF(__pyx_t_2);
  __Pyx_DECREF(__pyx_t_1); __pyx_t_1 = 0;
  if (PyDict_SetItem(__pyx_d, __pyx_n_s_server_credentials_ssl, __pyx_t_2) < 0) {__pyx_filename = __pyx_f[0]; __pyx_lineno = 97; __pyx_clineno = __LINE__; goto __pyx_L1_error;}
  __Pyx_DECREF(__pyx_t_2); __pyx_t_2 = 0;

  /* "grpc/_cython/cygrpc.pyx":99
 * server_credentials_ssl = credentials.server_credentials_ssl
 * 
 * CompletionQueue = completion_queue.CompletionQueue             # <<<<<<<<<<<<<<
 * Channel = channel.Channel
 * Server = server.Server
 */
  if (PyDict_SetItem(__pyx_d, __pyx_n_s_CompletionQueue, ((PyObject *)__pyx_ptype_4grpc_7_cython_7_cygrpc_16completion_queue_CompletionQueue)) < 0) {__pyx_filename = __pyx_f[0]; __pyx_lineno = 99; __pyx_clineno = __LINE__; goto __pyx_L1_error;}

  /* "grpc/_cython/cygrpc.pyx":100
 * 
 * CompletionQueue = completion_queue.CompletionQueue
 * Channel = channel.Channel             # <<<<<<<<<<<<<<
 * Server = server.Server
 * Call = call.Call
 */
  if (PyDict_SetItem(__pyx_d, __pyx_n_s_Channel, ((PyObject *)__pyx_ptype_4grpc_7_cython_7_cygrpc_7channel_Channel)) < 0) {__pyx_filename = __pyx_f[0]; __pyx_lineno = 100; __pyx_clineno = __LINE__; goto __pyx_L1_error;}

  /* "grpc/_cython/cygrpc.pyx":101
 * CompletionQueue = completion_queue.CompletionQueue
 * Channel = channel.Channel
 * Server = server.Server             # <<<<<<<<<<<<<<
 * Call = call.Call
 * 
 */
  if (PyDict_SetItem(__pyx_d, __pyx_n_s_Server, ((PyObject *)__pyx_ptype_4grpc_7_cython_7_cygrpc_6server_Server)) < 0) {__pyx_filename = __pyx_f[0]; __pyx_lineno = 101; __pyx_clineno = __LINE__; goto __pyx_L1_error;}

  /* "grpc/_cython/cygrpc.pyx":102
 * Channel = channel.Channel
 * Server = server.Server
 * Call = call.Call             # <<<<<<<<<<<<<<
 * 
 * 
 */
  if (PyDict_SetItem(__pyx_d, __pyx_n_s_Call, ((PyObject *)__pyx_ptype_4grpc_7_cython_7_cygrpc_4call_Call)) < 0) {__pyx_filename = __pyx_f[0]; __pyx_lineno = 102; __pyx_clineno = __LINE__; goto __pyx_L1_error;}

  /* "grpc/_cython/cygrpc.pyx":117
 *     grpc.grpc_shutdown()
 * 
 * _module_state = _ModuleState()             # <<<<<<<<<<<<<<
 * 
 */
  __pyx_t_2 = __Pyx_PyObject_Call(((PyObject *)__pyx_ptype_4grpc_7_cython_6cygrpc__ModuleState), __pyx_empty_tuple, NULL); if (unlikely(!__pyx_t_2)) {__pyx_filename = __pyx_f[0]; __pyx_lineno = 117; __pyx_clineno = __LINE__; goto __pyx_L1_error;}
  __Pyx_GOTREF(__pyx_t_2);
  if (PyDict_SetItem(__pyx_d, __pyx_n_s_module_state, __pyx_t_2) < 0) {__pyx_filename = __pyx_f[0]; __pyx_lineno = 117; __pyx_clineno = __LINE__; goto __pyx_L1_error;}
  __Pyx_DECREF(__pyx_t_2); __pyx_t_2 = 0;

  /* "grpc/_cython/cygrpc.pyx":1
 * # Copyright 2015, Google Inc.             # <<<<<<<<<<<<<<
 * # All rights reserved.
 * #
 */
  __pyx_t_2 = PyDict_New(); if (unlikely(!__pyx_t_2)) {__pyx_filename = __pyx_f[0]; __pyx_lineno = 1; __pyx_clineno = __LINE__; goto __pyx_L1_error;}
  __Pyx_GOTREF(__pyx_t_2);
  if (PyDict_SetItem(__pyx_d, __pyx_n_s_test, __pyx_t_2) < 0) {__pyx_filename = __pyx_f[0]; __pyx_lineno = 1; __pyx_clineno = __LINE__; goto __pyx_L1_error;}
  __Pyx_DECREF(__pyx_t_2); __pyx_t_2 = 0;

  /*--- Wrapped vars code ---*/

  goto __pyx_L0;
  __pyx_L1_error:;
  __Pyx_XDECREF(__pyx_t_1);
  __Pyx_XDECREF(__pyx_t_2);
  if (__pyx_m) {
    if (__pyx_d) {
      __Pyx_AddTraceback("init grpc._cython.cygrpc", __pyx_clineno, __pyx_lineno, __pyx_filename);
    }
    Py_DECREF(__pyx_m); __pyx_m = 0;
  } else if (!PyErr_Occurred()) {
    PyErr_SetString(PyExc_ImportError, "init grpc._cython.cygrpc");
  }
  __pyx_L0:;
  __Pyx_RefNannyFinishContext();
  #if PY_MAJOR_VERSION < 3
  return;
  #else
  return __pyx_m;
  #endif
}

/* --- Runtime support code --- */
#if CYTHON_REFNANNY
static __Pyx_RefNannyAPIStruct *__Pyx_RefNannyImportAPI(const char *modname) {
    PyObject *m = NULL, *p = NULL;
    void *r = NULL;
    m = PyImport_ImportModule((char *)modname);
    if (!m) goto end;
    p = PyObject_GetAttrString(m, (char *)"RefNannyAPI");
    if (!p) goto end;
    r = PyLong_AsVoidPtr(p);
end:
    Py_XDECREF(p);
    Py_XDECREF(m);
    return (__Pyx_RefNannyAPIStruct *)r;
}
#endif

static void __Pyx_RaiseArgtupleInvalid(
    const char* func_name,
    int exact,
    Py_ssize_t num_min,
    Py_ssize_t num_max,
    Py_ssize_t num_found)
{
    Py_ssize_t num_expected;
    const char *more_or_less;
    if (num_found < num_min) {
        num_expected = num_min;
        more_or_less = "at least";
    } else {
        num_expected = num_max;
        more_or_less = "at most";
    }
    if (exact) {
        more_or_less = "exactly";
    }
    PyErr_Format(PyExc_TypeError,
                 "%.200s() takes %.8s %" CYTHON_FORMAT_SSIZE_T "d positional argument%.1s (%" CYTHON_FORMAT_SSIZE_T "d given)",
                 func_name, more_or_less, num_expected,
                 (num_expected == 1) ? "" : "s", num_found);
}

static CYTHON_INLINE int __Pyx_CheckKeywordStrings(
    PyObject *kwdict,
    const char* function_name,
    int kw_allowed)
{
    PyObject* key = 0;
    Py_ssize_t pos = 0;
#if CYTHON_COMPILING_IN_PYPY
    if (!kw_allowed && PyDict_Next(kwdict, &pos, &key, 0))
        goto invalid_keyword;
    return 1;
#else
    while (PyDict_Next(kwdict, &pos, &key, 0)) {
        #if PY_MAJOR_VERSION < 3
        if (unlikely(!PyString_CheckExact(key)) && unlikely(!PyString_Check(key)))
        #endif
            if (unlikely(!PyUnicode_Check(key)))
                goto invalid_keyword_type;
    }
    if ((!kw_allowed) && unlikely(key))
        goto invalid_keyword;
    return 1;
invalid_keyword_type:
    PyErr_Format(PyExc_TypeError,
        "%.200s() keywords must be strings", function_name);
    return 0;
#endif
invalid_keyword:
    PyErr_Format(PyExc_TypeError,
    #if PY_MAJOR_VERSION < 3
        "%.200s() got an unexpected keyword argument '%.200s'",
        function_name, PyString_AsString(key));
    #else
        "%s() got an unexpected keyword argument '%U'",
        function_name, key);
    #endif
    return 0;
}

static void* __Pyx_GetVtable(PyObject *dict) {
    void* ptr;
    PyObject *ob = PyObject_GetItem(dict, __pyx_n_s_pyx_vtable);
    if (!ob)
        goto bad;
#if PY_VERSION_HEX >= 0x02070000
    ptr = PyCapsule_GetPointer(ob, 0);
#else
    ptr = PyCObject_AsVoidPtr(ob);
#endif
    if (!ptr && !PyErr_Occurred())
        PyErr_SetString(PyExc_RuntimeError, "invalid vtable found for imported type");
    Py_DECREF(ob);
    return ptr;
bad:
    Py_XDECREF(ob);
    return NULL;
}

static PyObject *__Pyx_Import(PyObject *name, PyObject *from_list, int level) {
    PyObject *empty_list = 0;
    PyObject *module = 0;
    PyObject *global_dict = 0;
    PyObject *empty_dict = 0;
    PyObject *list;
    #if PY_VERSION_HEX < 0x03030000
    PyObject *py_import;
    py_import = __Pyx_PyObject_GetAttrStr(__pyx_b, __pyx_n_s_import);
    if (!py_import)
        goto bad;
    #endif
    if (from_list)
        list = from_list;
    else {
        empty_list = PyList_New(0);
        if (!empty_list)
            goto bad;
        list = empty_list;
    }
    global_dict = PyModule_GetDict(__pyx_m);
    if (!global_dict)
        goto bad;
    empty_dict = PyDict_New();
    if (!empty_dict)
        goto bad;
    {
        #if PY_MAJOR_VERSION >= 3
        if (level == -1) {
            if (strchr(__Pyx_MODULE_NAME, '.')) {
                #if PY_VERSION_HEX < 0x03030000
                PyObject *py_level = PyInt_FromLong(1);
                if (!py_level)
                    goto bad;
                module = PyObject_CallFunctionObjArgs(py_import,
                    name, global_dict, empty_dict, list, py_level, NULL);
                Py_DECREF(py_level);
                #else
                module = PyImport_ImportModuleLevelObject(
                    name, global_dict, empty_dict, list, 1);
                #endif
                if (!module) {
                    if (!PyErr_ExceptionMatches(PyExc_ImportError))
                        goto bad;
                    PyErr_Clear();
                }
            }
            level = 0;
        }
        #endif
        if (!module) {
            #if PY_VERSION_HEX < 0x03030000
            PyObject *py_level = PyInt_FromLong(level);
            if (!py_level)
                goto bad;
            module = PyObject_CallFunctionObjArgs(py_import,
                name, global_dict, empty_dict, list, py_level, NULL);
            Py_DECREF(py_level);
            #else
            module = PyImport_ImportModuleLevelObject(
                name, global_dict, empty_dict, list, level);
            #endif
        }
    }
bad:
    #if PY_VERSION_HEX < 0x03030000
    Py_XDECREF(py_import);
    #endif
    Py_XDECREF(empty_list);
    Py_XDECREF(empty_dict);
    return module;
}

static PyObject* __Pyx_ImportFrom(PyObject* module, PyObject* name) {
    PyObject* value = __Pyx_PyObject_GetAttrStr(module, name);
    if (unlikely(!value) && PyErr_ExceptionMatches(PyExc_AttributeError)) {
        PyErr_Format(PyExc_ImportError,
        #if PY_MAJOR_VERSION < 3
            "cannot import name %.230s", PyString_AS_STRING(name));
        #else
            "cannot import name %S", name);
        #endif
    }
    return value;
}

static PyObject *__Pyx_GetBuiltinName(PyObject *name) {
    PyObject* result = __Pyx_PyObject_GetAttrStr(__pyx_b, name);
    if (unlikely(!result)) {
        PyErr_Format(PyExc_NameError,
#if PY_MAJOR_VERSION >= 3
            "name '%U' is not defined", name);
#else
            "name '%.200s' is not defined", PyString_AS_STRING(name));
#endif
    }
    return result;
}

static CYTHON_INLINE PyObject *__Pyx_GetModuleGlobalName(PyObject *name) {
    PyObject *result;
#if CYTHON_COMPILING_IN_CPYTHON
    result = PyDict_GetItem(__pyx_d, name);
    if (likely(result)) {
        Py_INCREF(result);
    } else {
#else
    result = PyObject_GetItem(__pyx_d, name);
    if (!result) {
        PyErr_Clear();
#endif
        result = __Pyx_GetBuiltinName(name);
    }
    return result;
}

#if CYTHON_COMPILING_IN_CPYTHON
static CYTHON_INLINE PyObject* __Pyx_PyObject_Call(PyObject *func, PyObject *arg, PyObject *kw) {
    PyObject *result;
    ternaryfunc call = func->ob_type->tp_call;
    if (unlikely(!call))
        return PyObject_Call(func, arg, kw);
    if (unlikely(Py_EnterRecursiveCall((char*)" while calling a Python object")))
        return NULL;
    result = (*call)(func, arg, kw);
    Py_LeaveRecursiveCall();
    if (unlikely(!result) && unlikely(!PyErr_Occurred())) {
        PyErr_SetString(
            PyExc_SystemError,
            "NULL result without error in PyObject_Call");
    }
    return result;
}
#endif

static int __pyx_bisect_code_objects(__Pyx_CodeObjectCacheEntry* entries, int count, int code_line) {
    int start = 0, mid = 0, end = count - 1;
    if (end >= 0 && code_line > entries[end].code_line) {
        return count;
    }
    while (start < end) {
        mid = start + (end - start) / 2;
        if (code_line < entries[mid].code_line) {
            end = mid;
        } else if (code_line > entries[mid].code_line) {
             start = mid + 1;
        } else {
            return mid;
        }
    }
    if (code_line <= entries[mid].code_line) {
        return mid;
    } else {
        return mid + 1;
    }
}
static PyCodeObject *__pyx_find_code_object(int code_line) {
    PyCodeObject* code_object;
    int pos;
    if (unlikely(!code_line) || unlikely(!__pyx_code_cache.entries)) {
        return NULL;
    }
    pos = __pyx_bisect_code_objects(__pyx_code_cache.entries, __pyx_code_cache.count, code_line);
    if (unlikely(pos >= __pyx_code_cache.count) || unlikely(__pyx_code_cache.entries[pos].code_line != code_line)) {
        return NULL;
    }
    code_object = __pyx_code_cache.entries[pos].code_object;
    Py_INCREF(code_object);
    return code_object;
}
static void __pyx_insert_code_object(int code_line, PyCodeObject* code_object) {
    int pos, i;
    __Pyx_CodeObjectCacheEntry* entries = __pyx_code_cache.entries;
    if (unlikely(!code_line)) {
        return;
    }
    if (unlikely(!entries)) {
        entries = (__Pyx_CodeObjectCacheEntry*)PyMem_Malloc(64*sizeof(__Pyx_CodeObjectCacheEntry));
        if (likely(entries)) {
            __pyx_code_cache.entries = entries;
            __pyx_code_cache.max_count = 64;
            __pyx_code_cache.count = 1;
            entries[0].code_line = code_line;
            entries[0].code_object = code_object;
            Py_INCREF(code_object);
        }
        return;
    }
    pos = __pyx_bisect_code_objects(__pyx_code_cache.entries, __pyx_code_cache.count, code_line);
    if ((pos < __pyx_code_cache.count) && unlikely(__pyx_code_cache.entries[pos].code_line == code_line)) {
        PyCodeObject* tmp = entries[pos].code_object;
        entries[pos].code_object = code_object;
        Py_DECREF(tmp);
        return;
    }
    if (__pyx_code_cache.count == __pyx_code_cache.max_count) {
        int new_max = __pyx_code_cache.max_count + 64;
        entries = (__Pyx_CodeObjectCacheEntry*)PyMem_Realloc(
            __pyx_code_cache.entries, (size_t)new_max*sizeof(__Pyx_CodeObjectCacheEntry));
        if (unlikely(!entries)) {
            return;
        }
        __pyx_code_cache.entries = entries;
        __pyx_code_cache.max_count = new_max;
    }
    for (i=__pyx_code_cache.count; i>pos; i--) {
        entries[i] = entries[i-1];
    }
    entries[pos].code_line = code_line;
    entries[pos].code_object = code_object;
    __pyx_code_cache.count++;
    Py_INCREF(code_object);
}

#include "compile.h"
#include "frameobject.h"
#include "traceback.h"
static PyCodeObject* __Pyx_CreateCodeObjectForTraceback(
            const char *funcname, int c_line,
            int py_line, const char *filename) {
    PyCodeObject *py_code = 0;
    PyObject *py_srcfile = 0;
    PyObject *py_funcname = 0;
    #if PY_MAJOR_VERSION < 3
    py_srcfile = PyString_FromString(filename);
    #else
    py_srcfile = PyUnicode_FromString(filename);
    #endif
    if (!py_srcfile) goto bad;
    if (c_line) {
        #if PY_MAJOR_VERSION < 3
        py_funcname = PyString_FromFormat( "%s (%s:%d)", funcname, __pyx_cfilenm, c_line);
        #else
        py_funcname = PyUnicode_FromFormat( "%s (%s:%d)", funcname, __pyx_cfilenm, c_line);
        #endif
    }
    else {
        #if PY_MAJOR_VERSION < 3
        py_funcname = PyString_FromString(funcname);
        #else
        py_funcname = PyUnicode_FromString(funcname);
        #endif
    }
    if (!py_funcname) goto bad;
    py_code = __Pyx_PyCode_New(
        0,
        0,
        0,
        0,
        0,
        __pyx_empty_bytes, /*PyObject *code,*/
        __pyx_empty_tuple, /*PyObject *consts,*/
        __pyx_empty_tuple, /*PyObject *names,*/
        __pyx_empty_tuple, /*PyObject *varnames,*/
        __pyx_empty_tuple, /*PyObject *freevars,*/
        __pyx_empty_tuple, /*PyObject *cellvars,*/
        py_srcfile,   /*PyObject *filename,*/
        py_funcname,  /*PyObject *name,*/
        py_line,
        __pyx_empty_bytes  /*PyObject *lnotab*/
    );
    Py_DECREF(py_srcfile);
    Py_DECREF(py_funcname);
    return py_code;
bad:
    Py_XDECREF(py_srcfile);
    Py_XDECREF(py_funcname);
    return NULL;
}
static void __Pyx_AddTraceback(const char *funcname, int c_line,
                               int py_line, const char *filename) {
    PyCodeObject *py_code = 0;
    PyFrameObject *py_frame = 0;
    py_code = __pyx_find_code_object(c_line ? c_line : py_line);
    if (!py_code) {
        py_code = __Pyx_CreateCodeObjectForTraceback(
            funcname, c_line, py_line, filename);
        if (!py_code) goto bad;
        __pyx_insert_code_object(c_line ? c_line : py_line, py_code);
    }
    py_frame = PyFrame_New(
        PyThreadState_GET(), /*PyThreadState *tstate,*/
        py_code,             /*PyCodeObject *code,*/
        __pyx_d,      /*PyObject *globals,*/
        0                    /*PyObject *locals*/
    );
    if (!py_frame) goto bad;
    py_frame->f_lineno = py_line;
    PyTraceBack_Here(py_frame);
bad:
    Py_XDECREF(py_code);
    Py_XDECREF(py_frame);
}

static CYTHON_INLINE PyObject* __Pyx_PyInt_From_grpc_completion_type(grpc_completion_type value) {
    const grpc_completion_type neg_one = (grpc_completion_type) -1, const_zero = (grpc_completion_type) 0;
    const int is_unsigned = neg_one > const_zero;
    if (is_unsigned) {
        if (sizeof(grpc_completion_type) < sizeof(long)) {
            return PyInt_FromLong((long) value);
        } else if (sizeof(grpc_completion_type) <= sizeof(unsigned long)) {
            return PyLong_FromUnsignedLong((unsigned long) value);
        } else if (sizeof(grpc_completion_type) <= sizeof(unsigned PY_LONG_LONG)) {
            return PyLong_FromUnsignedLongLong((unsigned PY_LONG_LONG) value);
        }
    } else {
        if (sizeof(grpc_completion_type) <= sizeof(long)) {
            return PyInt_FromLong((long) value);
        } else if (sizeof(grpc_completion_type) <= sizeof(PY_LONG_LONG)) {
            return PyLong_FromLongLong((PY_LONG_LONG) value);
        }
    }
    {
        int one = 1; int little = (int)*(unsigned char *)&one;
        unsigned char *bytes = (unsigned char *)&value;
        return _PyLong_FromByteArray(bytes, sizeof(grpc_completion_type),
                                     little, !is_unsigned);
    }
}

static CYTHON_INLINE PyObject* __Pyx_PyInt_From_long(long value) {
    const long neg_one = (long) -1, const_zero = (long) 0;
    const int is_unsigned = neg_one > const_zero;
    if (is_unsigned) {
        if (sizeof(long) < sizeof(long)) {
            return PyInt_FromLong((long) value);
        } else if (sizeof(long) <= sizeof(unsigned long)) {
            return PyLong_FromUnsignedLong((unsigned long) value);
        } else if (sizeof(long) <= sizeof(unsigned PY_LONG_LONG)) {
            return PyLong_FromUnsignedLongLong((unsigned PY_LONG_LONG) value);
        }
    } else {
        if (sizeof(long) <= sizeof(long)) {
            return PyInt_FromLong((long) value);
        } else if (sizeof(long) <= sizeof(PY_LONG_LONG)) {
            return PyLong_FromLongLong((PY_LONG_LONG) value);
        }
    }
    {
        int one = 1; int little = (int)*(unsigned char *)&one;
        unsigned char *bytes = (unsigned char *)&value;
        return _PyLong_FromByteArray(bytes, sizeof(long),
                                     little, !is_unsigned);
    }
}

#define __PYX_VERIFY_RETURN_INT(target_type, func_type, func_value)\
    __PYX__VERIFY_RETURN_INT(target_type, func_type, func_value, 0)
#define __PYX_VERIFY_RETURN_INT_EXC(target_type, func_type, func_value)\
    __PYX__VERIFY_RETURN_INT(target_type, func_type, func_value, 1)
#define __PYX__VERIFY_RETURN_INT(target_type, func_type, func_value, exc)\
    {\
        func_type value = func_value;\
        if (sizeof(target_type) < sizeof(func_type)) {\
            if (unlikely(value != (func_type) (target_type) value)) {\
                func_type zero = 0;\
                if (exc && unlikely(value == (func_type)-1 && PyErr_Occurred()))\
                    return (target_type) -1;\
                if (is_unsigned && unlikely(value < zero))\
                    goto raise_neg_overflow;\
                else\
                    goto raise_overflow;\
            }\
        }\
        return (target_type) value;\
    }

#if CYTHON_USE_PYLONG_INTERNALS
  #include "longintrepr.h"
#endif

static CYTHON_INLINE long __Pyx_PyInt_As_long(PyObject *x) {
    const long neg_one = (long) -1, const_zero = (long) 0;
    const int is_unsigned = neg_one > const_zero;
#if PY_MAJOR_VERSION < 3
    if (likely(PyInt_Check(x))) {
        if (sizeof(long) < sizeof(long)) {
            __PYX_VERIFY_RETURN_INT(long, long, PyInt_AS_LONG(x))
        } else {
            long val = PyInt_AS_LONG(x);
            if (is_unsigned && unlikely(val < 0)) {
                goto raise_neg_overflow;
            }
            return (long) val;
        }
    } else
#endif
    if (likely(PyLong_Check(x))) {
        if (is_unsigned) {
#if CYTHON_USE_PYLONG_INTERNALS
            const digit* digits = ((PyLongObject*)x)->ob_digit;
            switch (Py_SIZE(x)) {
                case  0: return (long) 0;
                case  1: __PYX_VERIFY_RETURN_INT(long, digit, digits[0])
                case 2:
                    if (8 * sizeof(long) > 1 * PyLong_SHIFT) {
                        if (8 * sizeof(unsigned long) > 2 * PyLong_SHIFT) {
                            __PYX_VERIFY_RETURN_INT(long, unsigned long, (((((unsigned long)digits[1]) << PyLong_SHIFT) | (unsigned long)digits[0])))
                        } else if (8 * sizeof(long) >= 2 * PyLong_SHIFT) {
                            return (long) (((((long)digits[1]) << PyLong_SHIFT) | (long)digits[0]));
                        }
                    }
                    break;
                case 3:
                    if (8 * sizeof(long) > 2 * PyLong_SHIFT) {
                        if (8 * sizeof(unsigned long) > 3 * PyLong_SHIFT) {
                            __PYX_VERIFY_RETURN_INT(long, unsigned long, (((((((unsigned long)digits[2]) << PyLong_SHIFT) | (unsigned long)digits[1]) << PyLong_SHIFT) | (unsigned long)digits[0])))
                        } else if (8 * sizeof(long) >= 3 * PyLong_SHIFT) {
                            return (long) (((((((long)digits[2]) << PyLong_SHIFT) | (long)digits[1]) << PyLong_SHIFT) | (long)digits[0]));
                        }
                    }
                    break;
                case 4:
                    if (8 * sizeof(long) > 3 * PyLong_SHIFT) {
                        if (8 * sizeof(unsigned long) > 4 * PyLong_SHIFT) {
                            __PYX_VERIFY_RETURN_INT(long, unsigned long, (((((((((unsigned long)digits[3]) << PyLong_SHIFT) | (unsigned long)digits[2]) << PyLong_SHIFT) | (unsigned long)digits[1]) << PyLong_SHIFT) | (unsigned long)digits[0])))
                        } else if (8 * sizeof(long) >= 4 * PyLong_SHIFT) {
                            return (long) (((((((((long)digits[3]) << PyLong_SHIFT) | (long)digits[2]) << PyLong_SHIFT) | (long)digits[1]) << PyLong_SHIFT) | (long)digits[0]));
                        }
                    }
                    break;
            }
#endif
#if CYTHON_COMPILING_IN_CPYTHON
            if (unlikely(Py_SIZE(x) < 0)) {
                goto raise_neg_overflow;
            }
#else
            {
                int result = PyObject_RichCompareBool(x, Py_False, Py_LT);
                if (unlikely(result < 0))
                    return (long) -1;
                if (unlikely(result == 1))
                    goto raise_neg_overflow;
            }
#endif
            if (sizeof(long) <= sizeof(unsigned long)) {
                __PYX_VERIFY_RETURN_INT_EXC(long, unsigned long, PyLong_AsUnsignedLong(x))
            } else if (sizeof(long) <= sizeof(unsigned PY_LONG_LONG)) {
                __PYX_VERIFY_RETURN_INT_EXC(long, unsigned PY_LONG_LONG, PyLong_AsUnsignedLongLong(x))
            }
        } else {
#if CYTHON_USE_PYLONG_INTERNALS
            const digit* digits = ((PyLongObject*)x)->ob_digit;
            switch (Py_SIZE(x)) {
                case  0: return (long) 0;
                case -1: __PYX_VERIFY_RETURN_INT(long, sdigit, -(sdigit) digits[0])
                case  1: __PYX_VERIFY_RETURN_INT(long,  digit, +digits[0])
                case -2:
                    if (8 * sizeof(long) - 1 > 1 * PyLong_SHIFT) {
                        if (8 * sizeof(unsigned long) > 2 * PyLong_SHIFT) {
                            __PYX_VERIFY_RETURN_INT(long, long, -(long) (((((unsigned long)digits[1]) << PyLong_SHIFT) | (unsigned long)digits[0])))
                        } else if (8 * sizeof(long) - 1 > 2 * PyLong_SHIFT) {
                            return (long) (((long)-1)*(((((long)digits[1]) << PyLong_SHIFT) | (long)digits[0])));
                        }
                    }
                    break;
                case 2:
                    if (8 * sizeof(long) > 1 * PyLong_SHIFT) {
                        if (8 * sizeof(unsigned long) > 2 * PyLong_SHIFT) {
                            __PYX_VERIFY_RETURN_INT(long, unsigned long, (((((unsigned long)digits[1]) << PyLong_SHIFT) | (unsigned long)digits[0])))
                        } else if (8 * sizeof(long) - 1 > 2 * PyLong_SHIFT) {
                            return (long) ((((((long)digits[1]) << PyLong_SHIFT) | (long)digits[0])));
                        }
                    }
                    break;
                case -3:
                    if (8 * sizeof(long) - 1 > 2 * PyLong_SHIFT) {
                        if (8 * sizeof(unsigned long) > 3 * PyLong_SHIFT) {
                            __PYX_VERIFY_RETURN_INT(long, long, -(long) (((((((unsigned long)digits[2]) << PyLong_SHIFT) | (unsigned long)digits[1]) << PyLong_SHIFT) | (unsigned long)digits[0])))
                        } else if (8 * sizeof(long) - 1 > 3 * PyLong_SHIFT) {
                            return (long) (((long)-1)*(((((((long)digits[2]) << PyLong_SHIFT) | (long)digits[1]) << PyLong_SHIFT) | (long)digits[0])));
                        }
                    }
                    break;
                case 3:
                    if (8 * sizeof(long) > 2 * PyLong_SHIFT) {
                        if (8 * sizeof(unsigned long) > 3 * PyLong_SHIFT) {
                            __PYX_VERIFY_RETURN_INT(long, unsigned long, (((((((unsigned long)digits[2]) << PyLong_SHIFT) | (unsigned long)digits[1]) << PyLong_SHIFT) | (unsigned long)digits[0])))
                        } else if (8 * sizeof(long) - 1 > 3 * PyLong_SHIFT) {
                            return (long) ((((((((long)digits[2]) << PyLong_SHIFT) | (long)digits[1]) << PyLong_SHIFT) | (long)digits[0])));
                        }
                    }
                    break;
                case -4:
                    if (8 * sizeof(long) - 1 > 3 * PyLong_SHIFT) {
                        if (8 * sizeof(unsigned long) > 4 * PyLong_SHIFT) {
                            __PYX_VERIFY_RETURN_INT(long, long, -(long) (((((((((unsigned long)digits[3]) << PyLong_SHIFT) | (unsigned long)digits[2]) << PyLong_SHIFT) | (unsigned long)digits[1]) << PyLong_SHIFT) | (unsigned long)digits[0])))
                        } else if (8 * sizeof(long) - 1 > 4 * PyLong_SHIFT) {
                            return (long) (((long)-1)*(((((((((long)digits[3]) << PyLong_SHIFT) | (long)digits[2]) << PyLong_SHIFT) | (long)digits[1]) << PyLong_SHIFT) | (long)digits[0])));
                        }
                    }
                    break;
                case 4:
                    if (8 * sizeof(long) > 3 * PyLong_SHIFT) {
                        if (8 * sizeof(unsigned long) > 4 * PyLong_SHIFT) {
                            __PYX_VERIFY_RETURN_INT(long, unsigned long, (((((((((unsigned long)digits[3]) << PyLong_SHIFT) | (unsigned long)digits[2]) << PyLong_SHIFT) | (unsigned long)digits[1]) << PyLong_SHIFT) | (unsigned long)digits[0])))
                        } else if (8 * sizeof(long) - 1 > 4 * PyLong_SHIFT) {
                            return (long) ((((((((((long)digits[3]) << PyLong_SHIFT) | (long)digits[2]) << PyLong_SHIFT) | (long)digits[1]) << PyLong_SHIFT) | (long)digits[0])));
                        }
                    }
                    break;
            }
#endif
            if (sizeof(long) <= sizeof(long)) {
                __PYX_VERIFY_RETURN_INT_EXC(long, long, PyLong_AsLong(x))
            } else if (sizeof(long) <= sizeof(PY_LONG_LONG)) {
                __PYX_VERIFY_RETURN_INT_EXC(long, PY_LONG_LONG, PyLong_AsLongLong(x))
            }
        }
        {
#if CYTHON_COMPILING_IN_PYPY && !defined(_PyLong_AsByteArray)
            PyErr_SetString(PyExc_RuntimeError,
                            "_PyLong_AsByteArray() not available in PyPy, cannot convert large numbers");
#else
            long val;
            PyObject *v = __Pyx_PyNumber_Int(x);
 #if PY_MAJOR_VERSION < 3
            if (likely(v) && !PyLong_Check(v)) {
                PyObject *tmp = v;
                v = PyNumber_Long(tmp);
                Py_DECREF(tmp);
            }
 #endif
            if (likely(v)) {
                int one = 1; int is_little = (int)*(unsigned char *)&one;
                unsigned char *bytes = (unsigned char *)&val;
                int ret = _PyLong_AsByteArray((PyLongObject *)v,
                                              bytes, sizeof(val),
                                              is_little, !is_unsigned);
                Py_DECREF(v);
                if (likely(!ret))
                    return val;
            }
#endif
            return (long) -1;
        }
    } else {
        long val;
        PyObject *tmp = __Pyx_PyNumber_Int(x);
        if (!tmp) return (long) -1;
        val = __Pyx_PyInt_As_long(tmp);
        Py_DECREF(tmp);
        return val;
    }
raise_overflow:
    PyErr_SetString(PyExc_OverflowError,
        "value too large to convert to long");
    return (long) -1;
raise_neg_overflow:
    PyErr_SetString(PyExc_OverflowError,
        "can't convert negative value to long");
    return (long) -1;
}

static CYTHON_INLINE int __Pyx_PyInt_As_int(PyObject *x) {
    const int neg_one = (int) -1, const_zero = (int) 0;
    const int is_unsigned = neg_one > const_zero;
#if PY_MAJOR_VERSION < 3
    if (likely(PyInt_Check(x))) {
        if (sizeof(int) < sizeof(long)) {
            __PYX_VERIFY_RETURN_INT(int, long, PyInt_AS_LONG(x))
        } else {
            long val = PyInt_AS_LONG(x);
            if (is_unsigned && unlikely(val < 0)) {
                goto raise_neg_overflow;
            }
            return (int) val;
        }
    } else
#endif
    if (likely(PyLong_Check(x))) {
        if (is_unsigned) {
#if CYTHON_USE_PYLONG_INTERNALS
            const digit* digits = ((PyLongObject*)x)->ob_digit;
            switch (Py_SIZE(x)) {
                case  0: return (int) 0;
                case  1: __PYX_VERIFY_RETURN_INT(int, digit, digits[0])
                case 2:
                    if (8 * sizeof(int) > 1 * PyLong_SHIFT) {
                        if (8 * sizeof(unsigned long) > 2 * PyLong_SHIFT) {
                            __PYX_VERIFY_RETURN_INT(int, unsigned long, (((((unsigned long)digits[1]) << PyLong_SHIFT) | (unsigned long)digits[0])))
                        } else if (8 * sizeof(int) >= 2 * PyLong_SHIFT) {
                            return (int) (((((int)digits[1]) << PyLong_SHIFT) | (int)digits[0]));
                        }
                    }
                    break;
                case 3:
                    if (8 * sizeof(int) > 2 * PyLong_SHIFT) {
                        if (8 * sizeof(unsigned long) > 3 * PyLong_SHIFT) {
                            __PYX_VERIFY_RETURN_INT(int, unsigned long, (((((((unsigned long)digits[2]) << PyLong_SHIFT) | (unsigned long)digits[1]) << PyLong_SHIFT) | (unsigned long)digits[0])))
                        } else if (8 * sizeof(int) >= 3 * PyLong_SHIFT) {
                            return (int) (((((((int)digits[2]) << PyLong_SHIFT) | (int)digits[1]) << PyLong_SHIFT) | (int)digits[0]));
                        }
                    }
                    break;
                case 4:
                    if (8 * sizeof(int) > 3 * PyLong_SHIFT) {
                        if (8 * sizeof(unsigned long) > 4 * PyLong_SHIFT) {
                            __PYX_VERIFY_RETURN_INT(int, unsigned long, (((((((((unsigned long)digits[3]) << PyLong_SHIFT) | (unsigned long)digits[2]) << PyLong_SHIFT) | (unsigned long)digits[1]) << PyLong_SHIFT) | (unsigned long)digits[0])))
                        } else if (8 * sizeof(int) >= 4 * PyLong_SHIFT) {
                            return (int) (((((((((int)digits[3]) << PyLong_SHIFT) | (int)digits[2]) << PyLong_SHIFT) | (int)digits[1]) << PyLong_SHIFT) | (int)digits[0]));
                        }
                    }
                    break;
            }
#endif
#if CYTHON_COMPILING_IN_CPYTHON
            if (unlikely(Py_SIZE(x) < 0)) {
                goto raise_neg_overflow;
            }
#else
            {
                int result = PyObject_RichCompareBool(x, Py_False, Py_LT);
                if (unlikely(result < 0))
                    return (int) -1;
                if (unlikely(result == 1))
                    goto raise_neg_overflow;
            }
#endif
            if (sizeof(int) <= sizeof(unsigned long)) {
                __PYX_VERIFY_RETURN_INT_EXC(int, unsigned long, PyLong_AsUnsignedLong(x))
            } else if (sizeof(int) <= sizeof(unsigned PY_LONG_LONG)) {
                __PYX_VERIFY_RETURN_INT_EXC(int, unsigned PY_LONG_LONG, PyLong_AsUnsignedLongLong(x))
            }
        } else {
#if CYTHON_USE_PYLONG_INTERNALS
            const digit* digits = ((PyLongObject*)x)->ob_digit;
            switch (Py_SIZE(x)) {
                case  0: return (int) 0;
                case -1: __PYX_VERIFY_RETURN_INT(int, sdigit, -(sdigit) digits[0])
                case  1: __PYX_VERIFY_RETURN_INT(int,  digit, +digits[0])
                case -2:
                    if (8 * sizeof(int) - 1 > 1 * PyLong_SHIFT) {
                        if (8 * sizeof(unsigned long) > 2 * PyLong_SHIFT) {
                            __PYX_VERIFY_RETURN_INT(int, long, -(long) (((((unsigned long)digits[1]) << PyLong_SHIFT) | (unsigned long)digits[0])))
                        } else if (8 * sizeof(int) - 1 > 2 * PyLong_SHIFT) {
                            return (int) (((int)-1)*(((((int)digits[1]) << PyLong_SHIFT) | (int)digits[0])));
                        }
                    }
                    break;
                case 2:
                    if (8 * sizeof(int) > 1 * PyLong_SHIFT) {
                        if (8 * sizeof(unsigned long) > 2 * PyLong_SHIFT) {
                            __PYX_VERIFY_RETURN_INT(int, unsigned long, (((((unsigned long)digits[1]) << PyLong_SHIFT) | (unsigned long)digits[0])))
                        } else if (8 * sizeof(int) - 1 > 2 * PyLong_SHIFT) {
                            return (int) ((((((int)digits[1]) << PyLong_SHIFT) | (int)digits[0])));
                        }
                    }
                    break;
                case -3:
                    if (8 * sizeof(int) - 1 > 2 * PyLong_SHIFT) {
                        if (8 * sizeof(unsigned long) > 3 * PyLong_SHIFT) {
                            __PYX_VERIFY_RETURN_INT(int, long, -(long) (((((((unsigned long)digits[2]) << PyLong_SHIFT) | (unsigned long)digits[1]) << PyLong_SHIFT) | (unsigned long)digits[0])))
                        } else if (8 * sizeof(int) - 1 > 3 * PyLong_SHIFT) {
                            return (int) (((int)-1)*(((((((int)digits[2]) << PyLong_SHIFT) | (int)digits[1]) << PyLong_SHIFT) | (int)digits[0])));
                        }
                    }
                    break;
                case 3:
                    if (8 * sizeof(int) > 2 * PyLong_SHIFT) {
                        if (8 * sizeof(unsigned long) > 3 * PyLong_SHIFT) {
                            __PYX_VERIFY_RETURN_INT(int, unsigned long, (((((((unsigned long)digits[2]) << PyLong_SHIFT) | (unsigned long)digits[1]) << PyLong_SHIFT) | (unsigned long)digits[0])))
                        } else if (8 * sizeof(int) - 1 > 3 * PyLong_SHIFT) {
                            return (int) ((((((((int)digits[2]) << PyLong_SHIFT) | (int)digits[1]) << PyLong_SHIFT) | (int)digits[0])));
                        }
                    }
                    break;
                case -4:
                    if (8 * sizeof(int) - 1 > 3 * PyLong_SHIFT) {
                        if (8 * sizeof(unsigned long) > 4 * PyLong_SHIFT) {
                            __PYX_VERIFY_RETURN_INT(int, long, -(long) (((((((((unsigned long)digits[3]) << PyLong_SHIFT) | (unsigned long)digits[2]) << PyLong_SHIFT) | (unsigned long)digits[1]) << PyLong_SHIFT) | (unsigned long)digits[0])))
                        } else if (8 * sizeof(int) - 1 > 4 * PyLong_SHIFT) {
                            return (int) (((int)-1)*(((((((((int)digits[3]) << PyLong_SHIFT) | (int)digits[2]) << PyLong_SHIFT) | (int)digits[1]) << PyLong_SHIFT) | (int)digits[0])));
                        }
                    }
                    break;
                case 4:
                    if (8 * sizeof(int) > 3 * PyLong_SHIFT) {
                        if (8 * sizeof(unsigned long) > 4 * PyLong_SHIFT) {
                            __PYX_VERIFY_RETURN_INT(int, unsigned long, (((((((((unsigned long)digits[3]) << PyLong_SHIFT) | (unsigned long)digits[2]) << PyLong_SHIFT) | (unsigned long)digits[1]) << PyLong_SHIFT) | (unsigned long)digits[0])))
                        } else if (8 * sizeof(int) - 1 > 4 * PyLong_SHIFT) {
                            return (int) ((((((((((int)digits[3]) << PyLong_SHIFT) | (int)digits[2]) << PyLong_SHIFT) | (int)digits[1]) << PyLong_SHIFT) | (int)digits[0])));
                        }
                    }
                    break;
            }
#endif
            if (sizeof(int) <= sizeof(long)) {
                __PYX_VERIFY_RETURN_INT_EXC(int, long, PyLong_AsLong(x))
            } else if (sizeof(int) <= sizeof(PY_LONG_LONG)) {
                __PYX_VERIFY_RETURN_INT_EXC(int, PY_LONG_LONG, PyLong_AsLongLong(x))
            }
        }
        {
#if CYTHON_COMPILING_IN_PYPY && !defined(_PyLong_AsByteArray)
            PyErr_SetString(PyExc_RuntimeError,
                            "_PyLong_AsByteArray() not available in PyPy, cannot convert large numbers");
#else
            int val;
            PyObject *v = __Pyx_PyNumber_Int(x);
 #if PY_MAJOR_VERSION < 3
            if (likely(v) && !PyLong_Check(v)) {
                PyObject *tmp = v;
                v = PyNumber_Long(tmp);
                Py_DECREF(tmp);
            }
 #endif
            if (likely(v)) {
                int one = 1; int is_little = (int)*(unsigned char *)&one;
                unsigned char *bytes = (unsigned char *)&val;
                int ret = _PyLong_AsByteArray((PyLongObject *)v,
                                              bytes, sizeof(val),
                                              is_little, !is_unsigned);
                Py_DECREF(v);
                if (likely(!ret))
                    return val;
            }
#endif
            return (int) -1;
        }
    } else {
        int val;
        PyObject *tmp = __Pyx_PyNumber_Int(x);
        if (!tmp) return (int) -1;
        val = __Pyx_PyInt_As_int(tmp);
        Py_DECREF(tmp);
        return val;
    }
raise_overflow:
    PyErr_SetString(PyExc_OverflowError,
        "value too large to convert to int");
    return (int) -1;
raise_neg_overflow:
    PyErr_SetString(PyExc_OverflowError,
        "can't convert negative value to int");
    return (int) -1;
}

static int __Pyx_check_binary_version(void) {
    char ctversion[4], rtversion[4];
    PyOS_snprintf(ctversion, 4, "%d.%d", PY_MAJOR_VERSION, PY_MINOR_VERSION);
    PyOS_snprintf(rtversion, 4, "%s", Py_GetVersion());
    if (ctversion[0] != rtversion[0] || ctversion[2] != rtversion[2]) {
        char message[200];
        PyOS_snprintf(message, sizeof(message),
                      "compiletime version %s of module '%.100s' "
                      "does not match runtime version %s",
                      ctversion, __Pyx_MODULE_NAME, rtversion);
        return PyErr_WarnEx(NULL, message, 1);
    }
    return 0;
}

#ifndef __PYX_HAVE_RT_ImportModule
#define __PYX_HAVE_RT_ImportModule
static PyObject *__Pyx_ImportModule(const char *name) {
    PyObject *py_name = 0;
    PyObject *py_module = 0;
    py_name = __Pyx_PyIdentifier_FromString(name);
    if (!py_name)
        goto bad;
    py_module = PyImport_Import(py_name);
    Py_DECREF(py_name);
    return py_module;
bad:
    Py_XDECREF(py_name);
    return 0;
}
#endif

#ifndef __PYX_HAVE_RT_ImportType
#define __PYX_HAVE_RT_ImportType
static PyTypeObject *__Pyx_ImportType(const char *module_name, const char *class_name,
    size_t size, int strict)
{
    PyObject *py_module = 0;
    PyObject *result = 0;
    PyObject *py_name = 0;
    char warning[200];
    Py_ssize_t basicsize;
#ifdef Py_LIMITED_API
    PyObject *py_basicsize;
#endif
    py_module = __Pyx_ImportModule(module_name);
    if (!py_module)
        goto bad;
    py_name = __Pyx_PyIdentifier_FromString(class_name);
    if (!py_name)
        goto bad;
    result = PyObject_GetAttr(py_module, py_name);
    Py_DECREF(py_name);
    py_name = 0;
    Py_DECREF(py_module);
    py_module = 0;
    if (!result)
        goto bad;
    if (!PyType_Check(result)) {
        PyErr_Format(PyExc_TypeError,
            "%.200s.%.200s is not a type object",
            module_name, class_name);
        goto bad;
    }
#ifndef Py_LIMITED_API
    basicsize = ((PyTypeObject *)result)->tp_basicsize;
#else
    py_basicsize = PyObject_GetAttrString(result, "__basicsize__");
    if (!py_basicsize)
        goto bad;
    basicsize = PyLong_AsSsize_t(py_basicsize);
    Py_DECREF(py_basicsize);
    py_basicsize = 0;
    if (basicsize == (Py_ssize_t)-1 && PyErr_Occurred())
        goto bad;
#endif
    if (!strict && (size_t)basicsize > size) {
        PyOS_snprintf(warning, sizeof(warning),
            "%s.%s size changed, may indicate binary incompatibility",
            module_name, class_name);
        if (PyErr_WarnEx(NULL, warning, 0) < 0) goto bad;
    }
    else if ((size_t)basicsize != size) {
        PyErr_Format(PyExc_ValueError,
            "%.200s.%.200s has the wrong size, try recompiling",
            module_name, class_name);
        goto bad;
    }
    return (PyTypeObject *)result;
bad:
    Py_XDECREF(py_module);
    Py_XDECREF(result);
    return NULL;
}
#endif

static int __Pyx_InitStrings(__Pyx_StringTabEntry *t) {
    while (t->p) {
        #if PY_MAJOR_VERSION < 3
        if (t->is_unicode) {
            *t->p = PyUnicode_DecodeUTF8(t->s, t->n - 1, NULL);
        } else if (t->intern) {
            *t->p = PyString_InternFromString(t->s);
        } else {
            *t->p = PyString_FromStringAndSize(t->s, t->n - 1);
        }
        #else
        if (t->is_unicode | t->is_str) {
            if (t->intern) {
                *t->p = PyUnicode_InternFromString(t->s);
            } else if (t->encoding) {
                *t->p = PyUnicode_Decode(t->s, t->n - 1, t->encoding, NULL);
            } else {
                *t->p = PyUnicode_FromStringAndSize(t->s, t->n - 1);
            }
        } else {
            *t->p = PyBytes_FromStringAndSize(t->s, t->n - 1);
        }
        #endif
        if (!*t->p)
            return -1;
        ++t;
    }
    return 0;
}

static CYTHON_INLINE PyObject* __Pyx_PyUnicode_FromString(const char* c_str) {
    return __Pyx_PyUnicode_FromStringAndSize(c_str, (Py_ssize_t)strlen(c_str));
}
static CYTHON_INLINE char* __Pyx_PyObject_AsString(PyObject* o) {
    Py_ssize_t ignore;
    return __Pyx_PyObject_AsStringAndSize(o, &ignore);
}
static CYTHON_INLINE char* __Pyx_PyObject_AsStringAndSize(PyObject* o, Py_ssize_t *length) {
#if CYTHON_COMPILING_IN_CPYTHON && (__PYX_DEFAULT_STRING_ENCODING_IS_ASCII || __PYX_DEFAULT_STRING_ENCODING_IS_DEFAULT)
    if (
#if PY_MAJOR_VERSION < 3 && __PYX_DEFAULT_STRING_ENCODING_IS_ASCII
            __Pyx_sys_getdefaultencoding_not_ascii &&
#endif
            PyUnicode_Check(o)) {
#if PY_VERSION_HEX < 0x03030000
        char* defenc_c;
        PyObject* defenc = _PyUnicode_AsDefaultEncodedString(o, NULL);
        if (!defenc) return NULL;
        defenc_c = PyBytes_AS_STRING(defenc);
#if __PYX_DEFAULT_STRING_ENCODING_IS_ASCII
        {
            char* end = defenc_c + PyBytes_GET_SIZE(defenc);
            char* c;
            for (c = defenc_c; c < end; c++) {
                if ((unsigned char) (*c) >= 128) {
                    PyUnicode_AsASCIIString(o);
                    return NULL;
                }
            }
        }
#endif
        *length = PyBytes_GET_SIZE(defenc);
        return defenc_c;
#else
        if (__Pyx_PyUnicode_READY(o) == -1) return NULL;
#if __PYX_DEFAULT_STRING_ENCODING_IS_ASCII
        if (PyUnicode_IS_ASCII(o)) {
            *length = PyUnicode_GET_LENGTH(o);
            return PyUnicode_AsUTF8(o);
        } else {
            PyUnicode_AsASCIIString(o);
            return NULL;
        }
#else
        return PyUnicode_AsUTF8AndSize(o, length);
#endif
#endif
    } else
#endif
#if (!CYTHON_COMPILING_IN_PYPY) || (defined(PyByteArray_AS_STRING) && defined(PyByteArray_GET_SIZE))
    if (PyByteArray_Check(o)) {
        *length = PyByteArray_GET_SIZE(o);
        return PyByteArray_AS_STRING(o);
    } else
#endif
    {
        char* result;
        int r = PyBytes_AsStringAndSize(o, &result, length);
        if (unlikely(r < 0)) {
            return NULL;
        } else {
            return result;
        }
    }
}
static CYTHON_INLINE int __Pyx_PyObject_IsTrue(PyObject* x) {
   int is_true = x == Py_True;
   if (is_true | (x == Py_False) | (x == Py_None)) return is_true;
   else return PyObject_IsTrue(x);
}
static CYTHON_INLINE PyObject* __Pyx_PyNumber_Int(PyObject* x) {
  PyNumberMethods *m;
  const char *name = NULL;
  PyObject *res = NULL;
#if PY_MAJOR_VERSION < 3
  if (PyInt_Check(x) || PyLong_Check(x))
#else
  if (PyLong_Check(x))
#endif
    return __Pyx_NewRef(x);
  m = Py_TYPE(x)->tp_as_number;
#if PY_MAJOR_VERSION < 3
  if (m && m->nb_int) {
    name = "int";
    res = PyNumber_Int(x);
  }
  else if (m && m->nb_long) {
    name = "long";
    res = PyNumber_Long(x);
  }
#else
  if (m && m->nb_int) {
    name = "int";
    res = PyNumber_Long(x);
  }
#endif
  if (res) {
#if PY_MAJOR_VERSION < 3
    if (!PyInt_Check(res) && !PyLong_Check(res)) {
#else
    if (!PyLong_Check(res)) {
#endif
      PyErr_Format(PyExc_TypeError,
                   "__%.4s__ returned non-%.4s (type %.200s)",
                   name, name, Py_TYPE(res)->tp_name);
      Py_DECREF(res);
      return NULL;
    }
  }
  else if (!PyErr_Occurred()) {
    PyErr_SetString(PyExc_TypeError,
                    "an integer is required");
  }
  return res;
}
static CYTHON_INLINE Py_ssize_t __Pyx_PyIndex_AsSsize_t(PyObject* b) {
  Py_ssize_t ival;
  PyObject *x;
#if PY_MAJOR_VERSION < 3
  if (likely(PyInt_CheckExact(b))) {
    if (sizeof(Py_ssize_t) >= sizeof(long))
        return PyInt_AS_LONG(b);
    else
        return PyInt_AsSsize_t(x);
  }
#endif
  if (likely(PyLong_CheckExact(b))) {
    #if CYTHON_USE_PYLONG_INTERNALS
    const digit* digits = ((PyLongObject*)b)->ob_digit;
    const Py_ssize_t size = Py_SIZE(b);
    if (likely(__Pyx_sst_abs(size) <= 1)) {
        ival = likely(size) ? digits[0] : 0;
        if (size == -1) ival = -ival;
        return ival;
    } else {
      switch (size) {
         case 2:
           if (8 * sizeof(Py_ssize_t) > 2 * PyLong_SHIFT) {
             return (Py_ssize_t) (((((size_t)digits[1]) << PyLong_SHIFT) | (size_t)digits[0]));
           }
           break;
         case -2:
           if (8 * sizeof(Py_ssize_t) > 2 * PyLong_SHIFT) {
             return -(Py_ssize_t) (((((size_t)digits[1]) << PyLong_SHIFT) | (size_t)digits[0]));
           }
           break;
         case 3:
           if (8 * sizeof(Py_ssize_t) > 3 * PyLong_SHIFT) {
             return (Py_ssize_t) (((((((size_t)digits[2]) << PyLong_SHIFT) | (size_t)digits[1]) << PyLong_SHIFT) | (size_t)digits[0]));
           }
           break;
         case -3:
           if (8 * sizeof(Py_ssize_t) > 3 * PyLong_SHIFT) {
             return -(Py_ssize_t) (((((((size_t)digits[2]) << PyLong_SHIFT) | (size_t)digits[1]) << PyLong_SHIFT) | (size_t)digits[0]));
           }
           break;
         case 4:
           if (8 * sizeof(Py_ssize_t) > 4 * PyLong_SHIFT) {
             return (Py_ssize_t) (((((((((size_t)digits[3]) << PyLong_SHIFT) | (size_t)digits[2]) << PyLong_SHIFT) | (size_t)digits[1]) << PyLong_SHIFT) | (size_t)digits[0]));
           }
           break;
         case -4:
           if (8 * sizeof(Py_ssize_t) > 4 * PyLong_SHIFT) {
             return -(Py_ssize_t) (((((((((size_t)digits[3]) << PyLong_SHIFT) | (size_t)digits[2]) << PyLong_SHIFT) | (size_t)digits[1]) << PyLong_SHIFT) | (size_t)digits[0]));
           }
           break;
      }
    }
    #endif
    return PyLong_AsSsize_t(b);
  }
  x = PyNumber_Index(b);
  if (!x) return -1;
  ival = PyInt_AsSsize_t(x);
  Py_DECREF(x);
  return ival;
}
static CYTHON_INLINE PyObject * __Pyx_PyInt_FromSize_t(size_t ival) {
    return PyInt_FromSize_t(ival);
}


#endif /* Py_PYTHON_H */
